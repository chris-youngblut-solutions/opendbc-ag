VERSION "created by canmatrix"

NS_ :

BS_: 250000

BU_:

BO_ 2147548168 VDMA_FC08_Vehicle_Electrical_Pow: 8 Vector__XXX
 SG_ Vehicle_Electrical_Power_9_RawPa : 0|64@1+ (1,0) [0|18446744073709551615] "" Vector__XXX

BO_ 2147548169 VDMA_FC09_Vehicle_Electrical_Pow: 8 Vector__XXX
 SG_ Vehicle_Electrical_Power_8_RawPa : 0|64@1+ (1,0) [0|18446744073709551615] "" Vector__XXX

BO_ 2147548170 VDMA_FC0A_Vehicle_Electrical_Pow: 8 Vector__XXX
 SG_ Vehicle_Electrical_Power_7_RawPa : 0|64@1+ (1,0) [0|18446744073709551615] "" Vector__XXX

BO_ 2147548171 VDMA_FC0B_Electronic_Engine_Cont: 8 Vector__XXX
 SG_ Electronic_Engine_Controller_20_ : 0|64@1+ (1,0) [0|18446744073709551615] "" Vector__XXX

BO_ 2147548172 VDMA_FC0C_Evaporative_Systems: 8 Vector__XXX
 SG_ Evaporative_Systems_RawPayload : 0|64@1+ (1,0) [0|18446744073709551615] "" Vector__XXX

BO_ 2147548173 VDMA_FC0D_Fire_Pump_Statistics_1: 8 Vector__XXX
 SG_ Fire_Pump_Statistics_1_RawPayloa : 0|64@1+ (1,0) [0|18446744073709551615] "" Vector__XXX

BO_ 2147548174 VDMA_FC0E_Primary_or_Rear_Hitch_: 8 Vector__XXX
 SG_ Primary_or_Rear_Hitch_Roll_and_P : 0|64@1+ (1,0) [0|18446744073709551615] "" Vector__XXX

BO_ 2147548175 VDMA_FC0F_Secondary_or_Front_Hit: 8 Vector__XXX
 SG_ Secondary_or_Front_Hitch_Roll_an : 0|64@1+ (1,0) [0|18446744073709551615] "" Vector__XXX

BO_ 2147548176 VDMA_FC10_Ambient_Conditions_3: 8 Vector__XXX
 SG_ Ambient_Conditions_3_RawPayload : 0|64@1+ (1,0) [0|18446744073709551615] "" Vector__XXX

BO_ 2147548177 VDMA_FC11_Total_Gaseous_Fuel_Inf: 8 Vector__XXX
 SG_ Total_Gaseous_Fuel_Information_R : 0|64@1+ (1,0) [0|18446744073709551615] "" Vector__XXX

BO_ 2147548178 VDMA_FC12_Cab_Door_Control_1: 8 Vector__XXX
 SG_ Cab_Door_Control_1_RawPayload : 0|64@1+ (1,0) [0|18446744073709551615] "" Vector__XXX

BO_ 2147548179 VDMA_FC13_Door_Latch_Status: 8 Vector__XXX
 SG_ Door_Latch_Status_RawPayload : 0|64@1+ (1,0) [0|18446744073709551615] "" Vector__XXX

BO_ 2147548180 VDMA_FC14_Vehicle_Electrical_Pow: 8 Vector__XXX
 SG_ Vehicle_Electrical_Power_3_obsol : 0|64@1+ (1,0) [0|18446744073709551615] "" Vector__XXX

BO_ 2147548181 VDMA_FC15_Vehicle_Electrical_Pow: 8 Vector__XXX
 SG_ Vehicle_Electrical_Power_6_RawPa : 0|64@1+ (1,0) [0|18446744073709551615] "" Vector__XXX

BO_ 2147548182 VDMA_FC16_Payload_Temperature_2: 8 Vector__XXX
 SG_ Payload_Temperature_2_RawPayload : 0|64@1+ (1,0) [0|18446744073709551615] "" Vector__XXX

BO_ 2147548183 VDMA_FC17_Payload_Temperature_1: 8 Vector__XXX
 SG_ Payload_Temperature_1_RawPayload : 0|64@1+ (1,0) [0|18446744073709551615] "" Vector__XXX

BO_ 2147548184 VDMA_FC18_Payload_System_Totals_: 8 Vector__XXX
 SG_ Payload_System_Totals_2_RawPaylo : 0|64@1+ (1,0) [0|18446744073709551615] "" Vector__XXX

BO_ 2147548185 VDMA_FC19_Payload_System_Totals_: 8 Vector__XXX
 SG_ Payload_System_Totals_1_RawPaylo : 0|64@1+ (1,0) [0|18446744073709551615] "" Vector__XXX

BO_ 2147548186 VDMA_FC1A_HVESS_Thermal_Manageme: 8 Vector__XXX
 SG_ HVESS_Thermal_Management_System_ : 0|64@1+ (1,0) [0|18446744073709551615] "" Vector__XXX

BO_ 2147548187 VDMA_FC1B_HVESS_Thermal_Manageme: 8 Vector__XXX
 SG_ HVESS_Thermal_Management_System_ : 0|64@1+ (1,0) [0|18446744073709551615] "" Vector__XXX

BO_ 2147548188 VDMA_FC1C_Refrigeration_Compartm: 8 Vector__XXX
 SG_ Refrigeration_Compartment_Inform : 0|64@1+ (1,0) [0|18446744073709551615] "" Vector__XXX

BO_ 2147548189 VDMA_FC1D_Refrigeration_Compartm: 8 Vector__XXX
 SG_ Refrigeration_Compartment_Inform : 0|64@1+ (1,0) [0|18446744073709551615] "" Vector__XXX

BO_ 2147548190 VDMA_FC1E_Vehicle_Electrical_Pow: 8 Vector__XXX
 SG_ Vehicle_Electrical_Power_16_RawP : 0|64@1+ (1,0) [0|18446744073709551615] "" Vector__XXX

BO_ 2147548191 VDMA_FC1F_Vehicle_Electrical_Pow: 8 Vector__XXX
 SG_ Vehicle_Electrical_Power_17_RawP : 0|64@1+ (1,0) [0|18446744073709551615] "" Vector__XXX

BO_ 2147548192 VDMA_FC20_High_Voltage_Energy_St: 8 Vector__XXX
 SG_ High_Voltage_Energy_Storage_Syst : 0|64@1+ (1,0) [0|18446744073709551615] "" Vector__XXX

BO_ 2147548193 VDMA_FC21_High_Voltage_Energy_St: 8 Vector__XXX
 SG_ High_Voltage_Energy_Storage_Syst : 0|64@1+ (1,0) [0|18446744073709551615] "" Vector__XXX

BO_ 2147548194 VDMA_FC22_Electronic_Engine_Cont: 8 Vector__XXX
 SG_ Electronic_Engine_Controller_19_ : 0|64@1+ (1,0) [0|18446744073709551615] "" Vector__XXX

BO_ 2147548195 VDMA_FC23_Fuel_Consumption_Liqui: 8 Vector__XXX
 SG_ Fuel_Consumption_Liquid_2_RawPay : 0|64@1+ (1,0) [0|18446744073709551615] "" Vector__XXX

BO_ 2147548196 VDMA_FC24_Aftertreatment_2_Diese: 8 Vector__XXX
 SG_ Aftertreatment_2_Diesel_Exhaust_ : 0|64@1+ (1,0) [0|18446744073709551615] "" Vector__XXX

BO_ 2147548197 VDMA_FC25_Aftertreatment_1_Diese: 8 Vector__XXX
 SG_ Aftertreatment_1_Diesel_Exhaust_ : 0|64@1+ (1,0) [0|18446744073709551615] "" Vector__XXX

BO_ 2147548198 VDMA_FC26_Aftertreatment_2_Diese: 8 Vector__XXX
 SG_ Aftertreatment_2_Diesel_Exhaust_ : 0|64@1+ (1,0) [0|18446744073709551615] "" Vector__XXX

BO_ 2147548199 VDMA_FC27_Aftertreatment_1_Diese: 8 Vector__XXX
 SG_ Aftertreatment_1_Diesel_Exhaust_ : 0|64@1+ (1,0) [0|18446744073709551615] "" Vector__XXX

BO_ 2147548200 VDMA_FC28_Cruise_Control_Vehicle: 8 Vector__XXX
 SG_ Cruise_Control_Vehicle_Speed_6_R : 0|64@1+ (1,0) [0|18446744073709551615] "" Vector__XXX

BO_ 2147548201 VDMA_FC29_Forward_Lane_Image_3: 8 Vector__XXX
 SG_ Forward_Lane_Image_3_RawPayload : 0|64@1+ (1,0) [0|18446744073709551615] "" Vector__XXX

BO_ 2147548202 VDMA_FC2A_Operator_Inducement_In: 8 Vector__XXX
 SG_ Operator_Inducement_Information_ : 0|64@1+ (1,0) [0|18446744073709551615] "" Vector__XXX

BO_ 2147548203 VDMA_FC2B_Cruise_Control_Vehicle: 8 Vector__XXX
 SG_ Cruise_Control_Vehicle_Speed_4_R : 0|64@1+ (1,0) [0|18446744073709551615] "" Vector__XXX

BO_ 2147548204 VDMA_FC2C_Brake_Caliper_Lining_C: 8 Vector__XXX
 SG_ Brake_Caliper_Lining_Clearance_R : 0|64@1+ (1,0) [0|18446744073709551615] "" Vector__XXX

BO_ 2147548205 VDMA_FC2D_Alternate_Fuel_5: 8 Vector__XXX
 SG_ Alternate_Fuel_5_RawPayload : 0|64@1+ (1,0) [0|18446744073709551615] "" Vector__XXX

BO_ 2147548206 VDMA_FC2E_Engine_Turbocharger_Co: 8 Vector__XXX
 SG_ Engine_Turbocharger_Control_3_Ra : 0|64@1+ (1,0) [0|18446744073709551615] "" Vector__XXX

BO_ 2147548207 VDMA_FC2F_Fire_Suppression_Agent: 8 Vector__XXX
 SG_ Fire_Suppression_Agent_Status_Ra : 0|64@1+ (1,0) [0|18446744073709551615] "" Vector__XXX

BO_ 2147548208 VDMA_FC30_SCR_Operator_Inducemen: 8 Vector__XXX
 SG_ SCR_Operator_Inducement_Informat : 0|64@1+ (1,0) [0|18446744073709551615] "" Vector__XXX

BO_ 2147548209 VDMA_FC31_Aftertreatment_System_: 8 Vector__XXX
 SG_ Aftertreatment_System_Informatio : 0|64@1+ (1,0) [0|18446744073709551615] "" Vector__XXX

BO_ 2147548210 VDMA_FC32_Aftertreatment_1_Parti: 8 Vector__XXX
 SG_ Aftertreatment_1_Particulate_Sen : 0|64@1+ (1,0) [0|18446744073709551615] "" Vector__XXX

BO_ 2147548211 VDMA_FC33_Engine_Fuel_Injector_M: 8 Vector__XXX
 SG_ Engine_Fuel_Injector_Metering_Ra : 0|64@1+ (1,0) [0|18446744073709551615] "" Vector__XXX

BO_ 2147548212 VDMA_FC34_Engine_Fuel_Injector_M: 8 Vector__XXX
 SG_ Engine_Fuel_Injector_Metering_Ra : 0|64@1+ (1,0) [0|18446744073709551615] "" Vector__XXX

BO_ 2147548213 VDMA_FC35_Aftertreatment_2_Diese: 8 Vector__XXX
 SG_ Aftertreatment_2_Diesel_Exhaust_ : 0|64@1+ (1,0) [0|18446744073709551615] "" Vector__XXX

BO_ 2147548214 VDMA_FC36_Gaseous_Fuel_Supply_Va: 8 Vector__XXX
 SG_ Gaseous_Fuel_Supply_Valve_Inform : 0|64@1+ (1,0) [0|18446744073709551615] "" Vector__XXX

BO_ 2147548215 VDMA_FC37_Engine_Oil_Mist_Detect: 8 Vector__XXX
 SG_ Engine_Oil_Mist_Detection_Inform : 0|64@1+ (1,0) [0|18446744073709551615] "" Vector__XXX

BO_ 2147548216 VDMA_FC38_Engine_Oil_Mist_Detect: 8 Vector__XXX
 SG_ Engine_Oil_Mist_Detection_Inform : 0|64@1+ (1,0) [0|18446744073709551615] "" Vector__XXX

BO_ 2147548217 VDMA_FC39_Gaseous_Fuel_Supply_Pr: 8 Vector__XXX
 SG_ Gaseous_Fuel_Supply_Pressure_2_R : 0|64@1+ (1,0) [0|18446744073709551615] "" Vector__XXX

BO_ 2147548218 VDMA_FC3A_Gaseous_Fuel_Supply_Pr: 8 Vector__XXX
 SG_ Gaseous_Fuel_Supply_Pressure_1_R : 0|64@1+ (1,0) [0|18446744073709551615] "" Vector__XXX

BO_ 2147548219 VDMA_FC3B_Engine_End_Bearing_Tem: 8 Vector__XXX
 SG_ Engine_End_Bearing_Temperature_3 : 0|64@1+ (1,0) [0|18446744073709551615] "" Vector__XXX

BO_ 2147548220 VDMA_FC3C_Engine_End_Bearing_Tem: 8 Vector__XXX
 SG_ Engine_End_Bearing_Temperature_2 : 0|64@1+ (1,0) [0|18446744073709551615] "" Vector__XXX

BO_ 2147548221 VDMA_FC3D_Engine_End_Bearing_Tem: 8 Vector__XXX
 SG_ Engine_End_Bearing_Temperature_1 : 0|64@1+ (1,0) [0|18446744073709551615] "" Vector__XXX

BO_ 2147548222 VDMA_FC3E_Heat_Exchanger_Debris_: 8 Vector__XXX
 SG_ Heat_Exchanger_Debris_Purge_Info : 0|64@1+ (1,0) [0|18446744073709551615] "" Vector__XXX

BO_ 2147548223 VDMA_FC3F_Engine_Turbocharger_Co: 8 Vector__XXX
 SG_ Engine_Turbocharger_Control_2_Ra : 0|64@1+ (1,0) [0|18446744073709551615] "" Vector__XXX

BO_ 2147548224 VDMA_FC40_Engine_Hydraulic_Fuel_: 8 Vector__XXX
 SG_ Engine_Hydraulic_Fuel_2_Pump_Sta : 0|64@1+ (1,0) [0|18446744073709551615] "" Vector__XXX

BO_ 2147548225 VDMA_FC41_Alternate_Fuel_4: 8 Vector__XXX
 SG_ Alternate_Fuel_4_RawPayload : 0|64@1+ (1,0) [0|18446744073709551615] "" Vector__XXX

BO_ 2147548226 VDMA_FC42_Tire_Condition_Message: 8 Vector__XXX
 SG_ Tire_Condition_Message_2_RawPayl : 0|64@1+ (1,0) [0|18446744073709551615] "" Vector__XXX

BO_ 2147548227 VDMA_FC43_Tire_Configuration_Sta: 8 Vector__XXX
 SG_ Tire_Configuration_Status_Inform : 0|64@1+ (1,0) [0|18446744073709551615] "" Vector__XXX

BO_ 2147548228 VDMA_FC44_High_Voltage_Energy_St: 8 Vector__XXX
 SG_ High_Voltage_Energy_Storage_Syst : 0|64@1+ (1,0) [0|18446744073709551615] "" Vector__XXX

BO_ 2147548229 VDMA_FC45_Tire_Wireless_Signal_S: 8 Vector__XXX
 SG_ Tire_Wireless_Signal_Strength_In : 0|64@1+ (1,0) [0|18446744073709551615] "" Vector__XXX

BO_ 2147548230 VDMA_FC46_Tire_Sensor_Identifica: 8 Vector__XXX
 SG_ Tire_Sensor_Identification_Statu : 0|64@1+ (1,0) [0|18446744073709551615] "" Vector__XXX

BO_ 2147548231 VDMA_FC47_Monitored_Tire_Informa: 8 Vector__XXX
 SG_ Monitored_Tire_Information_RawPa : 0|64@1+ (1,0) [0|18446744073709551615] "" Vector__XXX

BO_ 2147548232 VDMA_FC48_Aftertreatment_2_Histo: 8 Vector__XXX
 SG_ Aftertreatment_2_Historical_Info : 0|64@1+ (1,0) [0|18446744073709551615] "" Vector__XXX

BO_ 2147548233 VDMA_FC49_Aftertreatment_1_Histo: 8 Vector__XXX
 SG_ Aftertreatment_1_Historical_Info : 0|64@1+ (1,0) [0|18446744073709551615] "" Vector__XXX

BO_ 2147548234 VDMA_FC4A_SCR_System_Cleaning: 8 Vector__XXX
 SG_ SCR_System_Cleaning_RawPayload : 0|64@1+ (1,0) [0|18446744073709551615] "" Vector__XXX

BO_ 2147548235 VDMA_FC4B_Electronic_Engine_Cont: 8 Vector__XXX
 SG_ Electronic_Engine_Controller_17_ : 0|64@1+ (1,0) [0|18446744073709551615] "" Vector__XXX

BO_ 2147548236 VDMA_FC4C_SCR_Operator_Inducemen: 8 Vector__XXX
 SG_ SCR_Operator_Inducement_Informat : 0|64@1+ (1,0) [0|18446744073709551615] "" Vector__XXX

BO_ 2147548237 VDMA_FC4D_Aftertreatment_2_SCR_D: 8 Vector__XXX
 SG_ Aftertreatment_2_SCR_Dosing_Syst : 0|64@1+ (1,0) [0|18446744073709551615] "" Vector__XXX

BO_ 2147548238 VDMA_FC4E_Aftertreatment_1_SCR_D: 8 Vector__XXX
 SG_ Aftertreatment_1_SCR_Dosing_Syst : 0|64@1+ (1,0) [0|18446744073709551615] "" Vector__XXX

BO_ 2147548239 VDMA_FC4F_Payload_Weight_Sensor_: 8 Vector__XXX
 SG_ Payload_Weight_Sensor_Informatio : 0|64@1+ (1,0) [0|18446744073709551615] "" Vector__XXX

BO_ 2147548240 VDMA_FC50_Payload_System_Status: 8 Vector__XXX
 SG_ Payload_System_Status_RawPayload : 0|64@1+ (1,0) [0|18446744073709551615] "" Vector__XXX

BO_ 2147548241 VDMA_FC51_Air_Suspension_Control: 8 Vector__XXX
 SG_ Air_Suspension_Control_7_RawPayl : 0|64@1+ (1,0) [0|18446744073709551615] "" Vector__XXX

BO_ 2147548242 VDMA_FC52_Bin_Weight_and_Lift_Co: 8 Vector__XXX
 SG_ Bin_Weight_and_Lift_Count_RawPay : 0|64@1+ (1,0) [0|18446744073709551615] "" Vector__XXX

BO_ 2147548243 VDMA_FC53_Engine_Gaseous_Leakage: 8 Vector__XXX
 SG_ Engine_Gaseous_Leakage_Informati : 0|64@1+ (1,0) [0|18446744073709551615] "" Vector__XXX

BO_ 2147548244 VDMA_FC54_Driving_and_Rest_Times: 8 Vector__XXX
 SG_ Driving_and_Rest_Times_Driver_2_ : 0|64@1+ (1,0) [0|18446744073709551615] "" Vector__XXX

BO_ 2147548245 VDMA_FC55_Driving_and_Rest_Times: 8 Vector__XXX
 SG_ Driving_and_Rest_Times_Driver_1_ : 0|64@1+ (1,0) [0|18446744073709551615] "" Vector__XXX

BO_ 2147548246 VDMA_FC56_SCR_Operator_Inducemen: 8 Vector__XXX
 SG_ SCR_Operator_Inducement_Informat : 0|64@1+ (1,0) [0|18446744073709551615] "" Vector__XXX

BO_ 2147548247 VDMA_FC57_SCR_Operator_Inducemen: 8 Vector__XXX
 SG_ SCR_Operator_Inducement_Informat : 0|64@1+ (1,0) [0|18446744073709551615] "" Vector__XXX

BO_ 2147548248 VDMA_FC58_Turbocharger_Informati: 8 Vector__XXX
 SG_ Turbocharger_Information_7_RawPa : 0|64@1+ (1,0) [0|18446744073709551615] "" Vector__XXX

BO_ 2147548249 VDMA_FC59_Engine_Load_Sharing_In: 8 Vector__XXX
 SG_ Engine_Load_Sharing_Information_ : 0|64@1+ (1,0) [0|18446744073709551615] "" Vector__XXX

BO_ 2147548250 VDMA_FC5A_Synchronized_Service_D: 8 Vector__XXX
 SG_ Synchronized_Service_Distance_In : 0|64@1+ (1,0) [0|18446744073709551615] "" Vector__XXX

BO_ 2147548251 VDMA_FC5B_Synchronized_Service_D: 8 Vector__XXX
 SG_ Synchronized_Service_Delay_Opera : 0|64@1+ (1,0) [0|18446744073709551615] "" Vector__XXX

BO_ 2147548252 VDMA_FC5C_Synchronized_Service_D: 8 Vector__XXX
 SG_ Synchronized_Service_Delay_Calen : 0|64@1+ (1,0) [0|18446744073709551615] "" Vector__XXX

BO_ 2147548253 VDMA_FC5D_High_Voltage_Energy_St: 8 Vector__XXX
 SG_ High_Voltage_Energy_Storage_Syst : 0|64@1+ (1,0) [0|18446744073709551615] "" Vector__XXX

BO_ 2147548254 VDMA_FC5E_High_Voltage_Energy_St: 8 Vector__XXX
 SG_ High_Voltage_Energy_Storage_Syst : 0|64@1+ (1,0) [0|18446744073709551615] "" Vector__XXX

BO_ 2147548255 VDMA_FC5F_Encoder_Position: 8 Vector__XXX
 SG_ Encoder_Position_RawPayload : 0|64@1+ (1,0) [0|18446744073709551615] "" Vector__XXX

BO_ 2147548256 VDMA_FC60_Encoder_High_Resolutio: 8 Vector__XXX
 SG_ Encoder_High_Resolution_Position : 0|64@1+ (1,0) [0|18446744073709551615] "" Vector__XXX

BO_ 2147548257 VDMA_FC61_Encoder_Speed: 8 Vector__XXX
 SG_ Encoder_Speed_RawPayload : 0|64@1+ (1,0) [0|18446744073709551615] "" Vector__XXX

BO_ 2147548258 VDMA_FC62_Encoder_Acceleration: 8 Vector__XXX
 SG_ Encoder_Acceleration_RawPayload : 0|64@1+ (1,0) [0|18446744073709551615] "" Vector__XXX

BO_ 2147548259 VDMA_FC63_Encoder_Position_with_: 8 Vector__XXX
 SG_ Encoder_Position_with_Speed_and_ : 0|64@1+ (1,0) [0|18446744073709551615] "" Vector__XXX

BO_ 2147548260 VDMA_FC64_Inclinometer_Slope_Lon: 8 Vector__XXX
 SG_ Inclinometer_Slope_Longitudinal_ : 0|64@1+ (1,0) [0|18446744073709551615] "" Vector__XXX

BO_ 2147548261 VDMA_FC65_Inclinometer_Slope_Lon: 8 Vector__XXX
 SG_ Inclinometer_Slope_Longitudinal_ : 0|64@1+ (1,0) [0|18446744073709551615] "" Vector__XXX

BO_ 2147548262 VDMA_FC66_Inclinometer_Slope_Lat: 8 Vector__XXX
 SG_ Inclinometer_Slope_Lateral_16_bi : 0|64@1+ (1,0) [0|18446744073709551615] "" Vector__XXX

BO_ 2147548263 VDMA_FC67_Inclinometer_Slope_Lat: 8 Vector__XXX
 SG_ Inclinometer_Slope_Lateral_32_bi : 0|64@1+ (1,0) [0|18446744073709551615] "" Vector__XXX

BO_ 2147548264 VDMA_FC68_CANopen_Emergency_Mess: 8 Vector__XXX
 SG_ CANopen_Emergency_Message_RawPay : 0|64@1+ (1,0) [0|18446744073709551615] "" Vector__XXX

BO_ 2147548265 VDMA_FC69_EV_Operator_Indicators: 8 Vector__XXX
 SG_ EV_Operator_Indicators_1_RawPayl : 0|64@1+ (1,0) [0|18446744073709551615] "" Vector__XXX

BO_ 2147548266 VDMA_FC6A_System_Identification: 8 Vector__XXX
 SG_ System_Identification_RawPayload : 0|64@1+ (1,0) [0|18446744073709551615] "" Vector__XXX

BO_ 2147548267 VDMA_FC6B_Engine_Maximum_Net_Tor: 8 Vector__XXX
 SG_ Engine_Maximum_Net_Torque_Map_ob : 0|64@1+ (1,0) [0|18446744073709551615] "" Vector__XXX

BO_ 2147548268 VDMA_FC6C_Alarm: 8 Vector__XXX
 SG_ Alarm_RawPayload : 0|64@1+ (1,0) [0|18446744073709551615] "" Vector__XXX

BO_ 2147548269 VDMA_FC6D_Acoustic_Warning_Reque: 8 Vector__XXX
 SG_ Acoustic_Warning_Request_RawPayl : 0|64@1+ (1,0) [0|18446744073709551615] "" Vector__XXX

BO_ 2147548270 VDMA_FC6E_Acoustic_Warning_State: 8 Vector__XXX
 SG_ Acoustic_Warning_State_RawPayloa : 0|64@1+ (1,0) [0|18446744073709551615] "" Vector__XXX

BO_ 2147548271 VDMA_FC6F_Vehicle_Load: 8 Vector__XXX
 SG_ Vehicle_Load_RawPayload : 0|64@1+ (1,0) [0|18446744073709551615] "" Vector__XXX

BO_ 2147548272 VDMA_FC70_Body_Application_Unit_: 8 Vector__XXX
 SG_ Body_Application_Unit_1_RawPaylo : 0|64@1+ (1,0) [0|18446744073709551615] "" Vector__XXX

BO_ 2147548273 VDMA_FC71_Body_Application_Unit_: 8 Vector__XXX
 SG_ Body_Application_Unit_2_RawPaylo : 0|64@1+ (1,0) [0|18446744073709551615] "" Vector__XXX

BO_ 2147548274 VDMA_FC72_Body_Application_Unit_: 8 Vector__XXX
 SG_ Body_Application_Unit_3_RawPaylo : 0|64@1+ (1,0) [0|18446744073709551615] "" Vector__XXX

BO_ 2147548275 VDMA_FC73_Body_Application_Unit_: 8 Vector__XXX
 SG_ Body_Application_Unit_4_RawPaylo : 0|64@1+ (1,0) [0|18446744073709551615] "" Vector__XXX

BO_ 2147548276 VDMA_FC74_Body_Application_Unit_: 8 Vector__XXX
 SG_ Body_Application_Unit_5_RawPaylo : 0|64@1+ (1,0) [0|18446744073709551615] "" Vector__XXX

BO_ 2147548277 VDMA_FC75_Body_Application_Unit_: 8 Vector__XXX
 SG_ Body_Application_Unit_6_RawPaylo : 0|64@1+ (1,0) [0|18446744073709551615] "" Vector__XXX

BO_ 2147548278 VDMA_FC76_Body_Application_Unit_: 8 Vector__XXX
 SG_ Body_Application_Unit_7_RawPaylo : 0|64@1+ (1,0) [0|18446744073709551615] "" Vector__XXX

BO_ 2147548279 VDMA_FC77_Body_Application_Unit_: 8 Vector__XXX
 SG_ Body_Application_Unit_8_RawPaylo : 0|64@1+ (1,0) [0|18446744073709551615] "" Vector__XXX

BO_ 2147548280 VDMA_FC78_Electronic_Control_Uni: 8 Vector__XXX
 SG_ Electronic_Control_Unit_RawPaylo : 0|64@1+ (1,0) [0|18446744073709551615] "" Vector__XXX

BO_ 2147548281 VDMA_FC79_ECU_Power_Supply: 8 Vector__XXX
 SG_ ECU_Power_Supply_RawPayload : 0|64@1+ (1,0) [0|18446744073709551615] "" Vector__XXX

BO_ 2147548282 VDMA_FC7A_ECU_Temperature: 8 Vector__XXX
 SG_ ECU_Temperature_RawPayload : 0|64@1+ (1,0) [0|18446744073709551615] "" Vector__XXX

BO_ 2147548283 VDMA_FC7B_Error: 8 Vector__XXX
 SG_ Error_RawPayload : 0|64@1+ (1,0) [0|18446744073709551615] "" Vector__XXX

BO_ 2147548284 VDMA_FC7C_Heating_And_Refrigerat: 8 Vector__XXX
 SG_ Heating_And_Refrigerating_Unit_1 : 0|64@1+ (1,0) [0|18446744073709551615] "" Vector__XXX

BO_ 2147548285 VDMA_FC7D_Heating_And_Refrigerat: 8 Vector__XXX
 SG_ Heating_And_Refrigerating_Unit_2 : 0|64@1+ (1,0) [0|18446744073709551615] "" Vector__XXX

BO_ 2147548286 VDMA_FC7E_Heating_And_Refrigerat: 8 Vector__XXX
 SG_ Heating_And_Refrigerating_Unit_3 : 0|64@1+ (1,0) [0|18446744073709551615] "" Vector__XXX

BO_ 2147548287 VDMA_FC7F_Heating_And_Refrigerat: 8 Vector__XXX
 SG_ Heating_And_Refrigerating_Unit_4 : 0|64@1+ (1,0) [0|18446744073709551615] "" Vector__XXX

BO_ 2147548288 VDMA_FC80_HRU_Temperature_Setpoi: 8 Vector__XXX
 SG_ HRU_Temperature_Setpoint_RawPayl : 0|64@1+ (1,0) [0|18446744073709551615] "" Vector__XXX

BO_ 2147548289 VDMA_FC81_Lifting_Unit_1: 8 Vector__XXX
 SG_ Lifting_Unit_1_RawPayload : 0|64@1+ (1,0) [0|18446744073709551615] "" Vector__XXX

BO_ 2147548290 VDMA_FC82_Tail_Lift_Unit_1: 8 Vector__XXX
 SG_ Tail_Lift_Unit_1_RawPayload : 0|64@1+ (1,0) [0|18446744073709551615] "" Vector__XXX

BO_ 2147548291 VDMA_FC83_Vehicle_Status: 8 Vector__XXX
 SG_ Vehicle_Status_RawPayload : 0|64@1+ (1,0) [0|18446744073709551615] "" Vector__XXX

BO_ 2147548292 VDMA_FC84_Windshield_Wiper_Reque: 8 Vector__XXX
 SG_ Windshield_Wiper_Request_RawPayl : 0|64@1+ (1,0) [0|18446744073709551615] "" Vector__XXX

BO_ 2147548293 VDMA_FC85_Fuel_Cell_Auxiliary_He: 8 Vector__XXX
 SG_ Fuel_Cell_Auxiliary_Heater_Contr : 0|64@1+ (1,0) [0|18446744073709551615] "" Vector__XXX

BO_ 2147548294 VDMA_FC86_Fuel_Cell_Auxiliary_He: 8 Vector__XXX
 SG_ Fuel_Cell_Auxiliary_Heater_Infor : 0|64@1+ (1,0) [0|18446744073709551615] "" Vector__XXX

BO_ 2147548295 VDMA_FC87_Fuel_Cell_Coolant_Pump: 8 Vector__XXX
 SG_ Fuel_Cell_Coolant_Pump_1_Command : 0|64@1+ (1,0) [0|18446744073709551615] "" Vector__XXX

BO_ 2147548296 VDMA_FC88_Fuel_Cell_Coolant_Pump: 8 Vector__XXX
 SG_ Fuel_Cell_Coolant_Pump_2_Command : 0|64@1+ (1,0) [0|18446744073709551615] "" Vector__XXX

BO_ 2147548297 VDMA_FC89_Fuel_Cell_Coolant_Pump: 8 Vector__XXX
 SG_ Fuel_Cell_Coolant_Pump_1_Status_ : 0|64@1+ (1,0) [0|18446744073709551615] "" Vector__XXX

BO_ 2147548298 VDMA_FC8A_Fuel_Cell_Coolant_Pump: 8 Vector__XXX
 SG_ Fuel_Cell_Coolant_Pump_2_Status_ : 0|64@1+ (1,0) [0|18446744073709551615] "" Vector__XXX

BO_ 2147548299 VDMA_FC8B_Aftertreatment_1_Parti: 8 Vector__XXX
 SG_ Aftertreatment_1_Particulate_Sen : 0|64@1+ (1,0) [0|18446744073709551615] "" Vector__XXX

BO_ 2147548300 VDMA_FC8C_Aftertreatment_1_Parti: 8 Vector__XXX
 SG_ Aftertreatment_1_Particulate_Sen : 0|64@1+ (1,0) [0|18446744073709551615] "" Vector__XXX

BO_ 2147548303 VDMA_FC8F_Alternate_Fuel_3: 8 Vector__XXX
 SG_ Alternate_Fuel_3_RawPayload : 0|64@1+ (1,0) [0|18446744073709551615] "" Vector__XXX

BO_ 2147548304 VDMA_FC90_Engine_Fuel_Injector_M: 8 Vector__XXX
 SG_ Engine_Fuel_Injector_Metering_Ra : 0|64@1+ (1,0) [0|18446744073709551615] "" Vector__XXX

BO_ 2147548305 VDMA_FC91_Engine_Exhaust_NOx: 8 Vector__XXX
 SG_ Engine_Exhaust_NOx_RawPayload : 0|64@1+ (1,0) [0|18446744073709551615] "" Vector__XXX

BO_ 2147548306 VDMA_FC92_Air_Fuel_Ratio_1: 8 Vector__XXX
 SG_ Air_Fuel_Ratio_1_RawPayload : 0|64@1+ (1,0) [0|18446744073709551615] "" Vector__XXX

BO_ 2147548307 VDMA_FC93_Gaseous_Fuel_Pressure_: 8 Vector__XXX
 SG_ Gaseous_Fuel_Pressure_2_RawPaylo : 0|64@1+ (1,0) [0|18446744073709551615] "" Vector__XXX

BO_ 2147548308 VDMA_FC94_Aftertreatment_System_: 8 Vector__XXX
 SG_ Aftertreatment_System_Abuse_Info : 0|64@1+ (1,0) [0|18446744073709551615] "" Vector__XXX

BO_ 2147548309 VDMA_FC95_Engine_Cylinder_Pressu: 8 Vector__XXX
 SG_ Engine_Cylinder_Pressure_Monitor : 0|64@1+ (1,0) [0|18446744073709551615] "" Vector__XXX

BO_ 2147548310 VDMA_FC96_Engine_Information_2: 8 Vector__XXX
 SG_ Engine_Information_2_RawPayload : 0|64@1+ (1,0) [0|18446744073709551615] "" Vector__XXX

BO_ 2147548311 VDMA_FC97_Electronic_Steering_Co: 8 Vector__XXX
 SG_ Electronic_Steering_Control_2_Ra : 0|64@1+ (1,0) [0|18446744073709551615] "" Vector__XXX

BO_ 2147548312 VDMA_FC98_Vehicle_Speed_Limiter: 8 Vector__XXX
 SG_ Vehicle_Speed_Limiter_RawPayload : 0|64@1+ (1,0) [0|18446744073709551615] "" Vector__XXX

BO_ 2147548313 VDMA_FC99_Assembly_Unit_Identifi: 8 Vector__XXX
 SG_ Assembly_Unit_Identification_Raw : 0|64@1+ (1,0) [0|18446744073709551615] "" Vector__XXX

BO_ 2147548314 VDMA_FC9A_Joystick_3_Lamp_Status: 8 Vector__XXX
 SG_ Joystick_3_Lamp_Status_RawPayloa : 0|64@1+ (1,0) [0|18446744073709551615] "" Vector__XXX

BO_ 2147548315 VDMA_FC9B_Joystick_2_Lamp_Status: 8 Vector__XXX
 SG_ Joystick_2_Lamp_Status_RawPayloa : 0|64@1+ (1,0) [0|18446744073709551615] "" Vector__XXX

BO_ 2147548316 VDMA_FC9C_Joystick_1_Lamp_Status: 8 Vector__XXX
 SG_ Joystick_1_Lamp_Status_RawPayloa : 0|64@1+ (1,0) [0|18446744073709551615] "" Vector__XXX

BO_ 2147548317 VDMA_FC9D_Engine_Timing_Actuator: 8 Vector__XXX
 SG_ Engine_Timing_Actuator_Position_ : 0|64@1+ (1,0) [0|18446744073709551615] "" Vector__XXX

BO_ 2147548318 VDMA_FC9E_Engine_Timing_Actuator: 8 Vector__XXX
 SG_ Engine_Timing_Actuator_Position_ : 0|64@1+ (1,0) [0|18446744073709551615] "" Vector__XXX

BO_ 2147548319 VDMA_FC9F_Dash_Display_2: 8 Vector__XXX
 SG_ Dash_Display_2_RawPayload : 0|64@1+ (1,0) [0|18446744073709551615] "" Vector__XXX

BO_ 2147548320 VDMA_FCA0_Multi_fuel_Engine_Hour: 8 Vector__XXX
 SG_ Multi_fuel_Engine_Hours_RawPaylo : 0|64@1+ (1,0) [0|18446744073709551615] "" Vector__XXX

BO_ 2147548321 VDMA_FCA1_Engine_Spark_Misfire_R: 8 Vector__XXX
 SG_ Engine_Spark_Misfire_Rate_3_RawP : 0|64@1+ (1,0) [0|18446744073709551615] "" Vector__XXX

BO_ 2147548322 VDMA_FCA2_Engine_Spark_Misfire_R: 8 Vector__XXX
 SG_ Engine_Spark_Misfire_Rate_2_RawP : 0|64@1+ (1,0) [0|18446744073709551615] "" Vector__XXX

BO_ 2147548323 VDMA_FCA3_Engine_Spark_Misfire_R: 8 Vector__XXX
 SG_ Engine_Spark_Misfire_Rate_1_RawP : 0|64@1+ (1,0) [0|18446744073709551615] "" Vector__XXX

BO_ 2147548324 VDMA_FCA4_Engine_Spark_Maximum_V: 8 Vector__XXX
 SG_ Engine_Spark_Maximum_Voltage_6_R : 0|64@1+ (1,0) [0|18446744073709551615] "" Vector__XXX

BO_ 2147548325 VDMA_FCA5_Engine_Spark_Maximum_V: 8 Vector__XXX
 SG_ Engine_Spark_Maximum_Voltage_5_R : 0|64@1+ (1,0) [0|18446744073709551615] "" Vector__XXX

BO_ 2147548326 VDMA_FCA6_Engine_Spark_Maximum_V: 8 Vector__XXX
 SG_ Engine_Spark_Maximum_Voltage_4_R : 0|64@1+ (1,0) [0|18446744073709551615] "" Vector__XXX

BO_ 2147548327 VDMA_FCA7_Engine_Spark_Maximum_V: 8 Vector__XXX
 SG_ Engine_Spark_Maximum_Voltage_3_R : 0|64@1+ (1,0) [0|18446744073709551615] "" Vector__XXX

BO_ 2147548328 VDMA_FCA8_Engine_Spark_Maximum_V: 8 Vector__XXX
 SG_ Engine_Spark_Maximum_Voltage_2_R : 0|64@1+ (1,0) [0|18446744073709551615] "" Vector__XXX

BO_ 2147548329 VDMA_FCA9_Engine_Spark_Maximum_V: 8 Vector__XXX
 SG_ Engine_Spark_Maximum_Voltage_1_R : 0|64@1+ (1,0) [0|18446744073709551615] "" Vector__XXX

BO_ 2147548330 VDMA_FCAA_Engine_Spark_Minimum_V: 8 Vector__XXX
 SG_ Engine_Spark_Minimum_Voltage_6_R : 0|64@1+ (1,0) [0|18446744073709551615] "" Vector__XXX

BO_ 2147548331 VDMA_FCAB_Engine_Spark_Minimum_V: 8 Vector__XXX
 SG_ Engine_Spark_Minimum_Voltage_5_R : 0|64@1+ (1,0) [0|18446744073709551615] "" Vector__XXX

BO_ 2147548332 VDMA_FCAC_Engine_Spark_Minimum_V: 8 Vector__XXX
 SG_ Engine_Spark_Minimum_Voltage_4_R : 0|64@1+ (1,0) [0|18446744073709551615] "" Vector__XXX

BO_ 2147548333 VDMA_FCAD_Engine_Spark_Minimum_V: 8 Vector__XXX
 SG_ Engine_Spark_Minimum_Voltage_3_R : 0|64@1+ (1,0) [0|18446744073709551615] "" Vector__XXX

BO_ 2147548334 VDMA_FCAE_Engine_Spark_Minimum_V: 8 Vector__XXX
 SG_ Engine_Spark_Minimum_Voltage_2_R : 0|64@1+ (1,0) [0|18446744073709551615] "" Vector__XXX

BO_ 2147548335 VDMA_FCAF_Engine_Spark_Minimum_V: 8 Vector__XXX
 SG_ Engine_Spark_Minimum_Voltage_1_R : 0|64@1+ (1,0) [0|18446744073709551615] "" Vector__XXX

BO_ 2147548336 VDMA_FCB0_Engine_Ignition_Contro: 8 Vector__XXX
 SG_ Engine_Ignition_Controller_Maint : 0|64@1+ (1,0) [0|18446744073709551615] "" Vector__XXX

BO_ 2147548337 VDMA_FCB1_Engine_Ignition_Contro: 8 Vector__XXX
 SG_ Engine_Ignition_Control_Module_S : 0|64@1+ (1,0) [0|18446744073709551615] "" Vector__XXX

BO_ 2147548339 VDMA_FCB3_Fused_Power_Output_Cur: 8 Vector__XXX
 SG_ Fused_Power_Output_Current_RawPa : 0|64@1+ (1,0) [0|18446744073709551615] "" Vector__XXX

BO_ 2147548340 VDMA_FCB4_Switched_Power_Output_: 8 Vector__XXX
 SG_ Switched_Power_Output_Status_Raw : 0|64@1+ (1,0) [0|18446744073709551615] "" Vector__XXX

BO_ 2147548341 VDMA_FCB5_Fused_Power_Output_Sta: 8 Vector__XXX
 SG_ Fused_Power_Output_Status_RawPay : 0|64@1+ (1,0) [0|18446744073709551615] "" Vector__XXX

BO_ 2147548342 VDMA_FCB6_Vehicle_Electrical_Pow: 8 Vector__XXX
 SG_ Vehicle_Electrical_Power_5_RawPa : 0|64@1+ (1,0) [0|18446744073709551615] "" Vector__XXX

BO_ 2147548343 VDMA_FCB7_Hybrid_or_EV_System_St: 8 Vector__XXX
 SG_ Hybrid_or_EV_System_Status_2_Raw : 0|64@1+ (1,0) [0|18446744073709551615] "" Vector__XXX

BO_ 2147548344 VDMA_FCB8_Aftertreatment_2_Servi: 8 Vector__XXX
 SG_ Aftertreatment_2_Service_2_RawPa : 0|64@1+ (1,0) [0|18446744073709551615] "" Vector__XXX

BO_ 2147548345 VDMA_FCB9_Aftertreatment_1_Servi: 8 Vector__XXX
 SG_ Aftertreatment_1_Service_2_RawPa : 0|64@1+ (1,0) [0|18446744073709551615] "" Vector__XXX

BO_ 2147548346 VDMA_FCBA_Aftertreatment_2_SCR_E: 8 Vector__XXX
 SG_ Aftertreatment_2_SCR_Electronic_ : 0|64@1+ (1,0) [0|18446744073709551615] "" Vector__XXX

BO_ 2147548347 VDMA_FCBB_Aftertreatment_1_SCR_E: 8 Vector__XXX
 SG_ Aftertreatment_1_SCR_Electronic_ : 0|64@1+ (1,0) [0|18446744073709551615] "" Vector__XXX

BO_ 2147548348 VDMA_FCBC_Aftertreatment_2_SCR_S: 8 Vector__XXX
 SG_ Aftertreatment_2_SCR_Service_Inf : 0|64@1+ (1,0) [0|18446744073709551615] "" Vector__XXX

BO_ 2147548349 VDMA_FCBD_Aftertreatment_1_SCR_S: 8 Vector__XXX
 SG_ Aftertreatment_1_SCR_Service_Inf : 0|64@1+ (1,0) [0|18446744073709551615] "" Vector__XXX

BO_ 2147548350 VDMA_FCBE_Electronic_Transmissio: 8 Vector__XXX
 SG_ Electronic_Transmission_Controll : 0|64@1+ (1,0) [0|18446744073709551615] "" Vector__XXX

BO_ 2147548351 VDMA_FCBF_Electronic_Transmissio: 8 Vector__XXX
 SG_ Electronic_Transmission_Controll : 0|64@1+ (1,0) [0|18446744073709551615] "" Vector__XXX

BO_ 2147548352 VDMA_FCC0_Electronic_Transmissio: 8 Vector__XXX
 SG_ Electronic_Transmission_Controll : 0|64@1+ (1,0) [0|18446744073709551615] "" Vector__XXX

BO_ 2147548353 VDMA_FCC1_Transmission_Fluids_3: 8 Vector__XXX
 SG_ Transmission_Fluids_3_RawPayload : 0|64@1+ (1,0) [0|18446744073709551615] "" Vector__XXX

BO_ 2147548354 VDMA_FCC2_Hybrid_or_EV_System_St: 8 Vector__XXX
 SG_ Hybrid_or_EV_System_Status_1_Raw : 0|64@1+ (1,0) [0|18446744073709551615] "" Vector__XXX

BO_ 2147548355 VDMA_FCC3_Fuel_Information_4_Gas: 8 Vector__XXX
 SG_ Fuel_Information_4_Gaseous_RawPa : 0|64@1+ (1,0) [0|18446744073709551615] "" Vector__XXX

BO_ 2147548356 VDMA_FCC4_Aftertreatment_2_SCR_E: 8 Vector__XXX
 SG_ Aftertreatment_2_SCR_Exhaust_Gas : 0|64@1+ (1,0) [0|18446744073709551615] "" Vector__XXX

BO_ 2147548357 VDMA_FCC5_Aftertreatment_1_SCR_E: 8 Vector__XXX
 SG_ Aftertreatment_1_SCR_Exhaust_Gas : 0|64@1+ (1,0) [0|18446744073709551615] "" Vector__XXX

BO_ 2147548358 VDMA_FCC6_OBD_Information: 8 Vector__XXX
 SG_ OBD_Information_RawPayload : 0|64@1+ (1,0) [0|18446744073709551615] "" Vector__XXX

BO_ 2147548359 VDMA_FCC7_Model_Year_and_Certifi: 8 Vector__XXX
 SG_ Model_Year_and_Certification_Eng : 0|64@1+ (1,0) [0|18446744073709551615] "" Vector__XXX

BO_ 2147548360 VDMA_FCC8_Electronic_Engine_Cont: 8 Vector__XXX
 SG_ Electronic_Engine_Controller_13_ : 0|64@1+ (1,0) [0|18446744073709551615] "" Vector__XXX

BO_ 2147548361 VDMA_FCC9_Engine_Fuel_Throttle_V: 8 Vector__XXX
 SG_ Engine_Fuel_Throttle_Valve_Infor : 0|64@1+ (1,0) [0|18446744073709551615] "" Vector__XXX

BO_ 2147548362 VDMA_FCCA_Engine_Exhaust_Gas_Rec: 8 Vector__XXX
 SG_ Engine_Exhaust_Gas_Recirculation : 0|64@1+ (1,0) [0|18446744073709551615] "" Vector__XXX

BO_ 2147548363 VDMA_FCCB_Engine_Exhaust_Gas_Rec: 8 Vector__XXX
 SG_ Engine_Exhaust_Gas_Recirculation : 0|64@1+ (1,0) [0|18446744073709551615] "" Vector__XXX

BO_ 2147548364 VDMA_FCCC_Electronic_Engine_Cont: 8 Vector__XXX
 SG_ Electronic_Engine_Controller_12_ : 0|64@1+ (1,0) [0|18446744073709551615] "" Vector__XXX

BO_ 2147548365 VDMA_FCCD_Drive_Strategy_Status: 8 Vector__XXX
 SG_ Drive_Strategy_Status_RawPayload : 0|64@1+ (1,0) [0|18446744073709551615] "" Vector__XXX

BO_ 2147548366 VDMA_FCCE_Drive_Strategy_command: 8 Vector__XXX
 SG_ Drive_Strategy_command_RawPayloa : 0|64@1+ (1,0) [0|18446744073709551615] "" Vector__XXX

BO_ 2147548367 VDMA_FCCF_NOx_Sensor_Self_Diagno: 8 Vector__XXX
 SG_ NOx_Sensor_Self_Diagnosis_Reques : 0|64@1+ (1,0) [0|18446744073709551615] "" Vector__XXX

BO_ 2147548368 VDMA_FCD0_Engine_Particulate_Sen: 8 Vector__XXX
 SG_ Engine_Particulate_Sensor_Inform : 0|64@1+ (1,0) [0|18446744073709551615] "" Vector__XXX

BO_ 2147548369 VDMA_FCD1_Active_Service_Only_DT: 8 Vector__XXX
 SG_ Active_Service_Only_DTCs_RawPayl : 0|64@1+ (1,0) [0|18446744073709551615] "" Vector__XXX

BO_ 2147548370 VDMA_FCD2_Previously_Active_Serv: 8 Vector__XXX
 SG_ Previously_Active_Service_Only_D : 0|64@1+ (1,0) [0|18446744073709551615] "" Vector__XXX

BO_ 2147548371 VDMA_FCD3_Diagnostic_Data_Clear_: 8 Vector__XXX
 SG_ Diagnostic_Data_Clear_Reset_for_ : 0|64@1+ (1,0) [0|18446744073709551615] "" Vector__XXX

BO_ 2147548372 VDMA_FCD4_XCP_Get_Slave_ID: 8 Vector__XXX
 SG_ XCP_Get_Slave_ID_RawPayload : 0|64@1+ (1,0) [0|18446744073709551615] "" Vector__XXX

BO_ 2147548373 VDMA_FCD5_Aftertreatment_1_Diese: 8 Vector__XXX
 SG_ Aftertreatment_1_Diesel_Exhaust_ : 0|64@1+ (1,0) [0|18446744073709551615] "" Vector__XXX

BO_ 2147548374 VDMA_FCD6_Aftertreatment_1_Diese: 8 Vector__XXX
 SG_ Aftertreatment_1_Diesel_Particul : 0|64@1+ (1,0) [0|18446744073709551615] "" Vector__XXX

BO_ 2147548375 VDMA_FCD7_Aftertreatment_1_Diese: 8 Vector__XXX
 SG_ Aftertreatment_1_Diesel_Particul : 0|64@1+ (1,0) [0|18446744073709551615] "" Vector__XXX

BO_ 2147548376 VDMA_FCD8_Aftertreatment_1_Diese: 8 Vector__XXX
 SG_ Aftertreatment_1_Diesel_Particul : 0|64@1+ (1,0) [0|18446744073709551615] "" Vector__XXX

BO_ 2147548377 VDMA_FCD9_Aftertreatment_1_Diese: 8 Vector__XXX
 SG_ Aftertreatment_1_Diesel_Particul : 0|64@1+ (1,0) [0|18446744073709551615] "" Vector__XXX

BO_ 2147548378 VDMA_FCDA_Aftertreatment_1_Diese: 8 Vector__XXX
 SG_ Aftertreatment_1_Diesel_Particul : 0|64@1+ (1,0) [0|18446744073709551615] "" Vector__XXX

BO_ 2147548379 VDMA_FCDB_Aftertreatment_1_Diese: 8 Vector__XXX
 SG_ Aftertreatment_1_Diesel_Particul : 0|64@1+ (1,0) [0|18446744073709551615] "" Vector__XXX

BO_ 2147548380 VDMA_FCDC_Cruise_Control_Vehicle: 8 Vector__XXX
 SG_ Cruise_Control_Vehicle_Speed_3_R : 0|64@1+ (1,0) [0|18446744073709551615] "" Vector__XXX

BO_ 2147548381 VDMA_FCDD_Aftertreatment_2_Air_C: 8 Vector__XXX
 SG_ Aftertreatment_2_Air_Control_3_R : 0|64@1+ (1,0) [0|18446744073709551615] "" Vector__XXX

BO_ 2147548382 VDMA_FCDE_Aftertreatment_1_Air_C: 8 Vector__XXX
 SG_ Aftertreatment_1_Air_Control_3_R : 0|64@1+ (1,0) [0|18446744073709551615] "" Vector__XXX

BO_ 2147548383 VDMA_FCDF_Engine_Fluid_Level_Pre: 8 Vector__XXX
 SG_ Engine_Fluid_Level_Pressure_12_R : 0|64@1+ (1,0) [0|18446744073709551615] "" Vector__XXX

BO_ 2147548384 VDMA_FCE0_Diesel_Particulate_Fil: 8 Vector__XXX
 SG_ Diesel_Particulate_Filter_Contro : 0|64@1+ (1,0) [0|18446744073709551615] "" Vector__XXX

BO_ 2147548385 VDMA_FCE1_Fuel_Economy_2_Liquid: 8 Vector__XXX
 SG_ Fuel_Economy_2_Liquid_RawPayload : 0|64@1+ (1,0) [0|18446744073709551615] "" Vector__XXX

BO_ 2147548386 VDMA_FCE2_Supplemental_Fan_Statu: 8 Vector__XXX
 SG_ Supplemental_Fan_Status_RawPaylo : 0|64@1+ (1,0) [0|18446744073709551615] "" Vector__XXX

BO_ 2147548387 VDMA_FCE3_Engine_Exhaust_Brake_C: 8 Vector__XXX
 SG_ Engine_Exhaust_Brake_Control_Raw : 0|64@1+ (1,0) [0|18446744073709551615] "" Vector__XXX

BO_ 2147548388 VDMA_FCE4_Engine_Fuel_Properties: 8 Vector__XXX
 SG_ Engine_Fuel_Properties_RawPayloa : 0|64@1+ (1,0) [0|18446744073709551615] "" Vector__XXX

BO_ 2147548389 VDMA_FCE5_Hydraulic_Oil_Properti: 8 Vector__XXX
 SG_ Hydraulic_Oil_Properties_RawPayl : 0|64@1+ (1,0) [0|18446744073709551615] "" Vector__XXX

BO_ 2147548390 VDMA_FCE6_Vehicle_Chassis_Lubric: 8 Vector__XXX
 SG_ Vehicle_Chassis_Lubrication_Syst : 0|64@1+ (1,0) [0|18446744073709551615] "" Vector__XXX

BO_ 2147548391 VDMA_FCE7_Engine_Configuration_3: 8 Vector__XXX
 SG_ Engine_Configuration_3_RawPayloa : 0|64@1+ (1,0) [0|18446744073709551615] "" Vector__XXX

BO_ 2147548392 VDMA_FCE8_Intake_Valve_Actuation: 8 Vector__XXX
 SG_ Intake_Valve_Actuation_Control_R : 0|64@1+ (1,0) [0|18446744073709551615] "" Vector__XXX

BO_ 2147548393 VDMA_FCE9_Armrest_Switch_Matrix_: 8 Vector__XXX
 SG_ Armrest_Switch_Matrix_Commands_R : 0|64@1+ (1,0) [0|18446744073709551615] "" Vector__XXX

BO_ 2147548394 VDMA_FCEA_Vehicle_Electrical_Pow: 8 Vector__XXX
 SG_ Vehicle_Electrical_Power_4_obsol : 0|64@1+ (1,0) [0|18446744073709551615] "" Vector__XXX

BO_ 2147548395 VDMA_FCEB_Aftertreatment_2_NOx_A: 8 Vector__XXX
 SG_ Aftertreatment_2_NOx_Adsorber_In : 0|64@1+ (1,0) [0|18446744073709551615] "" Vector__XXX

BO_ 2147548396 VDMA_FCEC_Aftertreatment_1_NOx_A: 8 Vector__XXX
 SG_ Aftertreatment_1_NOx_Adsorber_In : 0|64@1+ (1,0) [0|18446744073709551615] "" Vector__XXX

BO_ 2147548397 VDMA_FCED_Aftertreatment_2_Warm_: 8 Vector__XXX
 SG_ Aftertreatment_2_Warm_Up_Diesel_ : 0|64@1+ (1,0) [0|18446744073709551615] "" Vector__XXX

BO_ 2147548398 VDMA_FCEE_Land_Leveling_System_R: 8 Vector__XXX
 SG_ Land_Leveling_System_Reference_E : 0|64@1+ (1,0) [0|18446744073709551615] "" Vector__XXX

BO_ 2147548399 VDMA_FCEF_Engine_Fluid_Level_Pre: 8 Vector__XXX
 SG_ Engine_Fluid_Level_Pressure_11_R : 0|64@1+ (1,0) [0|18446744073709551615] "" Vector__XXX

BO_ 2147548400 VDMA_FCF0_Engine_Fuel_Lube_x000D: 8 Vector__XXX
 SG_ Engine_Fuel_Lube_x000D_Systems_2 : 0|64@1+ (1,0) [0|18446744073709551615] "" Vector__XXX

BO_ 2147548401 VDMA_FCF1_Engine_Turbocharger_Wa: 8 Vector__XXX
 SG_ Engine_Turbocharger_Wastegate_Ac : 0|64@1+ (1,0) [0|18446744073709551615] "" Vector__XXX

BO_ 2147548402 VDMA_FCF2_Engine_Fuel_Throttle_V: 8 Vector__XXX
 SG_ Engine_Fuel_Throttle_Valve_Infor : 0|64@1+ (1,0) [0|18446744073709551615] "" Vector__XXX

BO_ 2147548403 VDMA_FCF3_Engine_Turbocharger_Co: 8 Vector__XXX
 SG_ Engine_Turbocharger_Compressor_B : 0|64@1+ (1,0) [0|18446744073709551615] "" Vector__XXX

BO_ 2147548404 VDMA_FCF4_Charge_Air_Cooler_2: 8 Vector__XXX
 SG_ Charge_Air_Cooler_2_RawPayload : 0|64@1+ (1,0) [0|18446744073709551615] "" Vector__XXX

BO_ 2147548405 VDMA_FCF5_Charge_Air_Cooler_2_Pr: 8 Vector__XXX
 SG_ Charge_Air_Cooler_2_Precooler_Ra : 0|64@1+ (1,0) [0|18446744073709551615] "" Vector__XXX

BO_ 2147548406 VDMA_FCF6_Charge_Air_Cooler_1: 8 Vector__XXX
 SG_ Charge_Air_Cooler_1_RawPayload : 0|64@1+ (1,0) [0|18446744073709551615] "" Vector__XXX

BO_ 2147548407 VDMA_FCF7_Charge_Air_Cooler_1_Pr: 8 Vector__XXX
 SG_ Charge_Air_Cooler_1_Precooler_Ra : 0|64@1+ (1,0) [0|18446744073709551615] "" Vector__XXX

BO_ 2147548408 VDMA_FCF8_Diesel_Particulate_Fil: 8 Vector__XXX
 SG_ Diesel_Particulate_Filter_2_Soot : 0|64@1+ (1,0) [0|18446744073709551615] "" Vector__XXX

BO_ 2147548409 VDMA_FCF9_Diesel_Particulate_Fil: 8 Vector__XXX
 SG_ Diesel_Particulate_Filter_1_Soot : 0|64@1+ (1,0) [0|18446744073709551615] "" Vector__XXX

BO_ 2147548410 VDMA_FCFA_Electronic_Engine_Cont: 8 Vector__XXX
 SG_ Electronic_Engine_Controller_11_ : 0|64@1+ (1,0) [0|18446744073709551615] "" Vector__XXX

BO_ 2147548411 VDMA_FCFB_Engine_Manifold_Actuat: 8 Vector__XXX
 SG_ Engine_Manifold_Actuator_Positio : 0|64@1+ (1,0) [0|18446744073709551615] "" Vector__XXX

BO_ 2147548412 VDMA_FCFC_Engine_Manifold_Actuat: 8 Vector__XXX
 SG_ Engine_Manifold_Actuator_Control : 0|64@1+ (1,0) [0|18446744073709551615] "" Vector__XXX

BO_ 2147548413 VDMA_FCFD_Electronic_Engine_Cont: 8 Vector__XXX
 SG_ Electronic_Engine_Controller_9_R : 0|64@1+ (1,0) [0|18446744073709551615] "" Vector__XXX

BO_ 2147548414 VDMA_FCFE_Electronic_Engine_Cont: 8 Vector__XXX
 SG_ Electronic_Engine_Controller_10_ : 0|64@1+ (1,0) [0|18446744073709551615] "" Vector__XXX

BO_ 2147548415 VDMA_FCFF_Engine_Temperature_5: 8 Vector__XXX
 SG_ Engine_Temperature_5_RawPayload : 0|64@1+ (1,0) [0|18446744073709551615] "" Vector__XXX

BO_ 2147548416 VDMA_FD00_Engine_Fluid_Level_Pre: 8 Vector__XXX
 SG_ Engine_Fluid_Level_Pressure_10_R : 0|64@1+ (1,0) [0|18446744073709551615] "" Vector__XXX

BO_ 2147548417 VDMA_FD01_Low_Voltage_Disconnect: 8 Vector__XXX
 SG_ Low_Voltage_Disconnect_Status_Ra : 0|64@1+ (1,0) [0|18446744073709551615] "" Vector__XXX

BO_ 2147548419 VDMA_FD03_Implement_Operating_st: 8 Vector__XXX
 SG_ Implement_Operating_state_comman : 0|64@1+ (1,0) [0|18446744073709551615] "" Vector__XXX

BO_ 2147548420 VDMA_FD04_Direct_Lamp_Control_Da: 8 Vector__XXX
 SG_ Direct_Lamp_Control_Data_2_RawPa : 0|64@1+ (1,0) [0|18446744073709551615] "" Vector__XXX

BO_ 2147548421 VDMA_FD05_Direct_Lamp_Control_Da: 8 Vector__XXX
 SG_ Direct_Lamp_Control_Data_1_RawPa : 0|64@1+ (1,0) [0|18446744073709551615] "" Vector__XXX

BO_ 2147548422 VDMA_FD06_Direct_Lamp_Control_Co: 8 Vector__XXX
 SG_ Direct_Lamp_Control_Command_2_Ra : 0|64@1+ (1,0) [0|18446744073709551615] "" Vector__XXX

BO_ 2147548423 VDMA_FD07_Direct_Lamp_Control_Co: 8 Vector__XXX
 SG_ Direct_Lamp_Control_Command_1_Ra : 0|64@1+ (1,0) [0|18446744073709551615] "" Vector__XXX

BO_ 2147548424 VDMA_FD08_Engine_oil_message: 8 Vector__XXX
 SG_ Engine_oil_message_RawPayload : 0|64@1+ (1,0) [0|18446744073709551615] "" Vector__XXX

BO_ 2147548426 VDMA_FD0A_Aftertreatment_2_Outle: 8 Vector__XXX
 SG_ Aftertreatment_2_Outlet_Gas_NOx_ : 0|64@1+ (1,0) [0|18446744073709551615] "" Vector__XXX

BO_ 2147548427 VDMA_FD0B_Aftertreatment_2_Outle: 8 Vector__XXX
 SG_ Aftertreatment_2_Outlet_Gas_NOx_ : 0|64@1+ (1,0) [0|18446744073709551615] "" Vector__XXX

BO_ 2147548428 VDMA_FD0C_Aftertreatment_2_Intak: 8 Vector__XXX
 SG_ Aftertreatment_2_Intake_Gas_NOx_ : 0|64@1+ (1,0) [0|18446744073709551615] "" Vector__XXX

BO_ 2147548429 VDMA_FD0D_Aftertreatment_2_Intak: 8 Vector__XXX
 SG_ Aftertreatment_2_Intake_Gas_NOx_ : 0|64@1+ (1,0) [0|18446744073709551615] "" Vector__XXX

BO_ 2147548430 VDMA_FD0E_Aftertreatment_1_Outle: 8 Vector__XXX
 SG_ Aftertreatment_1_Outlet_Gas_NOx_ : 0|64@1+ (1,0) [0|18446744073709551615] "" Vector__XXX

BO_ 2147548431 VDMA_FD0F_Aftertreatment_1_Outle: 8 Vector__XXX
 SG_ Aftertreatment_1_Outlet_Gas_NOx_ : 0|64@1+ (1,0) [0|18446744073709551615] "" Vector__XXX

BO_ 2147548432 VDMA_FD10_Aftertreatment_1_Intak: 8 Vector__XXX
 SG_ Aftertreatment_1_Intake_Gas_NOx_ : 0|64@1+ (1,0) [0|18446744073709551615] "" Vector__XXX

BO_ 2147548433 VDMA_FD11_Aftertreatment_1_Intak: 8 Vector__XXX
 SG_ Aftertreatment_1_Intake_Gas_NOx_ : 0|64@1+ (1,0) [0|18446744073709551615] "" Vector__XXX

BO_ 2147548434 VDMA_FD12_Magnet_Status_Informat: 8 Vector__XXX
 SG_ Magnet_Status_Information_1_RawP : 0|64@1+ (1,0) [0|18446744073709551615] "" Vector__XXX

BO_ 2147548435 VDMA_FD13_Magnet_System_Configur: 8 Vector__XXX
 SG_ Magnet_System_Configuration_Info : 0|64@1+ (1,0) [0|18446744073709551615] "" Vector__XXX

BO_ 2147548436 VDMA_FD14_Battery_Charger_2: 8 Vector__XXX
 SG_ Battery_Charger_2_RawPayload : 0|64@1+ (1,0) [0|18446744073709551615] "" Vector__XXX

BO_ 2147548437 VDMA_FD15_Battery_Charger_1: 8 Vector__XXX
 SG_ Battery_Charger_1_RawPayload : 0|64@1+ (1,0) [0|18446744073709551615] "" Vector__XXX

BO_ 2147548438 VDMA_FD16_Occupant_Classificatio: 8 Vector__XXX
 SG_ Occupant_Classification_System_I : 0|64@1+ (1,0) [0|18446744073709551615] "" Vector__XXX

BO_ 2147548439 VDMA_FD17_Beltlock_and_Airbag_De: 8 Vector__XXX
 SG_ Beltlock_and_Airbag_Deactivation : 0|64@1+ (1,0) [0|18446744073709551615] "" Vector__XXX

BO_ 2147548440 VDMA_FD18_Collision_Sensor_Infor: 8 Vector__XXX
 SG_ Collision_Sensor_Information_Raw : 0|64@1+ (1,0) [0|18446744073709551615] "" Vector__XXX

BO_ 2147548441 VDMA_FD19_Ignitor_Loop_Informati: 8 Vector__XXX
 SG_ Ignitor_Loop_Information_RawPayl : 0|64@1+ (1,0) [0|18446744073709551615] "" Vector__XXX

BO_ 2147548442 VDMA_FD1A_Aftertreatment_1_Warm_: 8 Vector__XXX
 SG_ Aftertreatment_1_Warm_Up_Diesel_ : 0|64@1+ (1,0) [0|18446744073709551615] "" Vector__XXX

BO_ 2147548443 VDMA_FD1B_Diesel_Particulate_Fil: 8 Vector__XXX
 SG_ Diesel_Particulate_Filter_2_Soot : 0|64@1+ (1,0) [0|18446744073709551615] "" Vector__XXX

BO_ 2147548444 VDMA_FD1C_Diesel_Particulate_Fil: 8 Vector__XXX
 SG_ Diesel_Particulate_Filter_1_Soot : 0|64@1+ (1,0) [0|18446744073709551615] "" Vector__XXX

BO_ 2147548445 VDMA_FD1D_Aftertreatment_Differe: 8 Vector__XXX
 SG_ Aftertreatment_Differential_Temp : 0|64@1+ (1,0) [0|18446744073709551615] "" Vector__XXX

BO_ 2147548446 VDMA_FD1E_Aftertreatment_Differe: 8 Vector__XXX
 SG_ Aftertreatment_Differential_Temp : 0|64@1+ (1,0) [0|18446744073709551615] "" Vector__XXX

BO_ 2147548447 VDMA_FD1F_Aftertreatment_2_Diese: 8 Vector__XXX
 SG_ Aftertreatment_2_Diesel_Oxidatio : 0|64@1+ (1,0) [0|18446744073709551615] "" Vector__XXX

BO_ 2147548448 VDMA_FD20_Aftertreatment_1_Diese: 8 Vector__XXX
 SG_ Aftertreatment_1_Diesel_Oxidatio : 0|64@1+ (1,0) [0|18446744073709551615] "" Vector__XXX

BO_ 2147548449 VDMA_FD21_Aftertreatment_2_Gas_O: 8 Vector__XXX
 SG_ Aftertreatment_2_Gas_Oxidation_C : 0|64@1+ (1,0) [0|18446744073709551615] "" Vector__XXX

BO_ 2147548450 VDMA_FD22_Aftertreatment_1_Gas_O: 8 Vector__XXX
 SG_ Aftertreatment_1_Gas_Oxidation_C : 0|64@1+ (1,0) [0|18446744073709551615] "" Vector__XXX

BO_ 2147548451 VDMA_FD23_Extended_Joystick_Mess: 8 Vector__XXX
 SG_ Extended_Joystick_Message_10_Raw : 0|64@1+ (1,0) [0|18446744073709551615] "" Vector__XXX

BO_ 2147548452 VDMA_FD24_Basic_Joystick_Message: 8 Vector__XXX
 SG_ Basic_Joystick_Message_10_RawPay : 0|64@1+ (1,0) [0|18446744073709551615] "" Vector__XXX

BO_ 2147548453 VDMA_FD25_Extended_Joystick_Mess: 8 Vector__XXX
 SG_ Extended_Joystick_Message_9_RawP : 0|64@1+ (1,0) [0|18446744073709551615] "" Vector__XXX

BO_ 2147548454 VDMA_FD26_Basic_Joystick_Message: 8 Vector__XXX
 SG_ Basic_Joystick_Message_9_RawPayl : 0|64@1+ (1,0) [0|18446744073709551615] "" Vector__XXX

BO_ 2147548455 VDMA_FD27_Extended_Joystick_Mess: 8 Vector__XXX
 SG_ Extended_Joystick_Message_8_RawP : 0|64@1+ (1,0) [0|18446744073709551615] "" Vector__XXX

BO_ 2147548456 VDMA_FD28_Basic_Joystick_Message: 8 Vector__XXX
 SG_ Basic_Joystick_Message_8_RawPayl : 0|64@1+ (1,0) [0|18446744073709551615] "" Vector__XXX

BO_ 2147548457 VDMA_FD29_Extended_Joystick_Mess: 8 Vector__XXX
 SG_ Extended_Joystick_Message_7_RawP : 0|64@1+ (1,0) [0|18446744073709551615] "" Vector__XXX

BO_ 2147548458 VDMA_FD2A_Basic_Joystick_Message: 8 Vector__XXX
 SG_ Basic_Joystick_Message_7_RawPayl : 0|64@1+ (1,0) [0|18446744073709551615] "" Vector__XXX

BO_ 2147548459 VDMA_FD2B_Extended_Joystick_Mess: 8 Vector__XXX
 SG_ Extended_Joystick_Message_6_RawP : 0|64@1+ (1,0) [0|18446744073709551615] "" Vector__XXX

BO_ 2147548460 VDMA_FD2C_Basic_Joystick_Message: 8 Vector__XXX
 SG_ Basic_Joystick_Message_6_RawPayl : 0|64@1+ (1,0) [0|18446744073709551615] "" Vector__XXX

BO_ 2147548461 VDMA_FD2D_Extended_Joystick_Mess: 8 Vector__XXX
 SG_ Extended_Joystick_Message_5_RawP : 0|64@1+ (1,0) [0|18446744073709551615] "" Vector__XXX

BO_ 2147548462 VDMA_FD2E_Basic_Joystick_Message: 8 Vector__XXX
 SG_ Basic_Joystick_Message_5_RawPayl : 0|64@1+ (1,0) [0|18446744073709551615] "" Vector__XXX

BO_ 2147548463 VDMA_FD2F_Extended_Joystick_Mess: 8 Vector__XXX
 SG_ Extended_Joystick_Message_4_RawP : 0|64@1+ (1,0) [0|18446744073709551615] "" Vector__XXX

BO_ 2147548464 VDMA_FD30_Basic_Joystick_Message: 8 Vector__XXX
 SG_ Basic_Joystick_Message_4_RawPayl : 0|64@1+ (1,0) [0|18446744073709551615] "" Vector__XXX

BO_ 2147548465 VDMA_FD31_Fan_Drive_2: 8 Vector__XXX
 SG_ Fan_Drive_2_RawPayload : 0|64@1+ (1,0) [0|18446744073709551615] "" Vector__XXX

BO_ 2147548467 VDMA_FD33_Aftertreatment_2_Diese: 8 Vector__XXX
 SG_ Aftertreatment_2_Diesel_Exhaust_ : 0|64@1+ (1,0) [0|18446744073709551615] "" Vector__XXX

BO_ 2147548468 VDMA_FD34_Aftertreatment_2_SCR_R: 8 Vector__XXX
 SG_ Aftertreatment_2_SCR_Reagant_Tan : 0|64@1+ (1,0) [0|18446744073709551615] "" Vector__XXX

BO_ 2147548469 VDMA_FD35_Aftertreatment_2_Diese: 8 Vector__XXX
 SG_ Aftertreatment_2_Diesel_Exhaust_ : 0|64@1+ (1,0) [0|18446744073709551615] "" Vector__XXX

CM_ BO_ 2147548168  "Source: isobus.net VDMA Data Dictionary (https://www.isobus.net/isobus/pGNAndSPN/12516?type=PGN)";
CM_ BO_ 2147548169  "Source: isobus.net VDMA Data Dictionary (https://www.isobus.net/isobus/pGNAndSPN/12521?type=PGN)";
CM_ BO_ 2147548170  "Source: isobus.net VDMA Data Dictionary (https://www.isobus.net/isobus/pGNAndSPN/12524?type=PGN)";
CM_ BO_ 2147548171  "Source: isobus.net VDMA Data Dictionary (https://www.isobus.net/isobus/pGNAndSPN/12528?type=PGN)";
CM_ BO_ 2147548172  "Source: isobus.net VDMA Data Dictionary (https://www.isobus.net/isobus/pGNAndSPN/12531?type=PGN)";
CM_ BO_ 2147548173  "Source: isobus.net VDMA Data Dictionary (https://www.isobus.net/isobus/pGNAndSPN/12533?type=PGN)";
CM_ BO_ 2147548174  "Source: isobus.net VDMA Data Dictionary (https://www.isobus.net/isobus/pGNAndSPN/12535?type=PGN)";
CM_ BO_ 2147548175  "Source: isobus.net VDMA Data Dictionary (https://www.isobus.net/isobus/pGNAndSPN/12537?type=PGN)";
CM_ BO_ 2147548176  "Source: isobus.net VDMA Data Dictionary (https://www.isobus.net/isobus/pGNAndSPN/12540?type=PGN)";
CM_ BO_ 2147548177  "Source: isobus.net VDMA Data Dictionary (https://www.isobus.net/isobus/pGNAndSPN/12542?type=PGN)";
CM_ BO_ 2147548178  "Source: isobus.net VDMA Data Dictionary (https://www.isobus.net/isobus/pGNAndSPN/12562?type=PGN)";
CM_ BO_ 2147548179  "Source: isobus.net VDMA Data Dictionary (https://www.isobus.net/isobus/pGNAndSPN/12566?type=PGN)";
CM_ BO_ 2147548180  "Source: isobus.net VDMA Data Dictionary (https://www.isobus.net/isobus/pGNAndSPN/12567?type=PGN)";
CM_ BO_ 2147548181  "Source: isobus.net VDMA Data Dictionary (https://www.isobus.net/isobus/pGNAndSPN/12571?type=PGN)";
CM_ BO_ 2147548182  "Source: isobus.net VDMA Data Dictionary (https://www.isobus.net/isobus/pGNAndSPN/12572?type=PGN)";
CM_ BO_ 2147548183  "Source: isobus.net VDMA Data Dictionary (https://www.isobus.net/isobus/pGNAndSPN/12576?type=PGN)";
CM_ BO_ 2147548184  "Source: isobus.net VDMA Data Dictionary (https://www.isobus.net/isobus/pGNAndSPN/12577?type=PGN)";
CM_ BO_ 2147548185  "Source: isobus.net VDMA Data Dictionary (https://www.isobus.net/isobus/pGNAndSPN/12579?type=PGN)";
CM_ BO_ 2147548186  "Source: isobus.net VDMA Data Dictionary (https://www.isobus.net/isobus/pGNAndSPN/12585?type=PGN)";
CM_ BO_ 2147548187  "Source: isobus.net VDMA Data Dictionary (https://www.isobus.net/isobus/pGNAndSPN/12589?type=PGN)";
CM_ BO_ 2147548188  "Source: isobus.net VDMA Data Dictionary (https://www.isobus.net/isobus/pGNAndSPN/12593?type=PGN)";
CM_ BO_ 2147548189  "Source: isobus.net VDMA Data Dictionary (https://www.isobus.net/isobus/pGNAndSPN/12595?type=PGN)";
CM_ BO_ 2147548190  "Source: isobus.net VDMA Data Dictionary (https://www.isobus.net/isobus/pGNAndSPN/12599?type=PGN)";
CM_ BO_ 2147548191  "Source: isobus.net VDMA Data Dictionary (https://www.isobus.net/isobus/pGNAndSPN/12603?type=PGN)";
CM_ BO_ 2147548192  "Source: isobus.net VDMA Data Dictionary (https://www.isobus.net/isobus/pGNAndSPN/12635?type=PGN)";
CM_ BO_ 2147548193  "Source: isobus.net VDMA Data Dictionary (https://www.isobus.net/isobus/pGNAndSPN/12667?type=PGN)";
CM_ BO_ 2147548194  "Source: isobus.net VDMA Data Dictionary (https://www.isobus.net/isobus/pGNAndSPN/12669?type=PGN)";
CM_ BO_ 2147548195  "Source: isobus.net VDMA Data Dictionary (https://www.isobus.net/isobus/pGNAndSPN/12670?type=PGN)";
CM_ BO_ 2147548196  "Source: isobus.net VDMA Data Dictionary (https://www.isobus.net/isobus/pGNAndSPN/12673?type=PGN)";
CM_ BO_ 2147548197  "Source: isobus.net VDMA Data Dictionary (https://www.isobus.net/isobus/pGNAndSPN/12676?type=PGN)";
CM_ BO_ 2147548198  "Source: isobus.net VDMA Data Dictionary (https://www.isobus.net/isobus/pGNAndSPN/12678?type=PGN)";
CM_ BO_ 2147548199  "Source: isobus.net VDMA Data Dictionary (https://www.isobus.net/isobus/pGNAndSPN/12680?type=PGN)";
CM_ BO_ 2147548200  "Source: isobus.net VDMA Data Dictionary (https://www.isobus.net/isobus/pGNAndSPN/12685?type=PGN)";
CM_ BO_ 2147548201  "Source: isobus.net VDMA Data Dictionary (https://www.isobus.net/isobus/pGNAndSPN/12694?type=PGN)";
CM_ BO_ 2147548202  "Source: isobus.net VDMA Data Dictionary (https://www.isobus.net/isobus/pGNAndSPN/12699?type=PGN)";
CM_ BO_ 2147548203  "Source: isobus.net VDMA Data Dictionary (https://www.isobus.net/isobus/pGNAndSPN/12703?type=PGN)";
CM_ BO_ 2147548204  "Source: isobus.net VDMA Data Dictionary (https://www.isobus.net/isobus/pGNAndSPN/12723?type=PGN)";
CM_ BO_ 2147548205  "Source: isobus.net VDMA Data Dictionary (https://www.isobus.net/isobus/pGNAndSPN/12727?type=PGN)";
CM_ BO_ 2147548206  "Source: isobus.net VDMA Data Dictionary (https://www.isobus.net/isobus/pGNAndSPN/12734?type=PGN)";
CM_ BO_ 2147548207  "Source: isobus.net VDMA Data Dictionary (https://www.isobus.net/isobus/pGNAndSPN/12738?type=PGN)";
CM_ BO_ 2147548208  "Source: isobus.net VDMA Data Dictionary (https://www.isobus.net/isobus/pGNAndSPN/12742?type=PGN)";
CM_ BO_ 2147548209  "Source: isobus.net VDMA Data Dictionary (https://www.isobus.net/isobus/pGNAndSPN/12755?type=PGN)";
CM_ BO_ 2147548210  "Source: isobus.net VDMA Data Dictionary (https://www.isobus.net/isobus/pGNAndSPN/12765?type=PGN)";
CM_ BO_ 2147548211  "Source: isobus.net VDMA Data Dictionary (https://www.isobus.net/isobus/pGNAndSPN/12767?type=PGN)";
CM_ BO_ 2147548212  "Source: isobus.net VDMA Data Dictionary (https://www.isobus.net/isobus/pGNAndSPN/12771?type=PGN)";
CM_ BO_ 2147548213  "Source: isobus.net VDMA Data Dictionary (https://www.isobus.net/isobus/pGNAndSPN/12773?type=PGN)";
CM_ BO_ 2147548214  "Source: isobus.net VDMA Data Dictionary (https://www.isobus.net/isobus/pGNAndSPN/12779?type=PGN)";
CM_ BO_ 2147548215  "Source: isobus.net VDMA Data Dictionary (https://www.isobus.net/isobus/pGNAndSPN/12781?type=PGN)";
CM_ BO_ 2147548216  "Source: isobus.net VDMA Data Dictionary (https://www.isobus.net/isobus/pGNAndSPN/12789?type=PGN)";
CM_ BO_ 2147548217  "Source: isobus.net VDMA Data Dictionary (https://www.isobus.net/isobus/pGNAndSPN/12791?type=PGN)";
CM_ BO_ 2147548218  "Source: isobus.net VDMA Data Dictionary (https://www.isobus.net/isobus/pGNAndSPN/12795?type=PGN)";
CM_ BO_ 2147548219  "Source: isobus.net VDMA Data Dictionary (https://www.isobus.net/isobus/pGNAndSPN/12799?type=PGN)";
CM_ BO_ 2147548220  "Source: isobus.net VDMA Data Dictionary (https://www.isobus.net/isobus/pGNAndSPN/12807?type=PGN)";
CM_ BO_ 2147548221  "Source: isobus.net VDMA Data Dictionary (https://www.isobus.net/isobus/pGNAndSPN/12815?type=PGN)";
CM_ BO_ 2147548222  "Source: isobus.net VDMA Data Dictionary (https://www.isobus.net/isobus/pGNAndSPN/12817?type=PGN)";
CM_ BO_ 2147548223  "Source: isobus.net VDMA Data Dictionary (https://www.isobus.net/isobus/pGNAndSPN/12819?type=PGN)";
CM_ BO_ 2147548224  "Source: isobus.net VDMA Data Dictionary (https://www.isobus.net/isobus/pGNAndSPN/12823?type=PGN)";
CM_ BO_ 2147548225  "Source: isobus.net VDMA Data Dictionary (https://www.isobus.net/isobus/pGNAndSPN/12828?type=PGN)";
CM_ BO_ 2147548226  "Source: isobus.net VDMA Data Dictionary (https://www.isobus.net/isobus/pGNAndSPN/12831?type=PGN)";
CM_ BO_ 2147548227  "Source: isobus.net VDMA Data Dictionary (https://www.isobus.net/isobus/pGNAndSPN/12837?type=PGN)";
CM_ BO_ 2147548228  "Source: isobus.net VDMA Data Dictionary (https://www.isobus.net/isobus/pGNAndSPN/12839?type=PGN)";
CM_ BO_ 2147548229  "Source: isobus.net VDMA Data Dictionary (https://www.isobus.net/isobus/pGNAndSPN/12845?type=PGN)";
CM_ BO_ 2147548230  "Source: isobus.net VDMA Data Dictionary (https://www.isobus.net/isobus/pGNAndSPN/12849?type=PGN)";
CM_ BO_ 2147548231  "Source: isobus.net VDMA Data Dictionary (https://www.isobus.net/isobus/pGNAndSPN/12863?type=PGN)";
CM_ BO_ 2147548232  "Source: isobus.net VDMA Data Dictionary (https://www.isobus.net/isobus/pGNAndSPN/12869?type=PGN)";
CM_ BO_ 2147548233  "Source: isobus.net VDMA Data Dictionary (https://www.isobus.net/isobus/pGNAndSPN/12876?type=PGN)";
CM_ BO_ 2147548234  "Source: isobus.net VDMA Data Dictionary (https://www.isobus.net/isobus/pGNAndSPN/12897?type=PGN)";
CM_ BO_ 2147548235  "Source: isobus.net VDMA Data Dictionary (https://www.isobus.net/isobus/pGNAndSPN/12901?type=PGN)";
CM_ BO_ 2147548236  "Source: isobus.net VDMA Data Dictionary (https://www.isobus.net/isobus/pGNAndSPN/12905?type=PGN)";
CM_ BO_ 2147548237  "Source: isobus.net VDMA Data Dictionary (https://www.isobus.net/isobus/pGNAndSPN/12910?type=PGN)";
CM_ BO_ 2147548238  "Source: isobus.net VDMA Data Dictionary (https://www.isobus.net/isobus/pGNAndSPN/12915?type=PGN)";
CM_ BO_ 2147548239  "Source: isobus.net VDMA Data Dictionary (https://www.isobus.net/isobus/pGNAndSPN/12923?type=PGN)";
CM_ BO_ 2147548240  "Source: isobus.net VDMA Data Dictionary (https://www.isobus.net/isobus/pGNAndSPN/12928?type=PGN)";
CM_ BO_ 2147548241  "Source: isobus.net VDMA Data Dictionary (https://www.isobus.net/isobus/pGNAndSPN/12932?type=PGN)";
CM_ BO_ 2147548242  "Source: isobus.net VDMA Data Dictionary (https://www.isobus.net/isobus/pGNAndSPN/12936?type=PGN)";
CM_ BO_ 2147548243  "Source: isobus.net VDMA Data Dictionary (https://www.isobus.net/isobus/pGNAndSPN/12942?type=PGN)";
CM_ BO_ 2147548244  "Source: isobus.net VDMA Data Dictionary (https://www.isobus.net/isobus/pGNAndSPN/12943?type=PGN)";
CM_ BO_ 2147548245  "Source: isobus.net VDMA Data Dictionary (https://www.isobus.net/isobus/pGNAndSPN/12944?type=PGN)";
CM_ BO_ 2147548246  "Source: isobus.net VDMA Data Dictionary (https://www.isobus.net/isobus/pGNAndSPN/12946?type=PGN)";
CM_ BO_ 2147548247  "Source: isobus.net VDMA Data Dictionary (https://www.isobus.net/isobus/pGNAndSPN/12948?type=PGN)";
CM_ BO_ 2147548248  "Source: isobus.net VDMA Data Dictionary (https://www.isobus.net/isobus/pGNAndSPN/12953?type=PGN)";
CM_ BO_ 2147548249  "Source: isobus.net VDMA Data Dictionary (https://www.isobus.net/isobus/pGNAndSPN/12956?type=PGN)";
CM_ BO_ 2147548250  "Source: isobus.net VDMA Data Dictionary (https://www.isobus.net/isobus/pGNAndSPN/12958?type=PGN)";
CM_ BO_ 2147548251  "Source: isobus.net VDMA Data Dictionary (https://www.isobus.net/isobus/pGNAndSPN/12960?type=PGN)";
CM_ BO_ 2147548252  "Source: isobus.net VDMA Data Dictionary (https://www.isobus.net/isobus/pGNAndSPN/12962?type=PGN)";
CM_ BO_ 2147548253  "Source: isobus.net VDMA Data Dictionary (https://www.isobus.net/isobus/pGNAndSPN/12973?type=PGN)";
CM_ BO_ 2147548254  "Source: isobus.net VDMA Data Dictionary (https://www.isobus.net/isobus/pGNAndSPN/12979?type=PGN)";
CM_ BO_ 2147548255  "Source: isobus.net VDMA Data Dictionary (https://www.isobus.net/isobus/pGNAndSPN/12980?type=PGN)";
CM_ BO_ 2147548256  "Source: isobus.net VDMA Data Dictionary (https://www.isobus.net/isobus/pGNAndSPN/12981?type=PGN)";
CM_ BO_ 2147548257  "Source: isobus.net VDMA Data Dictionary (https://www.isobus.net/isobus/pGNAndSPN/12982?type=PGN)";
CM_ BO_ 2147548258  "Source: isobus.net VDMA Data Dictionary (https://www.isobus.net/isobus/pGNAndSPN/12983?type=PGN)";
CM_ BO_ 2147548259  "Source: isobus.net VDMA Data Dictionary (https://www.isobus.net/isobus/pGNAndSPN/12984?type=PGN)";
CM_ BO_ 2147548260  "Source: isobus.net VDMA Data Dictionary (https://www.isobus.net/isobus/pGNAndSPN/12985?type=PGN)";
CM_ BO_ 2147548261  "Source: isobus.net VDMA Data Dictionary (https://www.isobus.net/isobus/pGNAndSPN/12986?type=PGN)";
CM_ BO_ 2147548262  "Source: isobus.net VDMA Data Dictionary (https://www.isobus.net/isobus/pGNAndSPN/12987?type=PGN)";
CM_ BO_ 2147548263  "Source: isobus.net VDMA Data Dictionary (https://www.isobus.net/isobus/pGNAndSPN/12988?type=PGN)";
CM_ BO_ 2147548264  "Source: isobus.net VDMA Data Dictionary (https://www.isobus.net/isobus/pGNAndSPN/12989?type=PGN)";
CM_ BO_ 2147548265  "Source: isobus.net VDMA Data Dictionary (https://www.isobus.net/isobus/pGNAndSPN/12990?type=PGN)";
CM_ BO_ 2147548266  "Source: isobus.net VDMA Data Dictionary (https://www.isobus.net/isobus/pGNAndSPN/12994?type=PGN)";
CM_ BO_ 2147548267  "Source: isobus.net VDMA Data Dictionary (https://www.isobus.net/isobus/pGNAndSPN/12995?type=PGN)";
CM_ BO_ 2147548268  "Source: isobus.net VDMA Data Dictionary (https://www.isobus.net/isobus/pGNAndSPN/12996?type=PGN)";
CM_ BO_ 2147548269  "Source: isobus.net VDMA Data Dictionary (https://www.isobus.net/isobus/pGNAndSPN/12997?type=PGN)";
CM_ BO_ 2147548270  "Source: isobus.net VDMA Data Dictionary (https://www.isobus.net/isobus/pGNAndSPN/12998?type=PGN)";
CM_ BO_ 2147548271  "Source: isobus.net VDMA Data Dictionary (https://www.isobus.net/isobus/pGNAndSPN/12999?type=PGN)";
CM_ BO_ 2147548272  "Source: isobus.net VDMA Data Dictionary (https://www.isobus.net/isobus/pGNAndSPN/13000?type=PGN)";
CM_ BO_ 2147548273  "Source: isobus.net VDMA Data Dictionary (https://www.isobus.net/isobus/pGNAndSPN/13001?type=PGN)";
CM_ BO_ 2147548274  "Source: isobus.net VDMA Data Dictionary (https://www.isobus.net/isobus/pGNAndSPN/13002?type=PGN)";
CM_ BO_ 2147548275  "Source: isobus.net VDMA Data Dictionary (https://www.isobus.net/isobus/pGNAndSPN/13003?type=PGN)";
CM_ BO_ 2147548276  "Source: isobus.net VDMA Data Dictionary (https://www.isobus.net/isobus/pGNAndSPN/13004?type=PGN)";
CM_ BO_ 2147548277  "Source: isobus.net VDMA Data Dictionary (https://www.isobus.net/isobus/pGNAndSPN/13005?type=PGN)";
CM_ BO_ 2147548278  "Source: isobus.net VDMA Data Dictionary (https://www.isobus.net/isobus/pGNAndSPN/13006?type=PGN)";
CM_ BO_ 2147548279  "Source: isobus.net VDMA Data Dictionary (https://www.isobus.net/isobus/pGNAndSPN/13007?type=PGN)";
CM_ BO_ 2147548280  "Source: isobus.net VDMA Data Dictionary (https://www.isobus.net/isobus/pGNAndSPN/13008?type=PGN)";
CM_ BO_ 2147548281  "Source: isobus.net VDMA Data Dictionary (https://www.isobus.net/isobus/pGNAndSPN/13009?type=PGN)";
CM_ BO_ 2147548282  "Source: isobus.net VDMA Data Dictionary (https://www.isobus.net/isobus/pGNAndSPN/13010?type=PGN)";
CM_ BO_ 2147548283  "Source: isobus.net VDMA Data Dictionary (https://www.isobus.net/isobus/pGNAndSPN/13011?type=PGN)";
CM_ BO_ 2147548284  "Source: isobus.net VDMA Data Dictionary (https://www.isobus.net/isobus/pGNAndSPN/13012?type=PGN)";
CM_ BO_ 2147548285  "Source: isobus.net VDMA Data Dictionary (https://www.isobus.net/isobus/pGNAndSPN/13013?type=PGN)";
CM_ BO_ 2147548286  "Source: isobus.net VDMA Data Dictionary (https://www.isobus.net/isobus/pGNAndSPN/13014?type=PGN)";
CM_ BO_ 2147548287  "Source: isobus.net VDMA Data Dictionary (https://www.isobus.net/isobus/pGNAndSPN/13015?type=PGN)";
CM_ BO_ 2147548288  "Source: isobus.net VDMA Data Dictionary (https://www.isobus.net/isobus/pGNAndSPN/13016?type=PGN)";
CM_ BO_ 2147548289  "Source: isobus.net VDMA Data Dictionary (https://www.isobus.net/isobus/pGNAndSPN/13017?type=PGN)";
CM_ BO_ 2147548290  "Source: isobus.net VDMA Data Dictionary (https://www.isobus.net/isobus/pGNAndSPN/13018?type=PGN)";
CM_ BO_ 2147548291  "Source: isobus.net VDMA Data Dictionary (https://www.isobus.net/isobus/pGNAndSPN/13019?type=PGN)";
CM_ BO_ 2147548292  "Source: isobus.net VDMA Data Dictionary (https://www.isobus.net/isobus/pGNAndSPN/13020?type=PGN)";
CM_ BO_ 2147548293  "Source: isobus.net VDMA Data Dictionary (https://www.isobus.net/isobus/pGNAndSPN/13023?type=PGN)";
CM_ BO_ 2147548294  "Source: isobus.net VDMA Data Dictionary (https://www.isobus.net/isobus/pGNAndSPN/13028?type=PGN)";
CM_ BO_ 2147548295  "Source: isobus.net VDMA Data Dictionary (https://www.isobus.net/isobus/pGNAndSPN/13031?type=PGN)";
CM_ BO_ 2147548296  "Source: isobus.net VDMA Data Dictionary (https://www.isobus.net/isobus/pGNAndSPN/13034?type=PGN)";
CM_ BO_ 2147548297  "Source: isobus.net VDMA Data Dictionary (https://www.isobus.net/isobus/pGNAndSPN/13038?type=PGN)";
CM_ BO_ 2147548298  "Source: isobus.net VDMA Data Dictionary (https://www.isobus.net/isobus/pGNAndSPN/13042?type=PGN)";
CM_ BO_ 2147548299  "Source: isobus.net VDMA Data Dictionary (https://www.isobus.net/isobus/pGNAndSPN/13048?type=PGN)";
CM_ BO_ 2147548300  "Source: isobus.net VDMA Data Dictionary (https://www.isobus.net/isobus/pGNAndSPN/13054?type=PGN)";
CM_ BO_ 2147548303  "Source: isobus.net VDMA Data Dictionary (https://www.isobus.net/isobus/pGNAndSPN/13067?type=PGN)";
CM_ BO_ 2147548304  "Source: isobus.net VDMA Data Dictionary (https://www.isobus.net/isobus/pGNAndSPN/13071?type=PGN)";
CM_ BO_ 2147548305  "Source: isobus.net VDMA Data Dictionary (https://www.isobus.net/isobus/pGNAndSPN/13074?type=PGN)";
CM_ BO_ 2147548306  "Source: isobus.net VDMA Data Dictionary (https://www.isobus.net/isobus/pGNAndSPN/13078?type=PGN)";
CM_ BO_ 2147548307  "Source: isobus.net VDMA Data Dictionary (https://www.isobus.net/isobus/pGNAndSPN/13082?type=PGN)";
CM_ BO_ 2147548308  "Source: isobus.net VDMA Data Dictionary (https://www.isobus.net/isobus/pGNAndSPN/13089?type=PGN)";
CM_ BO_ 2147548309  "Source: isobus.net VDMA Data Dictionary (https://www.isobus.net/isobus/pGNAndSPN/13091?type=PGN)";
CM_ BO_ 2147548310  "Source: isobus.net VDMA Data Dictionary (https://www.isobus.net/isobus/pGNAndSPN/13096?type=PGN)";
CM_ BO_ 2147548311  "Source: isobus.net VDMA Data Dictionary (https://www.isobus.net/isobus/pGNAndSPN/13108?type=PGN)";
CM_ BO_ 2147548312  "Source: isobus.net VDMA Data Dictionary (https://www.isobus.net/isobus/pGNAndSPN/13113?type=PGN)";
CM_ BO_ 2147548313  "Source: isobus.net VDMA Data Dictionary (https://www.isobus.net/isobus/pGNAndSPN/13115?type=PGN)";
CM_ BO_ 2147548314  "Source: isobus.net VDMA Data Dictionary (https://www.isobus.net/isobus/pGNAndSPN/13125?type=PGN)";
CM_ BO_ 2147548315  "Source: isobus.net VDMA Data Dictionary (https://www.isobus.net/isobus/pGNAndSPN/13135?type=PGN)";
CM_ BO_ 2147548316  "Source: isobus.net VDMA Data Dictionary (https://www.isobus.net/isobus/pGNAndSPN/13145?type=PGN)";
CM_ BO_ 2147548317  "Source: isobus.net VDMA Data Dictionary (https://www.isobus.net/isobus/pGNAndSPN/13147?type=PGN)";
CM_ BO_ 2147548318  "Source: isobus.net VDMA Data Dictionary (https://www.isobus.net/isobus/pGNAndSPN/13151?type=PGN)";
CM_ BO_ 2147548319  "Source: isobus.net VDMA Data Dictionary (https://www.isobus.net/isobus/pGNAndSPN/13158?type=PGN)";
CM_ BO_ 2147548320  "Source: isobus.net VDMA Data Dictionary (https://www.isobus.net/isobus/pGNAndSPN/13160?type=PGN)";
CM_ BO_ 2147548321  "Source: isobus.net VDMA Data Dictionary (https://www.isobus.net/isobus/pGNAndSPN/13168?type=PGN)";
CM_ BO_ 2147548322  "Source: isobus.net VDMA Data Dictionary (https://www.isobus.net/isobus/pGNAndSPN/13176?type=PGN)";
CM_ BO_ 2147548323  "Source: isobus.net VDMA Data Dictionary (https://www.isobus.net/isobus/pGNAndSPN/13184?type=PGN)";
CM_ BO_ 2147548324  "Source: isobus.net VDMA Data Dictionary (https://www.isobus.net/isobus/pGNAndSPN/13188?type=PGN)";
CM_ BO_ 2147548325  "Source: isobus.net VDMA Data Dictionary (https://www.isobus.net/isobus/pGNAndSPN/13192?type=PGN)";
CM_ BO_ 2147548326  "Source: isobus.net VDMA Data Dictionary (https://www.isobus.net/isobus/pGNAndSPN/13196?type=PGN)";
CM_ BO_ 2147548327  "Source: isobus.net VDMA Data Dictionary (https://www.isobus.net/isobus/pGNAndSPN/13200?type=PGN)";
CM_ BO_ 2147548328  "Source: isobus.net VDMA Data Dictionary (https://www.isobus.net/isobus/pGNAndSPN/13204?type=PGN)";
CM_ BO_ 2147548329  "Source: isobus.net VDMA Data Dictionary (https://www.isobus.net/isobus/pGNAndSPN/13208?type=PGN)";
CM_ BO_ 2147548330  "Source: isobus.net VDMA Data Dictionary (https://www.isobus.net/isobus/pGNAndSPN/13212?type=PGN)";
CM_ BO_ 2147548331  "Source: isobus.net VDMA Data Dictionary (https://www.isobus.net/isobus/pGNAndSPN/13216?type=PGN)";
CM_ BO_ 2147548332  "Source: isobus.net VDMA Data Dictionary (https://www.isobus.net/isobus/pGNAndSPN/13220?type=PGN)";
CM_ BO_ 2147548333  "Source: isobus.net VDMA Data Dictionary (https://www.isobus.net/isobus/pGNAndSPN/13224?type=PGN)";
CM_ BO_ 2147548334  "Source: isobus.net VDMA Data Dictionary (https://www.isobus.net/isobus/pGNAndSPN/13228?type=PGN)";
CM_ BO_ 2147548335  "Source: isobus.net VDMA Data Dictionary (https://www.isobus.net/isobus/pGNAndSPN/13232?type=PGN)";
CM_ BO_ 2147548336  "Source: isobus.net VDMA Data Dictionary (https://www.isobus.net/isobus/pGNAndSPN/13234?type=PGN)";
CM_ BO_ 2147548337  "Source: isobus.net VDMA Data Dictionary (https://www.isobus.net/isobus/pGNAndSPN/13238?type=PGN)";
CM_ BO_ 2147548339  "Source: isobus.net VDMA Data Dictionary (https://www.isobus.net/isobus/pGNAndSPN/13302?type=PGN)";
CM_ BO_ 2147548340  "Source: isobus.net VDMA Data Dictionary (https://www.isobus.net/isobus/pGNAndSPN/13334?type=PGN)";
CM_ BO_ 2147548341  "Source: isobus.net VDMA Data Dictionary (https://www.isobus.net/isobus/pGNAndSPN/13366?type=PGN)";
CM_ BO_ 2147548342  "Source: isobus.net VDMA Data Dictionary (https://www.isobus.net/isobus/pGNAndSPN/13370?type=PGN)";
CM_ BO_ 2147548343  "Source: isobus.net VDMA Data Dictionary (https://www.isobus.net/isobus/pGNAndSPN/13376?type=PGN)";
CM_ BO_ 2147548344  "Source: isobus.net VDMA Data Dictionary (https://www.isobus.net/isobus/pGNAndSPN/13378?type=PGN)";
CM_ BO_ 2147548345  "Source: isobus.net VDMA Data Dictionary (https://www.isobus.net/isobus/pGNAndSPN/13380?type=PGN)";
CM_ BO_ 2147548346  "Source: isobus.net VDMA Data Dictionary (https://www.isobus.net/isobus/pGNAndSPN/13387?type=PGN)";
CM_ BO_ 2147548347  "Source: isobus.net VDMA Data Dictionary (https://www.isobus.net/isobus/pGNAndSPN/13394?type=PGN)";
CM_ BO_ 2147548348  "Source: isobus.net VDMA Data Dictionary (https://www.isobus.net/isobus/pGNAndSPN/13395?type=PGN)";
CM_ BO_ 2147548349  "Source: isobus.net VDMA Data Dictionary (https://www.isobus.net/isobus/pGNAndSPN/13397?type=PGN)";
CM_ BO_ 2147548350  "Source: isobus.net VDMA Data Dictionary (https://www.isobus.net/isobus/pGNAndSPN/13401?type=PGN)";
CM_ BO_ 2147548351  "Source: isobus.net VDMA Data Dictionary (https://www.isobus.net/isobus/pGNAndSPN/13415?type=PGN)";
CM_ BO_ 2147548352  "Source: isobus.net VDMA Data Dictionary (https://www.isobus.net/isobus/pGNAndSPN/13421?type=PGN)";
CM_ BO_ 2147548353  "Source: isobus.net VDMA Data Dictionary (https://www.isobus.net/isobus/pGNAndSPN/13425?type=PGN)";
CM_ BO_ 2147548354  "Source: isobus.net VDMA Data Dictionary (https://www.isobus.net/isobus/pGNAndSPN/13446?type=PGN)";
CM_ BO_ 2147548355  "Source: isobus.net VDMA Data Dictionary (https://www.isobus.net/isobus/pGNAndSPN/13448?type=PGN)";
CM_ BO_ 2147548356  "Source: isobus.net VDMA Data Dictionary (https://www.isobus.net/isobus/pGNAndSPN/13450?type=PGN)";
CM_ BO_ 2147548357  "Source: isobus.net VDMA Data Dictionary (https://www.isobus.net/isobus/pGNAndSPN/13452?type=PGN)";
CM_ BO_ 2147548358  "Source: isobus.net VDMA Data Dictionary (https://www.isobus.net/isobus/pGNAndSPN/13453?type=PGN)";
CM_ BO_ 2147548359  "Source: isobus.net VDMA Data Dictionary (https://www.isobus.net/isobus/pGNAndSPN/13455?type=PGN)";
CM_ BO_ 2147548360  "Source: isobus.net VDMA Data Dictionary (https://www.isobus.net/isobus/pGNAndSPN/13468?type=PGN)";
CM_ BO_ 2147548361  "Source: isobus.net VDMA Data Dictionary (https://www.isobus.net/isobus/pGNAndSPN/13475?type=PGN)";
CM_ BO_ 2147548362  "Source: isobus.net VDMA Data Dictionary (https://www.isobus.net/isobus/pGNAndSPN/13485?type=PGN)";
CM_ BO_ 2147548363  "Source: isobus.net VDMA Data Dictionary (https://www.isobus.net/isobus/pGNAndSPN/13495?type=PGN)";
CM_ BO_ 2147548364  "Source: isobus.net VDMA Data Dictionary (https://www.isobus.net/isobus/pGNAndSPN/13501?type=PGN)";
CM_ BO_ 2147548365  "Source: isobus.net VDMA Data Dictionary (https://www.isobus.net/isobus/pGNAndSPN/13507?type=PGN)";
CM_ BO_ 2147548366  "Source: isobus.net VDMA Data Dictionary (https://www.isobus.net/isobus/pGNAndSPN/13512?type=PGN)";
CM_ BO_ 2147548367  "Source: isobus.net VDMA Data Dictionary (https://www.isobus.net/isobus/pGNAndSPN/13516?type=PGN)";
CM_ BO_ 2147548368  "Source: isobus.net VDMA Data Dictionary (https://www.isobus.net/isobus/pGNAndSPN/13519?type=PGN)";
CM_ BO_ 2147548369  "Source: isobus.net VDMA Data Dictionary (https://www.isobus.net/isobus/pGNAndSPN/13531?type=PGN)";
CM_ BO_ 2147548370  "Source: isobus.net VDMA Data Dictionary (https://www.isobus.net/isobus/pGNAndSPN/13543?type=PGN)";
CM_ BO_ 2147548371  "Source: isobus.net VDMA Data Dictionary (https://www.isobus.net/isobus/pGNAndSPN/13544?type=PGN)";
CM_ BO_ 2147548372  "Source: isobus.net VDMA Data Dictionary (https://www.isobus.net/isobus/pGNAndSPN/13545?type=PGN)";
CM_ BO_ 2147548373  "Source: isobus.net VDMA Data Dictionary (https://www.isobus.net/isobus/pGNAndSPN/13552?type=PGN)";
CM_ BO_ 2147548374  "Source: isobus.net VDMA Data Dictionary (https://www.isobus.net/isobus/pGNAndSPN/13556?type=PGN)";
CM_ BO_ 2147548375  "Source: isobus.net VDMA Data Dictionary (https://www.isobus.net/isobus/pGNAndSPN/13560?type=PGN)";
CM_ BO_ 2147548376  "Source: isobus.net VDMA Data Dictionary (https://www.isobus.net/isobus/pGNAndSPN/13564?type=PGN)";
CM_ BO_ 2147548377  "Source: isobus.net VDMA Data Dictionary (https://www.isobus.net/isobus/pGNAndSPN/13568?type=PGN)";
CM_ BO_ 2147548378  "Source: isobus.net VDMA Data Dictionary (https://www.isobus.net/isobus/pGNAndSPN/13572?type=PGN)";
CM_ BO_ 2147548379  "Source: isobus.net VDMA Data Dictionary (https://www.isobus.net/isobus/pGNAndSPN/13576?type=PGN)";
CM_ BO_ 2147548380  "Source: isobus.net VDMA Data Dictionary (https://www.isobus.net/isobus/pGNAndSPN/13587?type=PGN)";
CM_ BO_ 2147548381  "Source: isobus.net VDMA Data Dictionary (https://www.isobus.net/isobus/pGNAndSPN/13588?type=PGN)";
CM_ BO_ 2147548382  "Source: isobus.net VDMA Data Dictionary (https://www.isobus.net/isobus/pGNAndSPN/13590?type=PGN)";
CM_ BO_ 2147548383  "Source: isobus.net VDMA Data Dictionary (https://www.isobus.net/isobus/pGNAndSPN/13597?type=PGN)";
CM_ BO_ 2147548384  "Source: isobus.net VDMA Data Dictionary (https://www.isobus.net/isobus/pGNAndSPN/13601?type=PGN)";
CM_ BO_ 2147548385  "Source: isobus.net VDMA Data Dictionary (https://www.isobus.net/isobus/pGNAndSPN/13603?type=PGN)";
CM_ BO_ 2147548386  "Source: isobus.net VDMA Data Dictionary (https://www.isobus.net/isobus/pGNAndSPN/13612?type=PGN)";
CM_ BO_ 2147548387  "Source: isobus.net VDMA Data Dictionary (https://www.isobus.net/isobus/pGNAndSPN/13617?type=PGN)";
CM_ BO_ 2147548388  "Source: isobus.net VDMA Data Dictionary (https://www.isobus.net/isobus/pGNAndSPN/13621?type=PGN)";
CM_ BO_ 2147548389  "Source: isobus.net VDMA Data Dictionary (https://www.isobus.net/isobus/pGNAndSPN/13625?type=PGN)";
CM_ BO_ 2147548390  "Source: isobus.net VDMA Data Dictionary (https://www.isobus.net/isobus/pGNAndSPN/13631?type=PGN)";
CM_ BO_ 2147548391  "Source: isobus.net VDMA Data Dictionary (https://www.isobus.net/isobus/pGNAndSPN/13638?type=PGN)";
CM_ BO_ 2147548392  "Source: isobus.net VDMA Data Dictionary (https://www.isobus.net/isobus/pGNAndSPN/13640?type=PGN)";
CM_ BO_ 2147548393  "Source: isobus.net VDMA Data Dictionary (https://www.isobus.net/isobus/pGNAndSPN/13644?type=PGN)";
CM_ BO_ 2147548394  "Source: isobus.net VDMA Data Dictionary (https://www.isobus.net/isobus/pGNAndSPN/13645?type=PGN)";
CM_ BO_ 2147548395  "Source: isobus.net VDMA Data Dictionary (https://www.isobus.net/isobus/pGNAndSPN/13647?type=PGN)";
CM_ BO_ 2147548396  "Source: isobus.net VDMA Data Dictionary (https://www.isobus.net/isobus/pGNAndSPN/13649?type=PGN)";
CM_ BO_ 2147548397  "Source: isobus.net VDMA Data Dictionary (https://www.isobus.net/isobus/pGNAndSPN/13651?type=PGN)";
CM_ BO_ 2147548398  "Source: isobus.net VDMA Data Dictionary (https://www.isobus.net/isobus/pGNAndSPN/13655?type=PGN)";
CM_ BO_ 2147548399  "Source: isobus.net VDMA Data Dictionary (https://www.isobus.net/isobus/pGNAndSPN/13659?type=PGN)";
CM_ BO_ 2147548400  "Source: isobus.net VDMA Data Dictionary (https://www.isobus.net/isobus/pGNAndSPN/13664?type=PGN)";
CM_ BO_ 2147548401  "Source: isobus.net VDMA Data Dictionary (https://www.isobus.net/isobus/pGNAndSPN/13676?type=PGN)";
CM_ BO_ 2147548402  "Source: isobus.net VDMA Data Dictionary (https://www.isobus.net/isobus/pGNAndSPN/13690?type=PGN)";
CM_ BO_ 2147548403  "Source: isobus.net VDMA Data Dictionary (https://www.isobus.net/isobus/pGNAndSPN/13698?type=PGN)";
CM_ BO_ 2147548404  "Source: isobus.net VDMA Data Dictionary (https://www.isobus.net/isobus/pGNAndSPN/13702?type=PGN)";
CM_ BO_ 2147548405  "Source: isobus.net VDMA Data Dictionary (https://www.isobus.net/isobus/pGNAndSPN/13705?type=PGN)";
CM_ BO_ 2147548406  "Source: isobus.net VDMA Data Dictionary (https://www.isobus.net/isobus/pGNAndSPN/13709?type=PGN)";
CM_ BO_ 2147548407  "Source: isobus.net VDMA Data Dictionary (https://www.isobus.net/isobus/pGNAndSPN/13712?type=PGN)";
CM_ BO_ 2147548408  "Source: isobus.net VDMA Data Dictionary (https://www.isobus.net/isobus/pGNAndSPN/13715?type=PGN)";
CM_ BO_ 2147548409  "Source: isobus.net VDMA Data Dictionary (https://www.isobus.net/isobus/pGNAndSPN/13718?type=PGN)";
CM_ BO_ 2147548410  "Source: isobus.net VDMA Data Dictionary (https://www.isobus.net/isobus/pGNAndSPN/13722?type=PGN)";
CM_ BO_ 2147548411  "Source: isobus.net VDMA Data Dictionary (https://www.isobus.net/isobus/pGNAndSPN/13724?type=PGN)";
CM_ BO_ 2147548412  "Source: isobus.net VDMA Data Dictionary (https://www.isobus.net/isobus/pGNAndSPN/13726?type=PGN)";
CM_ BO_ 2147548413  "Source: isobus.net VDMA Data Dictionary (https://www.isobus.net/isobus/pGNAndSPN/13730?type=PGN)";
CM_ BO_ 2147548414  "Source: isobus.net VDMA Data Dictionary (https://www.isobus.net/isobus/pGNAndSPN/13735?type=PGN)";
CM_ BO_ 2147548415  "Source: isobus.net VDMA Data Dictionary (https://www.isobus.net/isobus/pGNAndSPN/13738?type=PGN)";
CM_ BO_ 2147548416  "Source: isobus.net VDMA Data Dictionary (https://www.isobus.net/isobus/pGNAndSPN/13743?type=PGN)";
CM_ BO_ 2147548417  "Source: isobus.net VDMA Data Dictionary (https://www.isobus.net/isobus/pGNAndSPN/13751?type=PGN)";
CM_ BO_ 2147548419  "Source: isobus.net VDMA Data Dictionary (https://www.isobus.net/isobus/pGNAndSPN/13754?type=PGN)";
CM_ BO_ 2147548420  "Source: isobus.net VDMA Data Dictionary (https://www.isobus.net/isobus/pGNAndSPN/13769?type=PGN)";
CM_ BO_ 2147548421  "Source: isobus.net VDMA Data Dictionary (https://www.isobus.net/isobus/pGNAndSPN/13796?type=PGN)";
CM_ BO_ 2147548422  "Source: isobus.net VDMA Data Dictionary (https://www.isobus.net/isobus/pGNAndSPN/13811?type=PGN)";
CM_ BO_ 2147548423  "Source: isobus.net VDMA Data Dictionary (https://www.isobus.net/isobus/pGNAndSPN/13838?type=PGN)";
CM_ BO_ 2147548424  "Source: isobus.net VDMA Data Dictionary (https://www.isobus.net/isobus/pGNAndSPN/13842?type=PGN)";
CM_ BO_ 2147548426  "Source: isobus.net VDMA Data Dictionary (https://www.isobus.net/isobus/pGNAndSPN/13850?type=PGN)";
CM_ BO_ 2147548427  "Source: isobus.net VDMA Data Dictionary (https://www.isobus.net/isobus/pGNAndSPN/13854?type=PGN)";
CM_ BO_ 2147548428  "Source: isobus.net VDMA Data Dictionary (https://www.isobus.net/isobus/pGNAndSPN/13860?type=PGN)";
CM_ BO_ 2147548429  "Source: isobus.net VDMA Data Dictionary (https://www.isobus.net/isobus/pGNAndSPN/13864?type=PGN)";
CM_ BO_ 2147548430  "Source: isobus.net VDMA Data Dictionary (https://www.isobus.net/isobus/pGNAndSPN/13870?type=PGN)";
CM_ BO_ 2147548431  "Source: isobus.net VDMA Data Dictionary (https://www.isobus.net/isobus/pGNAndSPN/13874?type=PGN)";
CM_ BO_ 2147548432  "Source: isobus.net VDMA Data Dictionary (https://www.isobus.net/isobus/pGNAndSPN/13880?type=PGN)";
CM_ BO_ 2147548433  "Source: isobus.net VDMA Data Dictionary (https://www.isobus.net/isobus/pGNAndSPN/13884?type=PGN)";
CM_ BO_ 2147548434  "Source: isobus.net VDMA Data Dictionary (https://www.isobus.net/isobus/pGNAndSPN/13892?type=PGN)";
CM_ BO_ 2147548435  "Source: isobus.net VDMA Data Dictionary (https://www.isobus.net/isobus/pGNAndSPN/13894?type=PGN)";
CM_ BO_ 2147548436  "Source: isobus.net VDMA Data Dictionary (https://www.isobus.net/isobus/pGNAndSPN/13901?type=PGN)";
CM_ BO_ 2147548437  "Source: isobus.net VDMA Data Dictionary (https://www.isobus.net/isobus/pGNAndSPN/13908?type=PGN)";
CM_ BO_ 2147548438  "Source: isobus.net VDMA Data Dictionary (https://www.isobus.net/isobus/pGNAndSPN/13918?type=PGN)";
CM_ BO_ 2147548439  "Source: isobus.net VDMA Data Dictionary (https://www.isobus.net/isobus/pGNAndSPN/13930?type=PGN)";
CM_ BO_ 2147548440  "Source: isobus.net VDMA Data Dictionary (https://www.isobus.net/isobus/pGNAndSPN/13964?type=PGN)";
CM_ BO_ 2147548441  "Source: isobus.net VDMA Data Dictionary (https://www.isobus.net/isobus/pGNAndSPN/14064?type=PGN)";
CM_ BO_ 2147548442  "Source: isobus.net VDMA Data Dictionary (https://www.isobus.net/isobus/pGNAndSPN/14066?type=PGN)";
CM_ BO_ 2147548443  "Source: isobus.net VDMA Data Dictionary (https://www.isobus.net/isobus/pGNAndSPN/14072?type=PGN)";
CM_ BO_ 2147548444  "Source: isobus.net VDMA Data Dictionary (https://www.isobus.net/isobus/pGNAndSPN/14078?type=PGN)";
CM_ BO_ 2147548445  "Source: isobus.net VDMA Data Dictionary (https://www.isobus.net/isobus/pGNAndSPN/14080?type=PGN)";
CM_ BO_ 2147548446  "Source: isobus.net VDMA Data Dictionary (https://www.isobus.net/isobus/pGNAndSPN/14082?type=PGN)";
CM_ BO_ 2147548447  "Source: isobus.net VDMA Data Dictionary (https://www.isobus.net/isobus/pGNAndSPN/14088?type=PGN)";
CM_ BO_ 2147548448  "Source: isobus.net VDMA Data Dictionary (https://www.isobus.net/isobus/pGNAndSPN/14094?type=PGN)";
CM_ BO_ 2147548449  "Source: isobus.net VDMA Data Dictionary (https://www.isobus.net/isobus/pGNAndSPN/14100?type=PGN)";
CM_ BO_ 2147548450  "Source: isobus.net VDMA Data Dictionary (https://www.isobus.net/isobus/pGNAndSPN/14106?type=PGN)";
CM_ BO_ 2147548451  "Source: isobus.net VDMA Data Dictionary (https://www.isobus.net/isobus/pGNAndSPN/14125?type=PGN)";
CM_ BO_ 2147548452  "Source: isobus.net VDMA Data Dictionary (https://www.isobus.net/isobus/pGNAndSPN/14147?type=PGN)";
CM_ BO_ 2147548453  "Source: isobus.net VDMA Data Dictionary (https://www.isobus.net/isobus/pGNAndSPN/14166?type=PGN)";
CM_ BO_ 2147548454  "Source: isobus.net VDMA Data Dictionary (https://www.isobus.net/isobus/pGNAndSPN/14188?type=PGN)";
CM_ BO_ 2147548455  "Source: isobus.net VDMA Data Dictionary (https://www.isobus.net/isobus/pGNAndSPN/14207?type=PGN)";
CM_ BO_ 2147548456  "Source: isobus.net VDMA Data Dictionary (https://www.isobus.net/isobus/pGNAndSPN/14229?type=PGN)";
CM_ BO_ 2147548457  "Source: isobus.net VDMA Data Dictionary (https://www.isobus.net/isobus/pGNAndSPN/14248?type=PGN)";
CM_ BO_ 2147548458  "Source: isobus.net VDMA Data Dictionary (https://www.isobus.net/isobus/pGNAndSPN/14270?type=PGN)";
CM_ BO_ 2147548459  "Source: isobus.net VDMA Data Dictionary (https://www.isobus.net/isobus/pGNAndSPN/14289?type=PGN)";
CM_ BO_ 2147548460  "Source: isobus.net VDMA Data Dictionary (https://www.isobus.net/isobus/pGNAndSPN/14311?type=PGN)";
CM_ BO_ 2147548461  "Source: isobus.net VDMA Data Dictionary (https://www.isobus.net/isobus/pGNAndSPN/14330?type=PGN)";
CM_ BO_ 2147548462  "Source: isobus.net VDMA Data Dictionary (https://www.isobus.net/isobus/pGNAndSPN/14352?type=PGN)";
CM_ BO_ 2147548463  "Source: isobus.net VDMA Data Dictionary (https://www.isobus.net/isobus/pGNAndSPN/14371?type=PGN)";
CM_ BO_ 2147548464  "Source: isobus.net VDMA Data Dictionary (https://www.isobus.net/isobus/pGNAndSPN/14393?type=PGN)";
CM_ BO_ 2147548465  "Source: isobus.net VDMA Data Dictionary (https://www.isobus.net/isobus/pGNAndSPN/14398?type=PGN)";
CM_ BO_ 2147548467  "Source: isobus.net VDMA Data Dictionary (https://www.isobus.net/isobus/pGNAndSPN/14408?type=PGN)";
CM_ BO_ 2147548468  "Source: isobus.net VDMA Data Dictionary (https://www.isobus.net/isobus/pGNAndSPN/14415?type=PGN)";
CM_ BO_ 2147548469  "Source: isobus.net VDMA Data Dictionary (https://www.isobus.net/isobus/pGNAndSPN/14422?type=PGN)";
CM_ SG_ 2147548168 Vehicle_Electrical_Power_9_RawPa "Generic 8-byte raw payload. Detail page: https://www.isobus.net/isobus/pGNAndSPN/12516?type=PGN. Signal-level enrichment via PR welcome  see CONTRIBUTING.md.";
CM_ SG_ 2147548169 Vehicle_Electrical_Power_8_RawPa "Generic 8-byte raw payload. Detail page: https://www.isobus.net/isobus/pGNAndSPN/12521?type=PGN. Signal-level enrichment via PR welcome  see CONTRIBUTING.md.";
CM_ SG_ 2147548170 Vehicle_Electrical_Power_7_RawPa "Generic 8-byte raw payload. Detail page: https://www.isobus.net/isobus/pGNAndSPN/12524?type=PGN. Signal-level enrichment via PR welcome  see CONTRIBUTING.md.";
CM_ SG_ 2147548171 Electronic_Engine_Controller_20_ "Generic 8-byte raw payload. Detail page: https://www.isobus.net/isobus/pGNAndSPN/12528?type=PGN. Signal-level enrichment via PR welcome  see CONTRIBUTING.md.";
CM_ SG_ 2147548172 Evaporative_Systems_RawPayload "Generic 8-byte raw payload. Detail page: https://www.isobus.net/isobus/pGNAndSPN/12531?type=PGN. Signal-level enrichment via PR welcome  see CONTRIBUTING.md.";
CM_ SG_ 2147548173 Fire_Pump_Statistics_1_RawPayloa "Generic 8-byte raw payload. Detail page: https://www.isobus.net/isobus/pGNAndSPN/12533?type=PGN. Signal-level enrichment via PR welcome  see CONTRIBUTING.md.";
CM_ SG_ 2147548174 Primary_or_Rear_Hitch_Roll_and_P "Generic 8-byte raw payload. Detail page: https://www.isobus.net/isobus/pGNAndSPN/12535?type=PGN. Signal-level enrichment via PR welcome  see CONTRIBUTING.md.";
CM_ SG_ 2147548175 Secondary_or_Front_Hitch_Roll_an "Generic 8-byte raw payload. Detail page: https://www.isobus.net/isobus/pGNAndSPN/12537?type=PGN. Signal-level enrichment via PR welcome  see CONTRIBUTING.md.";
CM_ SG_ 2147548176 Ambient_Conditions_3_RawPayload "Generic 8-byte raw payload. Detail page: https://www.isobus.net/isobus/pGNAndSPN/12540?type=PGN. Signal-level enrichment via PR welcome  see CONTRIBUTING.md.";
CM_ SG_ 2147548177 Total_Gaseous_Fuel_Information_R "Generic 8-byte raw payload. Detail page: https://www.isobus.net/isobus/pGNAndSPN/12542?type=PGN. Signal-level enrichment via PR welcome  see CONTRIBUTING.md.";
CM_ SG_ 2147548178 Cab_Door_Control_1_RawPayload "Generic 8-byte raw payload. Detail page: https://www.isobus.net/isobus/pGNAndSPN/12562?type=PGN. Signal-level enrichment via PR welcome  see CONTRIBUTING.md.";
CM_ SG_ 2147548179 Door_Latch_Status_RawPayload "Generic 8-byte raw payload. Detail page: https://www.isobus.net/isobus/pGNAndSPN/12566?type=PGN. Signal-level enrichment via PR welcome  see CONTRIBUTING.md.";
CM_ SG_ 2147548180 Vehicle_Electrical_Power_3_obsol "Generic 8-byte raw payload. Detail page: https://www.isobus.net/isobus/pGNAndSPN/12567?type=PGN. Signal-level enrichment via PR welcome  see CONTRIBUTING.md.";
CM_ SG_ 2147548181 Vehicle_Electrical_Power_6_RawPa "Generic 8-byte raw payload. Detail page: https://www.isobus.net/isobus/pGNAndSPN/12571?type=PGN. Signal-level enrichment via PR welcome  see CONTRIBUTING.md.";
CM_ SG_ 2147548182 Payload_Temperature_2_RawPayload "Generic 8-byte raw payload. Detail page: https://www.isobus.net/isobus/pGNAndSPN/12572?type=PGN. Signal-level enrichment via PR welcome  see CONTRIBUTING.md.";
CM_ SG_ 2147548183 Payload_Temperature_1_RawPayload "Generic 8-byte raw payload. Detail page: https://www.isobus.net/isobus/pGNAndSPN/12576?type=PGN. Signal-level enrichment via PR welcome  see CONTRIBUTING.md.";
CM_ SG_ 2147548184 Payload_System_Totals_2_RawPaylo "Generic 8-byte raw payload. Detail page: https://www.isobus.net/isobus/pGNAndSPN/12577?type=PGN. Signal-level enrichment via PR welcome  see CONTRIBUTING.md.";
CM_ SG_ 2147548185 Payload_System_Totals_1_RawPaylo "Generic 8-byte raw payload. Detail page: https://www.isobus.net/isobus/pGNAndSPN/12579?type=PGN. Signal-level enrichment via PR welcome  see CONTRIBUTING.md.";
CM_ SG_ 2147548186 HVESS_Thermal_Management_System_ "Generic 8-byte raw payload. Detail page: https://www.isobus.net/isobus/pGNAndSPN/12585?type=PGN. Signal-level enrichment via PR welcome  see CONTRIBUTING.md.";
CM_ SG_ 2147548187 HVESS_Thermal_Management_System_ "Generic 8-byte raw payload. Detail page: https://www.isobus.net/isobus/pGNAndSPN/12589?type=PGN. Signal-level enrichment via PR welcome  see CONTRIBUTING.md.";
CM_ SG_ 2147548188 Refrigeration_Compartment_Inform "Generic 8-byte raw payload. Detail page: https://www.isobus.net/isobus/pGNAndSPN/12593?type=PGN. Signal-level enrichment via PR welcome  see CONTRIBUTING.md.";
CM_ SG_ 2147548189 Refrigeration_Compartment_Inform "Generic 8-byte raw payload. Detail page: https://www.isobus.net/isobus/pGNAndSPN/12595?type=PGN. Signal-level enrichment via PR welcome  see CONTRIBUTING.md.";
CM_ SG_ 2147548190 Vehicle_Electrical_Power_16_RawP "Generic 8-byte raw payload. Detail page: https://www.isobus.net/isobus/pGNAndSPN/12599?type=PGN. Signal-level enrichment via PR welcome  see CONTRIBUTING.md.";
CM_ SG_ 2147548191 Vehicle_Electrical_Power_17_RawP "Generic 8-byte raw payload. Detail page: https://www.isobus.net/isobus/pGNAndSPN/12603?type=PGN. Signal-level enrichment via PR welcome  see CONTRIBUTING.md.";
CM_ SG_ 2147548192 High_Voltage_Energy_Storage_Syst "Generic 8-byte raw payload. Detail page: https://www.isobus.net/isobus/pGNAndSPN/12635?type=PGN. Signal-level enrichment via PR welcome  see CONTRIBUTING.md.";
CM_ SG_ 2147548193 High_Voltage_Energy_Storage_Syst "Generic 8-byte raw payload. Detail page: https://www.isobus.net/isobus/pGNAndSPN/12667?type=PGN. Signal-level enrichment via PR welcome  see CONTRIBUTING.md.";
CM_ SG_ 2147548194 Electronic_Engine_Controller_19_ "Generic 8-byte raw payload. Detail page: https://www.isobus.net/isobus/pGNAndSPN/12669?type=PGN. Signal-level enrichment via PR welcome  see CONTRIBUTING.md.";
CM_ SG_ 2147548195 Fuel_Consumption_Liquid_2_RawPay "Generic 8-byte raw payload. Detail page: https://www.isobus.net/isobus/pGNAndSPN/12670?type=PGN. Signal-level enrichment via PR welcome  see CONTRIBUTING.md.";
CM_ SG_ 2147548196 Aftertreatment_2_Diesel_Exhaust_ "Generic 8-byte raw payload. Detail page: https://www.isobus.net/isobus/pGNAndSPN/12673?type=PGN. Signal-level enrichment via PR welcome  see CONTRIBUTING.md.";
CM_ SG_ 2147548197 Aftertreatment_1_Diesel_Exhaust_ "Generic 8-byte raw payload. Detail page: https://www.isobus.net/isobus/pGNAndSPN/12676?type=PGN. Signal-level enrichment via PR welcome  see CONTRIBUTING.md.";
CM_ SG_ 2147548198 Aftertreatment_2_Diesel_Exhaust_ "Generic 8-byte raw payload. Detail page: https://www.isobus.net/isobus/pGNAndSPN/12678?type=PGN. Signal-level enrichment via PR welcome  see CONTRIBUTING.md.";
CM_ SG_ 2147548199 Aftertreatment_1_Diesel_Exhaust_ "Generic 8-byte raw payload. Detail page: https://www.isobus.net/isobus/pGNAndSPN/12680?type=PGN. Signal-level enrichment via PR welcome  see CONTRIBUTING.md.";
CM_ SG_ 2147548200 Cruise_Control_Vehicle_Speed_6_R "Generic 8-byte raw payload. Detail page: https://www.isobus.net/isobus/pGNAndSPN/12685?type=PGN. Signal-level enrichment via PR welcome  see CONTRIBUTING.md.";
CM_ SG_ 2147548201 Forward_Lane_Image_3_RawPayload "Generic 8-byte raw payload. Detail page: https://www.isobus.net/isobus/pGNAndSPN/12694?type=PGN. Signal-level enrichment via PR welcome  see CONTRIBUTING.md.";
CM_ SG_ 2147548202 Operator_Inducement_Information_ "Generic 8-byte raw payload. Detail page: https://www.isobus.net/isobus/pGNAndSPN/12699?type=PGN. Signal-level enrichment via PR welcome  see CONTRIBUTING.md.";
CM_ SG_ 2147548203 Cruise_Control_Vehicle_Speed_4_R "Generic 8-byte raw payload. Detail page: https://www.isobus.net/isobus/pGNAndSPN/12703?type=PGN. Signal-level enrichment via PR welcome  see CONTRIBUTING.md.";
CM_ SG_ 2147548204 Brake_Caliper_Lining_Clearance_R "Generic 8-byte raw payload. Detail page: https://www.isobus.net/isobus/pGNAndSPN/12723?type=PGN. Signal-level enrichment via PR welcome  see CONTRIBUTING.md.";
CM_ SG_ 2147548205 Alternate_Fuel_5_RawPayload "Generic 8-byte raw payload. Detail page: https://www.isobus.net/isobus/pGNAndSPN/12727?type=PGN. Signal-level enrichment via PR welcome  see CONTRIBUTING.md.";
CM_ SG_ 2147548206 Engine_Turbocharger_Control_3_Ra "Generic 8-byte raw payload. Detail page: https://www.isobus.net/isobus/pGNAndSPN/12734?type=PGN. Signal-level enrichment via PR welcome  see CONTRIBUTING.md.";
CM_ SG_ 2147548207 Fire_Suppression_Agent_Status_Ra "Generic 8-byte raw payload. Detail page: https://www.isobus.net/isobus/pGNAndSPN/12738?type=PGN. Signal-level enrichment via PR welcome  see CONTRIBUTING.md.";
CM_ SG_ 2147548208 SCR_Operator_Inducement_Informat "Generic 8-byte raw payload. Detail page: https://www.isobus.net/isobus/pGNAndSPN/12742?type=PGN. Signal-level enrichment via PR welcome  see CONTRIBUTING.md.";
CM_ SG_ 2147548209 Aftertreatment_System_Informatio "Generic 8-byte raw payload. Detail page: https://www.isobus.net/isobus/pGNAndSPN/12755?type=PGN. Signal-level enrichment via PR welcome  see CONTRIBUTING.md.";
CM_ SG_ 2147548210 Aftertreatment_1_Particulate_Sen "Generic 8-byte raw payload. Detail page: https://www.isobus.net/isobus/pGNAndSPN/12765?type=PGN. Signal-level enrichment via PR welcome  see CONTRIBUTING.md.";
CM_ SG_ 2147548211 Engine_Fuel_Injector_Metering_Ra "Generic 8-byte raw payload. Detail page: https://www.isobus.net/isobus/pGNAndSPN/12767?type=PGN. Signal-level enrichment via PR welcome  see CONTRIBUTING.md.";
CM_ SG_ 2147548212 Engine_Fuel_Injector_Metering_Ra "Generic 8-byte raw payload. Detail page: https://www.isobus.net/isobus/pGNAndSPN/12771?type=PGN. Signal-level enrichment via PR welcome  see CONTRIBUTING.md.";
CM_ SG_ 2147548213 Aftertreatment_2_Diesel_Exhaust_ "Generic 8-byte raw payload. Detail page: https://www.isobus.net/isobus/pGNAndSPN/12773?type=PGN. Signal-level enrichment via PR welcome  see CONTRIBUTING.md.";
CM_ SG_ 2147548214 Gaseous_Fuel_Supply_Valve_Inform "Generic 8-byte raw payload. Detail page: https://www.isobus.net/isobus/pGNAndSPN/12779?type=PGN. Signal-level enrichment via PR welcome  see CONTRIBUTING.md.";
CM_ SG_ 2147548215 Engine_Oil_Mist_Detection_Inform "Generic 8-byte raw payload. Detail page: https://www.isobus.net/isobus/pGNAndSPN/12781?type=PGN. Signal-level enrichment via PR welcome  see CONTRIBUTING.md.";
CM_ SG_ 2147548216 Engine_Oil_Mist_Detection_Inform "Generic 8-byte raw payload. Detail page: https://www.isobus.net/isobus/pGNAndSPN/12789?type=PGN. Signal-level enrichment via PR welcome  see CONTRIBUTING.md.";
CM_ SG_ 2147548217 Gaseous_Fuel_Supply_Pressure_2_R "Generic 8-byte raw payload. Detail page: https://www.isobus.net/isobus/pGNAndSPN/12791?type=PGN. Signal-level enrichment via PR welcome  see CONTRIBUTING.md.";
CM_ SG_ 2147548218 Gaseous_Fuel_Supply_Pressure_1_R "Generic 8-byte raw payload. Detail page: https://www.isobus.net/isobus/pGNAndSPN/12795?type=PGN. Signal-level enrichment via PR welcome  see CONTRIBUTING.md.";
CM_ SG_ 2147548219 Engine_End_Bearing_Temperature_3 "Generic 8-byte raw payload. Detail page: https://www.isobus.net/isobus/pGNAndSPN/12799?type=PGN. Signal-level enrichment via PR welcome  see CONTRIBUTING.md.";
CM_ SG_ 2147548220 Engine_End_Bearing_Temperature_2 "Generic 8-byte raw payload. Detail page: https://www.isobus.net/isobus/pGNAndSPN/12807?type=PGN. Signal-level enrichment via PR welcome  see CONTRIBUTING.md.";
CM_ SG_ 2147548221 Engine_End_Bearing_Temperature_1 "Generic 8-byte raw payload. Detail page: https://www.isobus.net/isobus/pGNAndSPN/12815?type=PGN. Signal-level enrichment via PR welcome  see CONTRIBUTING.md.";
CM_ SG_ 2147548222 Heat_Exchanger_Debris_Purge_Info "Generic 8-byte raw payload. Detail page: https://www.isobus.net/isobus/pGNAndSPN/12817?type=PGN. Signal-level enrichment via PR welcome  see CONTRIBUTING.md.";
CM_ SG_ 2147548223 Engine_Turbocharger_Control_2_Ra "Generic 8-byte raw payload. Detail page: https://www.isobus.net/isobus/pGNAndSPN/12819?type=PGN. Signal-level enrichment via PR welcome  see CONTRIBUTING.md.";
CM_ SG_ 2147548224 Engine_Hydraulic_Fuel_2_Pump_Sta "Generic 8-byte raw payload. Detail page: https://www.isobus.net/isobus/pGNAndSPN/12823?type=PGN. Signal-level enrichment via PR welcome  see CONTRIBUTING.md.";
CM_ SG_ 2147548225 Alternate_Fuel_4_RawPayload "Generic 8-byte raw payload. Detail page: https://www.isobus.net/isobus/pGNAndSPN/12828?type=PGN. Signal-level enrichment via PR welcome  see CONTRIBUTING.md.";
CM_ SG_ 2147548226 Tire_Condition_Message_2_RawPayl "Generic 8-byte raw payload. Detail page: https://www.isobus.net/isobus/pGNAndSPN/12831?type=PGN. Signal-level enrichment via PR welcome  see CONTRIBUTING.md.";
CM_ SG_ 2147548227 Tire_Configuration_Status_Inform "Generic 8-byte raw payload. Detail page: https://www.isobus.net/isobus/pGNAndSPN/12837?type=PGN. Signal-level enrichment via PR welcome  see CONTRIBUTING.md.";
CM_ SG_ 2147548228 High_Voltage_Energy_Storage_Syst "Generic 8-byte raw payload. Detail page: https://www.isobus.net/isobus/pGNAndSPN/12839?type=PGN. Signal-level enrichment via PR welcome  see CONTRIBUTING.md.";
CM_ SG_ 2147548229 Tire_Wireless_Signal_Strength_In "Generic 8-byte raw payload. Detail page: https://www.isobus.net/isobus/pGNAndSPN/12845?type=PGN. Signal-level enrichment via PR welcome  see CONTRIBUTING.md.";
CM_ SG_ 2147548230 Tire_Sensor_Identification_Statu "Generic 8-byte raw payload. Detail page: https://www.isobus.net/isobus/pGNAndSPN/12849?type=PGN. Signal-level enrichment via PR welcome  see CONTRIBUTING.md.";
CM_ SG_ 2147548231 Monitored_Tire_Information_RawPa "Generic 8-byte raw payload. Detail page: https://www.isobus.net/isobus/pGNAndSPN/12863?type=PGN. Signal-level enrichment via PR welcome  see CONTRIBUTING.md.";
CM_ SG_ 2147548232 Aftertreatment_2_Historical_Info "Generic 8-byte raw payload. Detail page: https://www.isobus.net/isobus/pGNAndSPN/12869?type=PGN. Signal-level enrichment via PR welcome  see CONTRIBUTING.md.";
CM_ SG_ 2147548233 Aftertreatment_1_Historical_Info "Generic 8-byte raw payload. Detail page: https://www.isobus.net/isobus/pGNAndSPN/12876?type=PGN. Signal-level enrichment via PR welcome  see CONTRIBUTING.md.";
CM_ SG_ 2147548234 SCR_System_Cleaning_RawPayload "Generic 8-byte raw payload. Detail page: https://www.isobus.net/isobus/pGNAndSPN/12897?type=PGN. Signal-level enrichment via PR welcome  see CONTRIBUTING.md.";
CM_ SG_ 2147548235 Electronic_Engine_Controller_17_ "Generic 8-byte raw payload. Detail page: https://www.isobus.net/isobus/pGNAndSPN/12901?type=PGN. Signal-level enrichment via PR welcome  see CONTRIBUTING.md.";
CM_ SG_ 2147548236 SCR_Operator_Inducement_Informat "Generic 8-byte raw payload. Detail page: https://www.isobus.net/isobus/pGNAndSPN/12905?type=PGN. Signal-level enrichment via PR welcome  see CONTRIBUTING.md.";
CM_ SG_ 2147548237 Aftertreatment_2_SCR_Dosing_Syst "Generic 8-byte raw payload. Detail page: https://www.isobus.net/isobus/pGNAndSPN/12910?type=PGN. Signal-level enrichment via PR welcome  see CONTRIBUTING.md.";
CM_ SG_ 2147548238 Aftertreatment_1_SCR_Dosing_Syst "Generic 8-byte raw payload. Detail page: https://www.isobus.net/isobus/pGNAndSPN/12915?type=PGN. Signal-level enrichment via PR welcome  see CONTRIBUTING.md.";
CM_ SG_ 2147548239 Payload_Weight_Sensor_Informatio "Generic 8-byte raw payload. Detail page: https://www.isobus.net/isobus/pGNAndSPN/12923?type=PGN. Signal-level enrichment via PR welcome  see CONTRIBUTING.md.";
CM_ SG_ 2147548240 Payload_System_Status_RawPayload "Generic 8-byte raw payload. Detail page: https://www.isobus.net/isobus/pGNAndSPN/12928?type=PGN. Signal-level enrichment via PR welcome  see CONTRIBUTING.md.";
CM_ SG_ 2147548241 Air_Suspension_Control_7_RawPayl "Generic 8-byte raw payload. Detail page: https://www.isobus.net/isobus/pGNAndSPN/12932?type=PGN. Signal-level enrichment via PR welcome  see CONTRIBUTING.md.";
CM_ SG_ 2147548242 Bin_Weight_and_Lift_Count_RawPay "Generic 8-byte raw payload. Detail page: https://www.isobus.net/isobus/pGNAndSPN/12936?type=PGN. Signal-level enrichment via PR welcome  see CONTRIBUTING.md.";
CM_ SG_ 2147548243 Engine_Gaseous_Leakage_Informati "Generic 8-byte raw payload. Detail page: https://www.isobus.net/isobus/pGNAndSPN/12942?type=PGN. Signal-level enrichment via PR welcome  see CONTRIBUTING.md.";
CM_ SG_ 2147548244 Driving_and_Rest_Times_Driver_2_ "Generic 8-byte raw payload. Detail page: https://www.isobus.net/isobus/pGNAndSPN/12943?type=PGN. Signal-level enrichment via PR welcome  see CONTRIBUTING.md.";
CM_ SG_ 2147548245 Driving_and_Rest_Times_Driver_1_ "Generic 8-byte raw payload. Detail page: https://www.isobus.net/isobus/pGNAndSPN/12944?type=PGN. Signal-level enrichment via PR welcome  see CONTRIBUTING.md.";
CM_ SG_ 2147548246 SCR_Operator_Inducement_Informat "Generic 8-byte raw payload. Detail page: https://www.isobus.net/isobus/pGNAndSPN/12946?type=PGN. Signal-level enrichment via PR welcome  see CONTRIBUTING.md.";
CM_ SG_ 2147548247 SCR_Operator_Inducement_Informat "Generic 8-byte raw payload. Detail page: https://www.isobus.net/isobus/pGNAndSPN/12948?type=PGN. Signal-level enrichment via PR welcome  see CONTRIBUTING.md.";
CM_ SG_ 2147548248 Turbocharger_Information_7_RawPa "Generic 8-byte raw payload. Detail page: https://www.isobus.net/isobus/pGNAndSPN/12953?type=PGN. Signal-level enrichment via PR welcome  see CONTRIBUTING.md.";
CM_ SG_ 2147548249 Engine_Load_Sharing_Information_ "Generic 8-byte raw payload. Detail page: https://www.isobus.net/isobus/pGNAndSPN/12956?type=PGN. Signal-level enrichment via PR welcome  see CONTRIBUTING.md.";
CM_ SG_ 2147548250 Synchronized_Service_Distance_In "Generic 8-byte raw payload. Detail page: https://www.isobus.net/isobus/pGNAndSPN/12958?type=PGN. Signal-level enrichment via PR welcome  see CONTRIBUTING.md.";
CM_ SG_ 2147548251 Synchronized_Service_Delay_Opera "Generic 8-byte raw payload. Detail page: https://www.isobus.net/isobus/pGNAndSPN/12960?type=PGN. Signal-level enrichment via PR welcome  see CONTRIBUTING.md.";
CM_ SG_ 2147548252 Synchronized_Service_Delay_Calen "Generic 8-byte raw payload. Detail page: https://www.isobus.net/isobus/pGNAndSPN/12962?type=PGN. Signal-level enrichment via PR welcome  see CONTRIBUTING.md.";
CM_ SG_ 2147548253 High_Voltage_Energy_Storage_Syst "Generic 8-byte raw payload. Detail page: https://www.isobus.net/isobus/pGNAndSPN/12973?type=PGN. Signal-level enrichment via PR welcome  see CONTRIBUTING.md.";
CM_ SG_ 2147548254 High_Voltage_Energy_Storage_Syst "Generic 8-byte raw payload. Detail page: https://www.isobus.net/isobus/pGNAndSPN/12979?type=PGN. Signal-level enrichment via PR welcome  see CONTRIBUTING.md.";
CM_ SG_ 2147548255 Encoder_Position_RawPayload "Generic 8-byte raw payload. Detail page: https://www.isobus.net/isobus/pGNAndSPN/12980?type=PGN. Signal-level enrichment via PR welcome  see CONTRIBUTING.md.";
CM_ SG_ 2147548256 Encoder_High_Resolution_Position "Generic 8-byte raw payload. Detail page: https://www.isobus.net/isobus/pGNAndSPN/12981?type=PGN. Signal-level enrichment via PR welcome  see CONTRIBUTING.md.";
CM_ SG_ 2147548257 Encoder_Speed_RawPayload "Generic 8-byte raw payload. Detail page: https://www.isobus.net/isobus/pGNAndSPN/12982?type=PGN. Signal-level enrichment via PR welcome  see CONTRIBUTING.md.";
CM_ SG_ 2147548258 Encoder_Acceleration_RawPayload "Generic 8-byte raw payload. Detail page: https://www.isobus.net/isobus/pGNAndSPN/12983?type=PGN. Signal-level enrichment via PR welcome  see CONTRIBUTING.md.";
CM_ SG_ 2147548259 Encoder_Position_with_Speed_and_ "Generic 8-byte raw payload. Detail page: https://www.isobus.net/isobus/pGNAndSPN/12984?type=PGN. Signal-level enrichment via PR welcome  see CONTRIBUTING.md.";
CM_ SG_ 2147548260 Inclinometer_Slope_Longitudinal_ "Generic 8-byte raw payload. Detail page: https://www.isobus.net/isobus/pGNAndSPN/12985?type=PGN. Signal-level enrichment via PR welcome  see CONTRIBUTING.md.";
CM_ SG_ 2147548261 Inclinometer_Slope_Longitudinal_ "Generic 8-byte raw payload. Detail page: https://www.isobus.net/isobus/pGNAndSPN/12986?type=PGN. Signal-level enrichment via PR welcome  see CONTRIBUTING.md.";
CM_ SG_ 2147548262 Inclinometer_Slope_Lateral_16_bi "Generic 8-byte raw payload. Detail page: https://www.isobus.net/isobus/pGNAndSPN/12987?type=PGN. Signal-level enrichment via PR welcome  see CONTRIBUTING.md.";
CM_ SG_ 2147548263 Inclinometer_Slope_Lateral_32_bi "Generic 8-byte raw payload. Detail page: https://www.isobus.net/isobus/pGNAndSPN/12988?type=PGN. Signal-level enrichment via PR welcome  see CONTRIBUTING.md.";
CM_ SG_ 2147548264 CANopen_Emergency_Message_RawPay "Generic 8-byte raw payload. Detail page: https://www.isobus.net/isobus/pGNAndSPN/12989?type=PGN. Signal-level enrichment via PR welcome  see CONTRIBUTING.md.";
CM_ SG_ 2147548265 EV_Operator_Indicators_1_RawPayl "Generic 8-byte raw payload. Detail page: https://www.isobus.net/isobus/pGNAndSPN/12990?type=PGN. Signal-level enrichment via PR welcome  see CONTRIBUTING.md.";
CM_ SG_ 2147548266 System_Identification_RawPayload "Generic 8-byte raw payload. Detail page: https://www.isobus.net/isobus/pGNAndSPN/12994?type=PGN. Signal-level enrichment via PR welcome  see CONTRIBUTING.md.";
CM_ SG_ 2147548267 Engine_Maximum_Net_Torque_Map_ob "Generic 8-byte raw payload. Detail page: https://www.isobus.net/isobus/pGNAndSPN/12995?type=PGN. Signal-level enrichment via PR welcome  see CONTRIBUTING.md.";
CM_ SG_ 2147548268 Alarm_RawPayload "Generic 8-byte raw payload. Detail page: https://www.isobus.net/isobus/pGNAndSPN/12996?type=PGN. Signal-level enrichment via PR welcome  see CONTRIBUTING.md.";
CM_ SG_ 2147548269 Acoustic_Warning_Request_RawPayl "Generic 8-byte raw payload. Detail page: https://www.isobus.net/isobus/pGNAndSPN/12997?type=PGN. Signal-level enrichment via PR welcome  see CONTRIBUTING.md.";
CM_ SG_ 2147548270 Acoustic_Warning_State_RawPayloa "Generic 8-byte raw payload. Detail page: https://www.isobus.net/isobus/pGNAndSPN/12998?type=PGN. Signal-level enrichment via PR welcome  see CONTRIBUTING.md.";
CM_ SG_ 2147548271 Vehicle_Load_RawPayload "Generic 8-byte raw payload. Detail page: https://www.isobus.net/isobus/pGNAndSPN/12999?type=PGN. Signal-level enrichment via PR welcome  see CONTRIBUTING.md.";
CM_ SG_ 2147548272 Body_Application_Unit_1_RawPaylo "Generic 8-byte raw payload. Detail page: https://www.isobus.net/isobus/pGNAndSPN/13000?type=PGN. Signal-level enrichment via PR welcome  see CONTRIBUTING.md.";
CM_ SG_ 2147548273 Body_Application_Unit_2_RawPaylo "Generic 8-byte raw payload. Detail page: https://www.isobus.net/isobus/pGNAndSPN/13001?type=PGN. Signal-level enrichment via PR welcome  see CONTRIBUTING.md.";
CM_ SG_ 2147548274 Body_Application_Unit_3_RawPaylo "Generic 8-byte raw payload. Detail page: https://www.isobus.net/isobus/pGNAndSPN/13002?type=PGN. Signal-level enrichment via PR welcome  see CONTRIBUTING.md.";
CM_ SG_ 2147548275 Body_Application_Unit_4_RawPaylo "Generic 8-byte raw payload. Detail page: https://www.isobus.net/isobus/pGNAndSPN/13003?type=PGN. Signal-level enrichment via PR welcome  see CONTRIBUTING.md.";
CM_ SG_ 2147548276 Body_Application_Unit_5_RawPaylo "Generic 8-byte raw payload. Detail page: https://www.isobus.net/isobus/pGNAndSPN/13004?type=PGN. Signal-level enrichment via PR welcome  see CONTRIBUTING.md.";
CM_ SG_ 2147548277 Body_Application_Unit_6_RawPaylo "Generic 8-byte raw payload. Detail page: https://www.isobus.net/isobus/pGNAndSPN/13005?type=PGN. Signal-level enrichment via PR welcome  see CONTRIBUTING.md.";
CM_ SG_ 2147548278 Body_Application_Unit_7_RawPaylo "Generic 8-byte raw payload. Detail page: https://www.isobus.net/isobus/pGNAndSPN/13006?type=PGN. Signal-level enrichment via PR welcome  see CONTRIBUTING.md.";
CM_ SG_ 2147548279 Body_Application_Unit_8_RawPaylo "Generic 8-byte raw payload. Detail page: https://www.isobus.net/isobus/pGNAndSPN/13007?type=PGN. Signal-level enrichment via PR welcome  see CONTRIBUTING.md.";
CM_ SG_ 2147548280 Electronic_Control_Unit_RawPaylo "Generic 8-byte raw payload. Detail page: https://www.isobus.net/isobus/pGNAndSPN/13008?type=PGN. Signal-level enrichment via PR welcome  see CONTRIBUTING.md.";
CM_ SG_ 2147548281 ECU_Power_Supply_RawPayload "Generic 8-byte raw payload. Detail page: https://www.isobus.net/isobus/pGNAndSPN/13009?type=PGN. Signal-level enrichment via PR welcome  see CONTRIBUTING.md.";
CM_ SG_ 2147548282 ECU_Temperature_RawPayload "Generic 8-byte raw payload. Detail page: https://www.isobus.net/isobus/pGNAndSPN/13010?type=PGN. Signal-level enrichment via PR welcome  see CONTRIBUTING.md.";
CM_ SG_ 2147548283 Error_RawPayload "Generic 8-byte raw payload. Detail page: https://www.isobus.net/isobus/pGNAndSPN/13011?type=PGN. Signal-level enrichment via PR welcome  see CONTRIBUTING.md.";
CM_ SG_ 2147548284 Heating_And_Refrigerating_Unit_1 "Generic 8-byte raw payload. Detail page: https://www.isobus.net/isobus/pGNAndSPN/13012?type=PGN. Signal-level enrichment via PR welcome  see CONTRIBUTING.md.";
CM_ SG_ 2147548285 Heating_And_Refrigerating_Unit_2 "Generic 8-byte raw payload. Detail page: https://www.isobus.net/isobus/pGNAndSPN/13013?type=PGN. Signal-level enrichment via PR welcome  see CONTRIBUTING.md.";
CM_ SG_ 2147548286 Heating_And_Refrigerating_Unit_3 "Generic 8-byte raw payload. Detail page: https://www.isobus.net/isobus/pGNAndSPN/13014?type=PGN. Signal-level enrichment via PR welcome  see CONTRIBUTING.md.";
CM_ SG_ 2147548287 Heating_And_Refrigerating_Unit_4 "Generic 8-byte raw payload. Detail page: https://www.isobus.net/isobus/pGNAndSPN/13015?type=PGN. Signal-level enrichment via PR welcome  see CONTRIBUTING.md.";
CM_ SG_ 2147548288 HRU_Temperature_Setpoint_RawPayl "Generic 8-byte raw payload. Detail page: https://www.isobus.net/isobus/pGNAndSPN/13016?type=PGN. Signal-level enrichment via PR welcome  see CONTRIBUTING.md.";
CM_ SG_ 2147548289 Lifting_Unit_1_RawPayload "Generic 8-byte raw payload. Detail page: https://www.isobus.net/isobus/pGNAndSPN/13017?type=PGN. Signal-level enrichment via PR welcome  see CONTRIBUTING.md.";
CM_ SG_ 2147548290 Tail_Lift_Unit_1_RawPayload "Generic 8-byte raw payload. Detail page: https://www.isobus.net/isobus/pGNAndSPN/13018?type=PGN. Signal-level enrichment via PR welcome  see CONTRIBUTING.md.";
CM_ SG_ 2147548291 Vehicle_Status_RawPayload "Generic 8-byte raw payload. Detail page: https://www.isobus.net/isobus/pGNAndSPN/13019?type=PGN. Signal-level enrichment via PR welcome  see CONTRIBUTING.md.";
CM_ SG_ 2147548292 Windshield_Wiper_Request_RawPayl "Generic 8-byte raw payload. Detail page: https://www.isobus.net/isobus/pGNAndSPN/13020?type=PGN. Signal-level enrichment via PR welcome  see CONTRIBUTING.md.";
CM_ SG_ 2147548293 Fuel_Cell_Auxiliary_Heater_Contr "Generic 8-byte raw payload. Detail page: https://www.isobus.net/isobus/pGNAndSPN/13023?type=PGN. Signal-level enrichment via PR welcome  see CONTRIBUTING.md.";
CM_ SG_ 2147548294 Fuel_Cell_Auxiliary_Heater_Infor "Generic 8-byte raw payload. Detail page: https://www.isobus.net/isobus/pGNAndSPN/13028?type=PGN. Signal-level enrichment via PR welcome  see CONTRIBUTING.md.";
CM_ SG_ 2147548295 Fuel_Cell_Coolant_Pump_1_Command "Generic 8-byte raw payload. Detail page: https://www.isobus.net/isobus/pGNAndSPN/13031?type=PGN. Signal-level enrichment via PR welcome  see CONTRIBUTING.md.";
CM_ SG_ 2147548296 Fuel_Cell_Coolant_Pump_2_Command "Generic 8-byte raw payload. Detail page: https://www.isobus.net/isobus/pGNAndSPN/13034?type=PGN. Signal-level enrichment via PR welcome  see CONTRIBUTING.md.";
CM_ SG_ 2147548297 Fuel_Cell_Coolant_Pump_1_Status_ "Generic 8-byte raw payload. Detail page: https://www.isobus.net/isobus/pGNAndSPN/13038?type=PGN. Signal-level enrichment via PR welcome  see CONTRIBUTING.md.";
CM_ SG_ 2147548298 Fuel_Cell_Coolant_Pump_2_Status_ "Generic 8-byte raw payload. Detail page: https://www.isobus.net/isobus/pGNAndSPN/13042?type=PGN. Signal-level enrichment via PR welcome  see CONTRIBUTING.md.";
CM_ SG_ 2147548299 Aftertreatment_1_Particulate_Sen "Generic 8-byte raw payload. Detail page: https://www.isobus.net/isobus/pGNAndSPN/13048?type=PGN. Signal-level enrichment via PR welcome  see CONTRIBUTING.md.";
CM_ SG_ 2147548300 Aftertreatment_1_Particulate_Sen "Generic 8-byte raw payload. Detail page: https://www.isobus.net/isobus/pGNAndSPN/13054?type=PGN. Signal-level enrichment via PR welcome  see CONTRIBUTING.md.";
CM_ SG_ 2147548303 Alternate_Fuel_3_RawPayload "Generic 8-byte raw payload. Detail page: https://www.isobus.net/isobus/pGNAndSPN/13067?type=PGN. Signal-level enrichment via PR welcome  see CONTRIBUTING.md.";
CM_ SG_ 2147548304 Engine_Fuel_Injector_Metering_Ra "Generic 8-byte raw payload. Detail page: https://www.isobus.net/isobus/pGNAndSPN/13071?type=PGN. Signal-level enrichment via PR welcome  see CONTRIBUTING.md.";
CM_ SG_ 2147548305 Engine_Exhaust_NOx_RawPayload "Generic 8-byte raw payload. Detail page: https://www.isobus.net/isobus/pGNAndSPN/13074?type=PGN. Signal-level enrichment via PR welcome  see CONTRIBUTING.md.";
CM_ SG_ 2147548306 Air_Fuel_Ratio_1_RawPayload "Generic 8-byte raw payload. Detail page: https://www.isobus.net/isobus/pGNAndSPN/13078?type=PGN. Signal-level enrichment via PR welcome  see CONTRIBUTING.md.";
CM_ SG_ 2147548307 Gaseous_Fuel_Pressure_2_RawPaylo "Generic 8-byte raw payload. Detail page: https://www.isobus.net/isobus/pGNAndSPN/13082?type=PGN. Signal-level enrichment via PR welcome  see CONTRIBUTING.md.";
CM_ SG_ 2147548308 Aftertreatment_System_Abuse_Info "Generic 8-byte raw payload. Detail page: https://www.isobus.net/isobus/pGNAndSPN/13089?type=PGN. Signal-level enrichment via PR welcome  see CONTRIBUTING.md.";
CM_ SG_ 2147548309 Engine_Cylinder_Pressure_Monitor "Generic 8-byte raw payload. Detail page: https://www.isobus.net/isobus/pGNAndSPN/13091?type=PGN. Signal-level enrichment via PR welcome  see CONTRIBUTING.md.";
CM_ SG_ 2147548310 Engine_Information_2_RawPayload "Generic 8-byte raw payload. Detail page: https://www.isobus.net/isobus/pGNAndSPN/13096?type=PGN. Signal-level enrichment via PR welcome  see CONTRIBUTING.md.";
CM_ SG_ 2147548311 Electronic_Steering_Control_2_Ra "Generic 8-byte raw payload. Detail page: https://www.isobus.net/isobus/pGNAndSPN/13108?type=PGN. Signal-level enrichment via PR welcome  see CONTRIBUTING.md.";
CM_ SG_ 2147548312 Vehicle_Speed_Limiter_RawPayload "Generic 8-byte raw payload. Detail page: https://www.isobus.net/isobus/pGNAndSPN/13113?type=PGN. Signal-level enrichment via PR welcome  see CONTRIBUTING.md.";
CM_ SG_ 2147548313 Assembly_Unit_Identification_Raw "Generic 8-byte raw payload. Detail page: https://www.isobus.net/isobus/pGNAndSPN/13115?type=PGN. Signal-level enrichment via PR welcome  see CONTRIBUTING.md.";
CM_ SG_ 2147548314 Joystick_3_Lamp_Status_RawPayloa "Generic 8-byte raw payload. Detail page: https://www.isobus.net/isobus/pGNAndSPN/13125?type=PGN. Signal-level enrichment via PR welcome  see CONTRIBUTING.md.";
CM_ SG_ 2147548315 Joystick_2_Lamp_Status_RawPayloa "Generic 8-byte raw payload. Detail page: https://www.isobus.net/isobus/pGNAndSPN/13135?type=PGN. Signal-level enrichment via PR welcome  see CONTRIBUTING.md.";
CM_ SG_ 2147548316 Joystick_1_Lamp_Status_RawPayloa "Generic 8-byte raw payload. Detail page: https://www.isobus.net/isobus/pGNAndSPN/13145?type=PGN. Signal-level enrichment via PR welcome  see CONTRIBUTING.md.";
CM_ SG_ 2147548317 Engine_Timing_Actuator_Position_ "Generic 8-byte raw payload. Detail page: https://www.isobus.net/isobus/pGNAndSPN/13147?type=PGN. Signal-level enrichment via PR welcome  see CONTRIBUTING.md.";
CM_ SG_ 2147548318 Engine_Timing_Actuator_Position_ "Generic 8-byte raw payload. Detail page: https://www.isobus.net/isobus/pGNAndSPN/13151?type=PGN. Signal-level enrichment via PR welcome  see CONTRIBUTING.md.";
CM_ SG_ 2147548319 Dash_Display_2_RawPayload "Generic 8-byte raw payload. Detail page: https://www.isobus.net/isobus/pGNAndSPN/13158?type=PGN. Signal-level enrichment via PR welcome  see CONTRIBUTING.md.";
CM_ SG_ 2147548320 Multi_fuel_Engine_Hours_RawPaylo "Generic 8-byte raw payload. Detail page: https://www.isobus.net/isobus/pGNAndSPN/13160?type=PGN. Signal-level enrichment via PR welcome  see CONTRIBUTING.md.";
CM_ SG_ 2147548321 Engine_Spark_Misfire_Rate_3_RawP "Generic 8-byte raw payload. Detail page: https://www.isobus.net/isobus/pGNAndSPN/13168?type=PGN. Signal-level enrichment via PR welcome  see CONTRIBUTING.md.";
CM_ SG_ 2147548322 Engine_Spark_Misfire_Rate_2_RawP "Generic 8-byte raw payload. Detail page: https://www.isobus.net/isobus/pGNAndSPN/13176?type=PGN. Signal-level enrichment via PR welcome  see CONTRIBUTING.md.";
CM_ SG_ 2147548323 Engine_Spark_Misfire_Rate_1_RawP "Generic 8-byte raw payload. Detail page: https://www.isobus.net/isobus/pGNAndSPN/13184?type=PGN. Signal-level enrichment via PR welcome  see CONTRIBUTING.md.";
CM_ SG_ 2147548324 Engine_Spark_Maximum_Voltage_6_R "Generic 8-byte raw payload. Detail page: https://www.isobus.net/isobus/pGNAndSPN/13188?type=PGN. Signal-level enrichment via PR welcome  see CONTRIBUTING.md.";
CM_ SG_ 2147548325 Engine_Spark_Maximum_Voltage_5_R "Generic 8-byte raw payload. Detail page: https://www.isobus.net/isobus/pGNAndSPN/13192?type=PGN. Signal-level enrichment via PR welcome  see CONTRIBUTING.md.";
CM_ SG_ 2147548326 Engine_Spark_Maximum_Voltage_4_R "Generic 8-byte raw payload. Detail page: https://www.isobus.net/isobus/pGNAndSPN/13196?type=PGN. Signal-level enrichment via PR welcome  see CONTRIBUTING.md.";
CM_ SG_ 2147548327 Engine_Spark_Maximum_Voltage_3_R "Generic 8-byte raw payload. Detail page: https://www.isobus.net/isobus/pGNAndSPN/13200?type=PGN. Signal-level enrichment via PR welcome  see CONTRIBUTING.md.";
CM_ SG_ 2147548328 Engine_Spark_Maximum_Voltage_2_R "Generic 8-byte raw payload. Detail page: https://www.isobus.net/isobus/pGNAndSPN/13204?type=PGN. Signal-level enrichment via PR welcome  see CONTRIBUTING.md.";
CM_ SG_ 2147548329 Engine_Spark_Maximum_Voltage_1_R "Generic 8-byte raw payload. Detail page: https://www.isobus.net/isobus/pGNAndSPN/13208?type=PGN. Signal-level enrichment via PR welcome  see CONTRIBUTING.md.";
CM_ SG_ 2147548330 Engine_Spark_Minimum_Voltage_6_R "Generic 8-byte raw payload. Detail page: https://www.isobus.net/isobus/pGNAndSPN/13212?type=PGN. Signal-level enrichment via PR welcome  see CONTRIBUTING.md.";
CM_ SG_ 2147548331 Engine_Spark_Minimum_Voltage_5_R "Generic 8-byte raw payload. Detail page: https://www.isobus.net/isobus/pGNAndSPN/13216?type=PGN. Signal-level enrichment via PR welcome  see CONTRIBUTING.md.";
CM_ SG_ 2147548332 Engine_Spark_Minimum_Voltage_4_R "Generic 8-byte raw payload. Detail page: https://www.isobus.net/isobus/pGNAndSPN/13220?type=PGN. Signal-level enrichment via PR welcome  see CONTRIBUTING.md.";
CM_ SG_ 2147548333 Engine_Spark_Minimum_Voltage_3_R "Generic 8-byte raw payload. Detail page: https://www.isobus.net/isobus/pGNAndSPN/13224?type=PGN. Signal-level enrichment via PR welcome  see CONTRIBUTING.md.";
CM_ SG_ 2147548334 Engine_Spark_Minimum_Voltage_2_R "Generic 8-byte raw payload. Detail page: https://www.isobus.net/isobus/pGNAndSPN/13228?type=PGN. Signal-level enrichment via PR welcome  see CONTRIBUTING.md.";
CM_ SG_ 2147548335 Engine_Spark_Minimum_Voltage_1_R "Generic 8-byte raw payload. Detail page: https://www.isobus.net/isobus/pGNAndSPN/13232?type=PGN. Signal-level enrichment via PR welcome  see CONTRIBUTING.md.";
CM_ SG_ 2147548336 Engine_Ignition_Controller_Maint "Generic 8-byte raw payload. Detail page: https://www.isobus.net/isobus/pGNAndSPN/13234?type=PGN. Signal-level enrichment via PR welcome  see CONTRIBUTING.md.";
CM_ SG_ 2147548337 Engine_Ignition_Control_Module_S "Generic 8-byte raw payload. Detail page: https://www.isobus.net/isobus/pGNAndSPN/13238?type=PGN. Signal-level enrichment via PR welcome  see CONTRIBUTING.md.";
CM_ SG_ 2147548339 Fused_Power_Output_Current_RawPa "Generic 8-byte raw payload. Detail page: https://www.isobus.net/isobus/pGNAndSPN/13302?type=PGN. Signal-level enrichment via PR welcome  see CONTRIBUTING.md.";
CM_ SG_ 2147548340 Switched_Power_Output_Status_Raw "Generic 8-byte raw payload. Detail page: https://www.isobus.net/isobus/pGNAndSPN/13334?type=PGN. Signal-level enrichment via PR welcome  see CONTRIBUTING.md.";
CM_ SG_ 2147548341 Fused_Power_Output_Status_RawPay "Generic 8-byte raw payload. Detail page: https://www.isobus.net/isobus/pGNAndSPN/13366?type=PGN. Signal-level enrichment via PR welcome  see CONTRIBUTING.md.";
CM_ SG_ 2147548342 Vehicle_Electrical_Power_5_RawPa "Generic 8-byte raw payload. Detail page: https://www.isobus.net/isobus/pGNAndSPN/13370?type=PGN. Signal-level enrichment via PR welcome  see CONTRIBUTING.md.";
CM_ SG_ 2147548343 Hybrid_or_EV_System_Status_2_Raw "Generic 8-byte raw payload. Detail page: https://www.isobus.net/isobus/pGNAndSPN/13376?type=PGN. Signal-level enrichment via PR welcome  see CONTRIBUTING.md.";
CM_ SG_ 2147548344 Aftertreatment_2_Service_2_RawPa "Generic 8-byte raw payload. Detail page: https://www.isobus.net/isobus/pGNAndSPN/13378?type=PGN. Signal-level enrichment via PR welcome  see CONTRIBUTING.md.";
CM_ SG_ 2147548345 Aftertreatment_1_Service_2_RawPa "Generic 8-byte raw payload. Detail page: https://www.isobus.net/isobus/pGNAndSPN/13380?type=PGN. Signal-level enrichment via PR welcome  see CONTRIBUTING.md.";
CM_ SG_ 2147548346 Aftertreatment_2_SCR_Electronic_ "Generic 8-byte raw payload. Detail page: https://www.isobus.net/isobus/pGNAndSPN/13387?type=PGN. Signal-level enrichment via PR welcome  see CONTRIBUTING.md.";
CM_ SG_ 2147548347 Aftertreatment_1_SCR_Electronic_ "Generic 8-byte raw payload. Detail page: https://www.isobus.net/isobus/pGNAndSPN/13394?type=PGN. Signal-level enrichment via PR welcome  see CONTRIBUTING.md.";
CM_ SG_ 2147548348 Aftertreatment_2_SCR_Service_Inf "Generic 8-byte raw payload. Detail page: https://www.isobus.net/isobus/pGNAndSPN/13395?type=PGN. Signal-level enrichment via PR welcome  see CONTRIBUTING.md.";
CM_ SG_ 2147548349 Aftertreatment_1_SCR_Service_Inf "Generic 8-byte raw payload. Detail page: https://www.isobus.net/isobus/pGNAndSPN/13397?type=PGN. Signal-level enrichment via PR welcome  see CONTRIBUTING.md.";
CM_ SG_ 2147548350 Electronic_Transmission_Controll "Generic 8-byte raw payload. Detail page: https://www.isobus.net/isobus/pGNAndSPN/13401?type=PGN. Signal-level enrichment via PR welcome  see CONTRIBUTING.md.";
CM_ SG_ 2147548351 Electronic_Transmission_Controll "Generic 8-byte raw payload. Detail page: https://www.isobus.net/isobus/pGNAndSPN/13415?type=PGN. Signal-level enrichment via PR welcome  see CONTRIBUTING.md.";
CM_ SG_ 2147548352 Electronic_Transmission_Controll "Generic 8-byte raw payload. Detail page: https://www.isobus.net/isobus/pGNAndSPN/13421?type=PGN. Signal-level enrichment via PR welcome  see CONTRIBUTING.md.";
CM_ SG_ 2147548353 Transmission_Fluids_3_RawPayload "Generic 8-byte raw payload. Detail page: https://www.isobus.net/isobus/pGNAndSPN/13425?type=PGN. Signal-level enrichment via PR welcome  see CONTRIBUTING.md.";
CM_ SG_ 2147548354 Hybrid_or_EV_System_Status_1_Raw "Generic 8-byte raw payload. Detail page: https://www.isobus.net/isobus/pGNAndSPN/13446?type=PGN. Signal-level enrichment via PR welcome  see CONTRIBUTING.md.";
CM_ SG_ 2147548355 Fuel_Information_4_Gaseous_RawPa "Generic 8-byte raw payload. Detail page: https://www.isobus.net/isobus/pGNAndSPN/13448?type=PGN. Signal-level enrichment via PR welcome  see CONTRIBUTING.md.";
CM_ SG_ 2147548356 Aftertreatment_2_SCR_Exhaust_Gas "Generic 8-byte raw payload. Detail page: https://www.isobus.net/isobus/pGNAndSPN/13450?type=PGN. Signal-level enrichment via PR welcome  see CONTRIBUTING.md.";
CM_ SG_ 2147548357 Aftertreatment_1_SCR_Exhaust_Gas "Generic 8-byte raw payload. Detail page: https://www.isobus.net/isobus/pGNAndSPN/13452?type=PGN. Signal-level enrichment via PR welcome  see CONTRIBUTING.md.";
CM_ SG_ 2147548358 OBD_Information_RawPayload "Generic 8-byte raw payload. Detail page: https://www.isobus.net/isobus/pGNAndSPN/13453?type=PGN. Signal-level enrichment via PR welcome  see CONTRIBUTING.md.";
CM_ SG_ 2147548359 Model_Year_and_Certification_Eng "Generic 8-byte raw payload. Detail page: https://www.isobus.net/isobus/pGNAndSPN/13455?type=PGN. Signal-level enrichment via PR welcome  see CONTRIBUTING.md.";
CM_ SG_ 2147548360 Electronic_Engine_Controller_13_ "Generic 8-byte raw payload. Detail page: https://www.isobus.net/isobus/pGNAndSPN/13468?type=PGN. Signal-level enrichment via PR welcome  see CONTRIBUTING.md.";
CM_ SG_ 2147548361 Engine_Fuel_Throttle_Valve_Infor "Generic 8-byte raw payload. Detail page: https://www.isobus.net/isobus/pGNAndSPN/13475?type=PGN. Signal-level enrichment via PR welcome  see CONTRIBUTING.md.";
CM_ SG_ 2147548362 Engine_Exhaust_Gas_Recirculation "Generic 8-byte raw payload. Detail page: https://www.isobus.net/isobus/pGNAndSPN/13485?type=PGN. Signal-level enrichment via PR welcome  see CONTRIBUTING.md.";
CM_ SG_ 2147548363 Engine_Exhaust_Gas_Recirculation "Generic 8-byte raw payload. Detail page: https://www.isobus.net/isobus/pGNAndSPN/13495?type=PGN. Signal-level enrichment via PR welcome  see CONTRIBUTING.md.";
CM_ SG_ 2147548364 Electronic_Engine_Controller_12_ "Generic 8-byte raw payload. Detail page: https://www.isobus.net/isobus/pGNAndSPN/13501?type=PGN. Signal-level enrichment via PR welcome  see CONTRIBUTING.md.";
CM_ SG_ 2147548365 Drive_Strategy_Status_RawPayload "Generic 8-byte raw payload. Detail page: https://www.isobus.net/isobus/pGNAndSPN/13507?type=PGN. Signal-level enrichment via PR welcome  see CONTRIBUTING.md.";
CM_ SG_ 2147548366 Drive_Strategy_command_RawPayloa "Generic 8-byte raw payload. Detail page: https://www.isobus.net/isobus/pGNAndSPN/13512?type=PGN. Signal-level enrichment via PR welcome  see CONTRIBUTING.md.";
CM_ SG_ 2147548367 NOx_Sensor_Self_Diagnosis_Reques "Generic 8-byte raw payload. Detail page: https://www.isobus.net/isobus/pGNAndSPN/13516?type=PGN. Signal-level enrichment via PR welcome  see CONTRIBUTING.md.";
CM_ SG_ 2147548368 Engine_Particulate_Sensor_Inform "Generic 8-byte raw payload. Detail page: https://www.isobus.net/isobus/pGNAndSPN/13519?type=PGN. Signal-level enrichment via PR welcome  see CONTRIBUTING.md.";
CM_ SG_ 2147548369 Active_Service_Only_DTCs_RawPayl "Generic 8-byte raw payload. Detail page: https://www.isobus.net/isobus/pGNAndSPN/13531?type=PGN. Signal-level enrichment via PR welcome  see CONTRIBUTING.md.";
CM_ SG_ 2147548370 Previously_Active_Service_Only_D "Generic 8-byte raw payload. Detail page: https://www.isobus.net/isobus/pGNAndSPN/13543?type=PGN. Signal-level enrichment via PR welcome  see CONTRIBUTING.md.";
CM_ SG_ 2147548371 Diagnostic_Data_Clear_Reset_for_ "Generic 8-byte raw payload. Detail page: https://www.isobus.net/isobus/pGNAndSPN/13544?type=PGN. Signal-level enrichment via PR welcome  see CONTRIBUTING.md.";
CM_ SG_ 2147548372 XCP_Get_Slave_ID_RawPayload "Generic 8-byte raw payload. Detail page: https://www.isobus.net/isobus/pGNAndSPN/13545?type=PGN. Signal-level enrichment via PR welcome  see CONTRIBUTING.md.";
CM_ SG_ 2147548373 Aftertreatment_1_Diesel_Exhaust_ "Generic 8-byte raw payload. Detail page: https://www.isobus.net/isobus/pGNAndSPN/13552?type=PGN. Signal-level enrichment via PR welcome  see CONTRIBUTING.md.";
CM_ SG_ 2147548374 Aftertreatment_1_Diesel_Particul "Generic 8-byte raw payload. Detail page: https://www.isobus.net/isobus/pGNAndSPN/13556?type=PGN. Signal-level enrichment via PR welcome  see CONTRIBUTING.md.";
CM_ SG_ 2147548375 Aftertreatment_1_Diesel_Particul "Generic 8-byte raw payload. Detail page: https://www.isobus.net/isobus/pGNAndSPN/13560?type=PGN. Signal-level enrichment via PR welcome  see CONTRIBUTING.md.";
CM_ SG_ 2147548376 Aftertreatment_1_Diesel_Particul "Generic 8-byte raw payload. Detail page: https://www.isobus.net/isobus/pGNAndSPN/13564?type=PGN. Signal-level enrichment via PR welcome  see CONTRIBUTING.md.";
CM_ SG_ 2147548377 Aftertreatment_1_Diesel_Particul "Generic 8-byte raw payload. Detail page: https://www.isobus.net/isobus/pGNAndSPN/13568?type=PGN. Signal-level enrichment via PR welcome  see CONTRIBUTING.md.";
CM_ SG_ 2147548378 Aftertreatment_1_Diesel_Particul "Generic 8-byte raw payload. Detail page: https://www.isobus.net/isobus/pGNAndSPN/13572?type=PGN. Signal-level enrichment via PR welcome  see CONTRIBUTING.md.";
CM_ SG_ 2147548379 Aftertreatment_1_Diesel_Particul "Generic 8-byte raw payload. Detail page: https://www.isobus.net/isobus/pGNAndSPN/13576?type=PGN. Signal-level enrichment via PR welcome  see CONTRIBUTING.md.";
CM_ SG_ 2147548380 Cruise_Control_Vehicle_Speed_3_R "Generic 8-byte raw payload. Detail page: https://www.isobus.net/isobus/pGNAndSPN/13587?type=PGN. Signal-level enrichment via PR welcome  see CONTRIBUTING.md.";
CM_ SG_ 2147548381 Aftertreatment_2_Air_Control_3_R "Generic 8-byte raw payload. Detail page: https://www.isobus.net/isobus/pGNAndSPN/13588?type=PGN. Signal-level enrichment via PR welcome  see CONTRIBUTING.md.";
CM_ SG_ 2147548382 Aftertreatment_1_Air_Control_3_R "Generic 8-byte raw payload. Detail page: https://www.isobus.net/isobus/pGNAndSPN/13590?type=PGN. Signal-level enrichment via PR welcome  see CONTRIBUTING.md.";
CM_ SG_ 2147548383 Engine_Fluid_Level_Pressure_12_R "Generic 8-byte raw payload. Detail page: https://www.isobus.net/isobus/pGNAndSPN/13597?type=PGN. Signal-level enrichment via PR welcome  see CONTRIBUTING.md.";
CM_ SG_ 2147548384 Diesel_Particulate_Filter_Contro "Generic 8-byte raw payload. Detail page: https://www.isobus.net/isobus/pGNAndSPN/13601?type=PGN. Signal-level enrichment via PR welcome  see CONTRIBUTING.md.";
CM_ SG_ 2147548385 Fuel_Economy_2_Liquid_RawPayload "Generic 8-byte raw payload. Detail page: https://www.isobus.net/isobus/pGNAndSPN/13603?type=PGN. Signal-level enrichment via PR welcome  see CONTRIBUTING.md.";
CM_ SG_ 2147548386 Supplemental_Fan_Status_RawPaylo "Generic 8-byte raw payload. Detail page: https://www.isobus.net/isobus/pGNAndSPN/13612?type=PGN. Signal-level enrichment via PR welcome  see CONTRIBUTING.md.";
CM_ SG_ 2147548387 Engine_Exhaust_Brake_Control_Raw "Generic 8-byte raw payload. Detail page: https://www.isobus.net/isobus/pGNAndSPN/13617?type=PGN. Signal-level enrichment via PR welcome  see CONTRIBUTING.md.";
CM_ SG_ 2147548388 Engine_Fuel_Properties_RawPayloa "Generic 8-byte raw payload. Detail page: https://www.isobus.net/isobus/pGNAndSPN/13621?type=PGN. Signal-level enrichment via PR welcome  see CONTRIBUTING.md.";
CM_ SG_ 2147548389 Hydraulic_Oil_Properties_RawPayl "Generic 8-byte raw payload. Detail page: https://www.isobus.net/isobus/pGNAndSPN/13625?type=PGN. Signal-level enrichment via PR welcome  see CONTRIBUTING.md.";
CM_ SG_ 2147548390 Vehicle_Chassis_Lubrication_Syst "Generic 8-byte raw payload. Detail page: https://www.isobus.net/isobus/pGNAndSPN/13631?type=PGN. Signal-level enrichment via PR welcome  see CONTRIBUTING.md.";
CM_ SG_ 2147548391 Engine_Configuration_3_RawPayloa "Generic 8-byte raw payload. Detail page: https://www.isobus.net/isobus/pGNAndSPN/13638?type=PGN. Signal-level enrichment via PR welcome  see CONTRIBUTING.md.";
CM_ SG_ 2147548392 Intake_Valve_Actuation_Control_R "Generic 8-byte raw payload. Detail page: https://www.isobus.net/isobus/pGNAndSPN/13640?type=PGN. Signal-level enrichment via PR welcome  see CONTRIBUTING.md.";
CM_ SG_ 2147548393 Armrest_Switch_Matrix_Commands_R "Generic 8-byte raw payload. Detail page: https://www.isobus.net/isobus/pGNAndSPN/13644?type=PGN. Signal-level enrichment via PR welcome  see CONTRIBUTING.md.";
CM_ SG_ 2147548394 Vehicle_Electrical_Power_4_obsol "Generic 8-byte raw payload. Detail page: https://www.isobus.net/isobus/pGNAndSPN/13645?type=PGN. Signal-level enrichment via PR welcome  see CONTRIBUTING.md.";
CM_ SG_ 2147548395 Aftertreatment_2_NOx_Adsorber_In "Generic 8-byte raw payload. Detail page: https://www.isobus.net/isobus/pGNAndSPN/13647?type=PGN. Signal-level enrichment via PR welcome  see CONTRIBUTING.md.";
CM_ SG_ 2147548396 Aftertreatment_1_NOx_Adsorber_In "Generic 8-byte raw payload. Detail page: https://www.isobus.net/isobus/pGNAndSPN/13649?type=PGN. Signal-level enrichment via PR welcome  see CONTRIBUTING.md.";
CM_ SG_ 2147548397 Aftertreatment_2_Warm_Up_Diesel_ "Generic 8-byte raw payload. Detail page: https://www.isobus.net/isobus/pGNAndSPN/13651?type=PGN. Signal-level enrichment via PR welcome  see CONTRIBUTING.md.";
CM_ SG_ 2147548398 Land_Leveling_System_Reference_E "Generic 8-byte raw payload. Detail page: https://www.isobus.net/isobus/pGNAndSPN/13655?type=PGN. Signal-level enrichment via PR welcome  see CONTRIBUTING.md.";
CM_ SG_ 2147548399 Engine_Fluid_Level_Pressure_11_R "Generic 8-byte raw payload. Detail page: https://www.isobus.net/isobus/pGNAndSPN/13659?type=PGN. Signal-level enrichment via PR welcome  see CONTRIBUTING.md.";
CM_ SG_ 2147548400 Engine_Fuel_Lube_x000D_Systems_2 "Generic 8-byte raw payload. Detail page: https://www.isobus.net/isobus/pGNAndSPN/13664?type=PGN. Signal-level enrichment via PR welcome  see CONTRIBUTING.md.";
CM_ SG_ 2147548401 Engine_Turbocharger_Wastegate_Ac "Generic 8-byte raw payload. Detail page: https://www.isobus.net/isobus/pGNAndSPN/13676?type=PGN. Signal-level enrichment via PR welcome  see CONTRIBUTING.md.";
CM_ SG_ 2147548402 Engine_Fuel_Throttle_Valve_Infor "Generic 8-byte raw payload. Detail page: https://www.isobus.net/isobus/pGNAndSPN/13690?type=PGN. Signal-level enrichment via PR welcome  see CONTRIBUTING.md.";
CM_ SG_ 2147548403 Engine_Turbocharger_Compressor_B "Generic 8-byte raw payload. Detail page: https://www.isobus.net/isobus/pGNAndSPN/13698?type=PGN. Signal-level enrichment via PR welcome  see CONTRIBUTING.md.";
CM_ SG_ 2147548404 Charge_Air_Cooler_2_RawPayload "Generic 8-byte raw payload. Detail page: https://www.isobus.net/isobus/pGNAndSPN/13702?type=PGN. Signal-level enrichment via PR welcome  see CONTRIBUTING.md.";
CM_ SG_ 2147548405 Charge_Air_Cooler_2_Precooler_Ra "Generic 8-byte raw payload. Detail page: https://www.isobus.net/isobus/pGNAndSPN/13705?type=PGN. Signal-level enrichment via PR welcome  see CONTRIBUTING.md.";
CM_ SG_ 2147548406 Charge_Air_Cooler_1_RawPayload "Generic 8-byte raw payload. Detail page: https://www.isobus.net/isobus/pGNAndSPN/13709?type=PGN. Signal-level enrichment via PR welcome  see CONTRIBUTING.md.";
CM_ SG_ 2147548407 Charge_Air_Cooler_1_Precooler_Ra "Generic 8-byte raw payload. Detail page: https://www.isobus.net/isobus/pGNAndSPN/13712?type=PGN. Signal-level enrichment via PR welcome  see CONTRIBUTING.md.";
CM_ SG_ 2147548408 Diesel_Particulate_Filter_2_Soot "Generic 8-byte raw payload. Detail page: https://www.isobus.net/isobus/pGNAndSPN/13715?type=PGN. Signal-level enrichment via PR welcome  see CONTRIBUTING.md.";
CM_ SG_ 2147548409 Diesel_Particulate_Filter_1_Soot "Generic 8-byte raw payload. Detail page: https://www.isobus.net/isobus/pGNAndSPN/13718?type=PGN. Signal-level enrichment via PR welcome  see CONTRIBUTING.md.";
CM_ SG_ 2147548410 Electronic_Engine_Controller_11_ "Generic 8-byte raw payload. Detail page: https://www.isobus.net/isobus/pGNAndSPN/13722?type=PGN. Signal-level enrichment via PR welcome  see CONTRIBUTING.md.";
CM_ SG_ 2147548411 Engine_Manifold_Actuator_Positio "Generic 8-byte raw payload. Detail page: https://www.isobus.net/isobus/pGNAndSPN/13724?type=PGN. Signal-level enrichment via PR welcome  see CONTRIBUTING.md.";
CM_ SG_ 2147548412 Engine_Manifold_Actuator_Control "Generic 8-byte raw payload. Detail page: https://www.isobus.net/isobus/pGNAndSPN/13726?type=PGN. Signal-level enrichment via PR welcome  see CONTRIBUTING.md.";
CM_ SG_ 2147548413 Electronic_Engine_Controller_9_R "Generic 8-byte raw payload. Detail page: https://www.isobus.net/isobus/pGNAndSPN/13730?type=PGN. Signal-level enrichment via PR welcome  see CONTRIBUTING.md.";
CM_ SG_ 2147548414 Electronic_Engine_Controller_10_ "Generic 8-byte raw payload. Detail page: https://www.isobus.net/isobus/pGNAndSPN/13735?type=PGN. Signal-level enrichment via PR welcome  see CONTRIBUTING.md.";
CM_ SG_ 2147548415 Engine_Temperature_5_RawPayload "Generic 8-byte raw payload. Detail page: https://www.isobus.net/isobus/pGNAndSPN/13738?type=PGN. Signal-level enrichment via PR welcome  see CONTRIBUTING.md.";
CM_ SG_ 2147548416 Engine_Fluid_Level_Pressure_10_R "Generic 8-byte raw payload. Detail page: https://www.isobus.net/isobus/pGNAndSPN/13743?type=PGN. Signal-level enrichment via PR welcome  see CONTRIBUTING.md.";
CM_ SG_ 2147548417 Low_Voltage_Disconnect_Status_Ra "Generic 8-byte raw payload. Detail page: https://www.isobus.net/isobus/pGNAndSPN/13751?type=PGN. Signal-level enrichment via PR welcome  see CONTRIBUTING.md.";
CM_ SG_ 2147548419 Implement_Operating_state_comman "Generic 8-byte raw payload. Detail page: https://www.isobus.net/isobus/pGNAndSPN/13754?type=PGN. Signal-level enrichment via PR welcome  see CONTRIBUTING.md.";
CM_ SG_ 2147548420 Direct_Lamp_Control_Data_2_RawPa "Generic 8-byte raw payload. Detail page: https://www.isobus.net/isobus/pGNAndSPN/13769?type=PGN. Signal-level enrichment via PR welcome  see CONTRIBUTING.md.";
CM_ SG_ 2147548421 Direct_Lamp_Control_Data_1_RawPa "Generic 8-byte raw payload. Detail page: https://www.isobus.net/isobus/pGNAndSPN/13796?type=PGN. Signal-level enrichment via PR welcome  see CONTRIBUTING.md.";
CM_ SG_ 2147548422 Direct_Lamp_Control_Command_2_Ra "Generic 8-byte raw payload. Detail page: https://www.isobus.net/isobus/pGNAndSPN/13811?type=PGN. Signal-level enrichment via PR welcome  see CONTRIBUTING.md.";
CM_ SG_ 2147548423 Direct_Lamp_Control_Command_1_Ra "Generic 8-byte raw payload. Detail page: https://www.isobus.net/isobus/pGNAndSPN/13838?type=PGN. Signal-level enrichment via PR welcome  see CONTRIBUTING.md.";
CM_ SG_ 2147548424 Engine_oil_message_RawPayload "Generic 8-byte raw payload. Detail page: https://www.isobus.net/isobus/pGNAndSPN/13842?type=PGN. Signal-level enrichment via PR welcome  see CONTRIBUTING.md.";
CM_ SG_ 2147548426 Aftertreatment_2_Outlet_Gas_NOx_ "Generic 8-byte raw payload. Detail page: https://www.isobus.net/isobus/pGNAndSPN/13850?type=PGN. Signal-level enrichment via PR welcome  see CONTRIBUTING.md.";
CM_ SG_ 2147548427 Aftertreatment_2_Outlet_Gas_NOx_ "Generic 8-byte raw payload. Detail page: https://www.isobus.net/isobus/pGNAndSPN/13854?type=PGN. Signal-level enrichment via PR welcome  see CONTRIBUTING.md.";
CM_ SG_ 2147548428 Aftertreatment_2_Intake_Gas_NOx_ "Generic 8-byte raw payload. Detail page: https://www.isobus.net/isobus/pGNAndSPN/13860?type=PGN. Signal-level enrichment via PR welcome  see CONTRIBUTING.md.";
CM_ SG_ 2147548429 Aftertreatment_2_Intake_Gas_NOx_ "Generic 8-byte raw payload. Detail page: https://www.isobus.net/isobus/pGNAndSPN/13864?type=PGN. Signal-level enrichment via PR welcome  see CONTRIBUTING.md.";
CM_ SG_ 2147548430 Aftertreatment_1_Outlet_Gas_NOx_ "Generic 8-byte raw payload. Detail page: https://www.isobus.net/isobus/pGNAndSPN/13870?type=PGN. Signal-level enrichment via PR welcome  see CONTRIBUTING.md.";
CM_ SG_ 2147548431 Aftertreatment_1_Outlet_Gas_NOx_ "Generic 8-byte raw payload. Detail page: https://www.isobus.net/isobus/pGNAndSPN/13874?type=PGN. Signal-level enrichment via PR welcome  see CONTRIBUTING.md.";
CM_ SG_ 2147548432 Aftertreatment_1_Intake_Gas_NOx_ "Generic 8-byte raw payload. Detail page: https://www.isobus.net/isobus/pGNAndSPN/13880?type=PGN. Signal-level enrichment via PR welcome  see CONTRIBUTING.md.";
CM_ SG_ 2147548433 Aftertreatment_1_Intake_Gas_NOx_ "Generic 8-byte raw payload. Detail page: https://www.isobus.net/isobus/pGNAndSPN/13884?type=PGN. Signal-level enrichment via PR welcome  see CONTRIBUTING.md.";
CM_ SG_ 2147548434 Magnet_Status_Information_1_RawP "Generic 8-byte raw payload. Detail page: https://www.isobus.net/isobus/pGNAndSPN/13892?type=PGN. Signal-level enrichment via PR welcome  see CONTRIBUTING.md.";
CM_ SG_ 2147548435 Magnet_System_Configuration_Info "Generic 8-byte raw payload. Detail page: https://www.isobus.net/isobus/pGNAndSPN/13894?type=PGN. Signal-level enrichment via PR welcome  see CONTRIBUTING.md.";
CM_ SG_ 2147548436 Battery_Charger_2_RawPayload "Generic 8-byte raw payload. Detail page: https://www.isobus.net/isobus/pGNAndSPN/13901?type=PGN. Signal-level enrichment via PR welcome  see CONTRIBUTING.md.";
CM_ SG_ 2147548437 Battery_Charger_1_RawPayload "Generic 8-byte raw payload. Detail page: https://www.isobus.net/isobus/pGNAndSPN/13908?type=PGN. Signal-level enrichment via PR welcome  see CONTRIBUTING.md.";
CM_ SG_ 2147548438 Occupant_Classification_System_I "Generic 8-byte raw payload. Detail page: https://www.isobus.net/isobus/pGNAndSPN/13918?type=PGN. Signal-level enrichment via PR welcome  see CONTRIBUTING.md.";
CM_ SG_ 2147548439 Beltlock_and_Airbag_Deactivation "Generic 8-byte raw payload. Detail page: https://www.isobus.net/isobus/pGNAndSPN/13930?type=PGN. Signal-level enrichment via PR welcome  see CONTRIBUTING.md.";
CM_ SG_ 2147548440 Collision_Sensor_Information_Raw "Generic 8-byte raw payload. Detail page: https://www.isobus.net/isobus/pGNAndSPN/13964?type=PGN. Signal-level enrichment via PR welcome  see CONTRIBUTING.md.";
CM_ SG_ 2147548441 Ignitor_Loop_Information_RawPayl "Generic 8-byte raw payload. Detail page: https://www.isobus.net/isobus/pGNAndSPN/14064?type=PGN. Signal-level enrichment via PR welcome  see CONTRIBUTING.md.";
CM_ SG_ 2147548442 Aftertreatment_1_Warm_Up_Diesel_ "Generic 8-byte raw payload. Detail page: https://www.isobus.net/isobus/pGNAndSPN/14066?type=PGN. Signal-level enrichment via PR welcome  see CONTRIBUTING.md.";
CM_ SG_ 2147548443 Diesel_Particulate_Filter_2_Soot "Generic 8-byte raw payload. Detail page: https://www.isobus.net/isobus/pGNAndSPN/14072?type=PGN. Signal-level enrichment via PR welcome  see CONTRIBUTING.md.";
CM_ SG_ 2147548444 Diesel_Particulate_Filter_1_Soot "Generic 8-byte raw payload. Detail page: https://www.isobus.net/isobus/pGNAndSPN/14078?type=PGN. Signal-level enrichment via PR welcome  see CONTRIBUTING.md.";
CM_ SG_ 2147548445 Aftertreatment_Differential_Temp "Generic 8-byte raw payload. Detail page: https://www.isobus.net/isobus/pGNAndSPN/14080?type=PGN. Signal-level enrichment via PR welcome  see CONTRIBUTING.md.";
CM_ SG_ 2147548446 Aftertreatment_Differential_Temp "Generic 8-byte raw payload. Detail page: https://www.isobus.net/isobus/pGNAndSPN/14082?type=PGN. Signal-level enrichment via PR welcome  see CONTRIBUTING.md.";
CM_ SG_ 2147548447 Aftertreatment_2_Diesel_Oxidatio "Generic 8-byte raw payload. Detail page: https://www.isobus.net/isobus/pGNAndSPN/14088?type=PGN. Signal-level enrichment via PR welcome  see CONTRIBUTING.md.";
CM_ SG_ 2147548448 Aftertreatment_1_Diesel_Oxidatio "Generic 8-byte raw payload. Detail page: https://www.isobus.net/isobus/pGNAndSPN/14094?type=PGN. Signal-level enrichment via PR welcome  see CONTRIBUTING.md.";
CM_ SG_ 2147548449 Aftertreatment_2_Gas_Oxidation_C "Generic 8-byte raw payload. Detail page: https://www.isobus.net/isobus/pGNAndSPN/14100?type=PGN. Signal-level enrichment via PR welcome  see CONTRIBUTING.md.";
CM_ SG_ 2147548450 Aftertreatment_1_Gas_Oxidation_C "Generic 8-byte raw payload. Detail page: https://www.isobus.net/isobus/pGNAndSPN/14106?type=PGN. Signal-level enrichment via PR welcome  see CONTRIBUTING.md.";
CM_ SG_ 2147548451 Extended_Joystick_Message_10_Raw "Generic 8-byte raw payload. Detail page: https://www.isobus.net/isobus/pGNAndSPN/14125?type=PGN. Signal-level enrichment via PR welcome  see CONTRIBUTING.md.";
CM_ SG_ 2147548452 Basic_Joystick_Message_10_RawPay "Generic 8-byte raw payload. Detail page: https://www.isobus.net/isobus/pGNAndSPN/14147?type=PGN. Signal-level enrichment via PR welcome  see CONTRIBUTING.md.";
CM_ SG_ 2147548453 Extended_Joystick_Message_9_RawP "Generic 8-byte raw payload. Detail page: https://www.isobus.net/isobus/pGNAndSPN/14166?type=PGN. Signal-level enrichment via PR welcome  see CONTRIBUTING.md.";
CM_ SG_ 2147548454 Basic_Joystick_Message_9_RawPayl "Generic 8-byte raw payload. Detail page: https://www.isobus.net/isobus/pGNAndSPN/14188?type=PGN. Signal-level enrichment via PR welcome  see CONTRIBUTING.md.";
CM_ SG_ 2147548455 Extended_Joystick_Message_8_RawP "Generic 8-byte raw payload. Detail page: https://www.isobus.net/isobus/pGNAndSPN/14207?type=PGN. Signal-level enrichment via PR welcome  see CONTRIBUTING.md.";
CM_ SG_ 2147548456 Basic_Joystick_Message_8_RawPayl "Generic 8-byte raw payload. Detail page: https://www.isobus.net/isobus/pGNAndSPN/14229?type=PGN. Signal-level enrichment via PR welcome  see CONTRIBUTING.md.";
CM_ SG_ 2147548457 Extended_Joystick_Message_7_RawP "Generic 8-byte raw payload. Detail page: https://www.isobus.net/isobus/pGNAndSPN/14248?type=PGN. Signal-level enrichment via PR welcome  see CONTRIBUTING.md.";
CM_ SG_ 2147548458 Basic_Joystick_Message_7_RawPayl "Generic 8-byte raw payload. Detail page: https://www.isobus.net/isobus/pGNAndSPN/14270?type=PGN. Signal-level enrichment via PR welcome  see CONTRIBUTING.md.";
CM_ SG_ 2147548459 Extended_Joystick_Message_6_RawP "Generic 8-byte raw payload. Detail page: https://www.isobus.net/isobus/pGNAndSPN/14289?type=PGN. Signal-level enrichment via PR welcome  see CONTRIBUTING.md.";
CM_ SG_ 2147548460 Basic_Joystick_Message_6_RawPayl "Generic 8-byte raw payload. Detail page: https://www.isobus.net/isobus/pGNAndSPN/14311?type=PGN. Signal-level enrichment via PR welcome  see CONTRIBUTING.md.";
CM_ SG_ 2147548461 Extended_Joystick_Message_5_RawP "Generic 8-byte raw payload. Detail page: https://www.isobus.net/isobus/pGNAndSPN/14330?type=PGN. Signal-level enrichment via PR welcome  see CONTRIBUTING.md.";
CM_ SG_ 2147548462 Basic_Joystick_Message_5_RawPayl "Generic 8-byte raw payload. Detail page: https://www.isobus.net/isobus/pGNAndSPN/14352?type=PGN. Signal-level enrichment via PR welcome  see CONTRIBUTING.md.";
CM_ SG_ 2147548463 Extended_Joystick_Message_4_RawP "Generic 8-byte raw payload. Detail page: https://www.isobus.net/isobus/pGNAndSPN/14371?type=PGN. Signal-level enrichment via PR welcome  see CONTRIBUTING.md.";
CM_ SG_ 2147548464 Basic_Joystick_Message_4_RawPayl "Generic 8-byte raw payload. Detail page: https://www.isobus.net/isobus/pGNAndSPN/14393?type=PGN. Signal-level enrichment via PR welcome  see CONTRIBUTING.md.";
CM_ SG_ 2147548465 Fan_Drive_2_RawPayload "Generic 8-byte raw payload. Detail page: https://www.isobus.net/isobus/pGNAndSPN/14398?type=PGN. Signal-level enrichment via PR welcome  see CONTRIBUTING.md.";
CM_ SG_ 2147548467 Aftertreatment_2_Diesel_Exhaust_ "Generic 8-byte raw payload. Detail page: https://www.isobus.net/isobus/pGNAndSPN/14408?type=PGN. Signal-level enrichment via PR welcome  see CONTRIBUTING.md.";
CM_ SG_ 2147548468 Aftertreatment_2_SCR_Reagant_Tan "Generic 8-byte raw payload. Detail page: https://www.isobus.net/isobus/pGNAndSPN/14415?type=PGN. Signal-level enrichment via PR welcome  see CONTRIBUTING.md.";
CM_ SG_ 2147548469 Aftertreatment_2_Diesel_Exhaust_ "Generic 8-byte raw payload. Detail page: https://www.isobus.net/isobus/pGNAndSPN/14422?type=PGN. Signal-level enrichment via PR welcome  see CONTRIBUTING.md.";

BA_DEF_ BO_ "SystemMessageLongSymbol" STRING;
BA_DEF_ SG_ "SystemSignalLongSymbol" STRING;
BA_ "SystemMessageLongSymbol" BO_ 2147548168 "VDMA_FC08_Vehicle_Electrical_Power_9";
BA_ "SystemMessageLongSymbol" BO_ 2147548169 "VDMA_FC09_Vehicle_Electrical_Power_8";
BA_ "SystemMessageLongSymbol" BO_ 2147548170 "VDMA_FC0A_Vehicle_Electrical_Power_7";
BA_ "SystemMessageLongSymbol" BO_ 2147548171 "VDMA_FC0B_Electronic_Engine_Controller_20";
BA_ "SystemMessageLongSymbol" BO_ 2147548174 "VDMA_FC0E_Primary_or_Rear_Hitch_Roll_and_P";
BA_ "SystemMessageLongSymbol" BO_ 2147548175 "VDMA_FC0F_Secondary_or_Front_Hitch_Roll_an";
BA_ "SystemMessageLongSymbol" BO_ 2147548177 "VDMA_FC11_Total_Gaseous_Fuel_Information";
BA_ "SystemMessageLongSymbol" BO_ 2147548180 "VDMA_FC14_Vehicle_Electrical_Power_3_obsol";
BA_ "SystemMessageLongSymbol" BO_ 2147548181 "VDMA_FC15_Vehicle_Electrical_Power_6";
BA_ "SystemMessageLongSymbol" BO_ 2147548184 "VDMA_FC18_Payload_System_Totals_2";
BA_ "SystemMessageLongSymbol" BO_ 2147548185 "VDMA_FC19_Payload_System_Totals_1";
BA_ "SystemMessageLongSymbol" BO_ 2147548186 "VDMA_FC1A_HVESS_Thermal_Management_System_";
BA_ "SystemMessageLongSymbol" BO_ 2147548187 "VDMA_FC1B_HVESS_Thermal_Management_System_";
BA_ "SystemMessageLongSymbol" BO_ 2147548188 "VDMA_FC1C_Refrigeration_Compartment_Inform";
BA_ "SystemMessageLongSymbol" BO_ 2147548189 "VDMA_FC1D_Refrigeration_Compartment_Inform";
BA_ "SystemMessageLongSymbol" BO_ 2147548190 "VDMA_FC1E_Vehicle_Electrical_Power_16";
BA_ "SystemMessageLongSymbol" BO_ 2147548191 "VDMA_FC1F_Vehicle_Electrical_Power_17";
BA_ "SystemMessageLongSymbol" BO_ 2147548192 "VDMA_FC20_High_Voltage_Energy_Storage_Syst";
BA_ "SystemMessageLongSymbol" BO_ 2147548193 "VDMA_FC21_High_Voltage_Energy_Storage_Syst";
BA_ "SystemMessageLongSymbol" BO_ 2147548194 "VDMA_FC22_Electronic_Engine_Controller_19";
BA_ "SystemMessageLongSymbol" BO_ 2147548195 "VDMA_FC23_Fuel_Consumption_Liquid_2";
BA_ "SystemMessageLongSymbol" BO_ 2147548196 "VDMA_FC24_Aftertreatment_2_Diesel_Exhaust_";
BA_ "SystemMessageLongSymbol" BO_ 2147548197 "VDMA_FC25_Aftertreatment_1_Diesel_Exhaust_";
BA_ "SystemMessageLongSymbol" BO_ 2147548198 "VDMA_FC26_Aftertreatment_2_Diesel_Exhaust_";
BA_ "SystemMessageLongSymbol" BO_ 2147548199 "VDMA_FC27_Aftertreatment_1_Diesel_Exhaust_";
BA_ "SystemMessageLongSymbol" BO_ 2147548200 "VDMA_FC28_Cruise_Control_Vehicle_Speed_6";
BA_ "SystemMessageLongSymbol" BO_ 2147548202 "VDMA_FC2A_Operator_Inducement_Information_";
BA_ "SystemMessageLongSymbol" BO_ 2147548203 "VDMA_FC2B_Cruise_Control_Vehicle_Speed_4";
BA_ "SystemMessageLongSymbol" BO_ 2147548204 "VDMA_FC2C_Brake_Caliper_Lining_Clearance";
BA_ "SystemMessageLongSymbol" BO_ 2147548206 "VDMA_FC2E_Engine_Turbocharger_Control_3";
BA_ "SystemMessageLongSymbol" BO_ 2147548207 "VDMA_FC2F_Fire_Suppression_Agent_Status";
BA_ "SystemMessageLongSymbol" BO_ 2147548208 "VDMA_FC30_SCR_Operator_Inducement_Informat";
BA_ "SystemMessageLongSymbol" BO_ 2147548209 "VDMA_FC31_Aftertreatment_System_Informatio";
BA_ "SystemMessageLongSymbol" BO_ 2147548210 "VDMA_FC32_Aftertreatment_1_Particulate_Sen";
BA_ "SystemMessageLongSymbol" BO_ 2147548211 "VDMA_FC33_Engine_Fuel_Injector_Metering_Ra";
BA_ "SystemMessageLongSymbol" BO_ 2147548212 "VDMA_FC34_Engine_Fuel_Injector_Metering_Ra";
BA_ "SystemMessageLongSymbol" BO_ 2147548213 "VDMA_FC35_Aftertreatment_2_Diesel_Exhaust_";
BA_ "SystemMessageLongSymbol" BO_ 2147548214 "VDMA_FC36_Gaseous_Fuel_Supply_Valve_Inform";
BA_ "SystemMessageLongSymbol" BO_ 2147548215 "VDMA_FC37_Engine_Oil_Mist_Detection_Inform";
BA_ "SystemMessageLongSymbol" BO_ 2147548216 "VDMA_FC38_Engine_Oil_Mist_Detection_Inform";
BA_ "SystemMessageLongSymbol" BO_ 2147548217 "VDMA_FC39_Gaseous_Fuel_Supply_Pressure_2";
BA_ "SystemMessageLongSymbol" BO_ 2147548218 "VDMA_FC3A_Gaseous_Fuel_Supply_Pressure_1";
BA_ "SystemMessageLongSymbol" BO_ 2147548219 "VDMA_FC3B_Engine_End_Bearing_Temperature_3";
BA_ "SystemMessageLongSymbol" BO_ 2147548220 "VDMA_FC3C_Engine_End_Bearing_Temperature_2";
BA_ "SystemMessageLongSymbol" BO_ 2147548221 "VDMA_FC3D_Engine_End_Bearing_Temperature_1";
BA_ "SystemMessageLongSymbol" BO_ 2147548222 "VDMA_FC3E_Heat_Exchanger_Debris_Purge_Info";
BA_ "SystemMessageLongSymbol" BO_ 2147548223 "VDMA_FC3F_Engine_Turbocharger_Control_2";
BA_ "SystemMessageLongSymbol" BO_ 2147548224 "VDMA_FC40_Engine_Hydraulic_Fuel_2_Pump_Sta";
BA_ "SystemMessageLongSymbol" BO_ 2147548226 "VDMA_FC42_Tire_Condition_Message_2";
BA_ "SystemMessageLongSymbol" BO_ 2147548227 "VDMA_FC43_Tire_Configuration_Status_Inform";
BA_ "SystemMessageLongSymbol" BO_ 2147548228 "VDMA_FC44_High_Voltage_Energy_Storage_Syst";
BA_ "SystemMessageLongSymbol" BO_ 2147548229 "VDMA_FC45_Tire_Wireless_Signal_Strength_In";
BA_ "SystemMessageLongSymbol" BO_ 2147548230 "VDMA_FC46_Tire_Sensor_Identification_Statu";
BA_ "SystemMessageLongSymbol" BO_ 2147548231 "VDMA_FC47_Monitored_Tire_Information";
BA_ "SystemMessageLongSymbol" BO_ 2147548232 "VDMA_FC48_Aftertreatment_2_Historical_Info";
BA_ "SystemMessageLongSymbol" BO_ 2147548233 "VDMA_FC49_Aftertreatment_1_Historical_Info";
BA_ "SystemMessageLongSymbol" BO_ 2147548235 "VDMA_FC4B_Electronic_Engine_Controller_17";
BA_ "SystemMessageLongSymbol" BO_ 2147548236 "VDMA_FC4C_SCR_Operator_Inducement_Informat";
BA_ "SystemMessageLongSymbol" BO_ 2147548237 "VDMA_FC4D_Aftertreatment_2_SCR_Dosing_Syst";
BA_ "SystemMessageLongSymbol" BO_ 2147548238 "VDMA_FC4E_Aftertreatment_1_SCR_Dosing_Syst";
BA_ "SystemMessageLongSymbol" BO_ 2147548239 "VDMA_FC4F_Payload_Weight_Sensor_Informatio";
BA_ "SystemMessageLongSymbol" BO_ 2147548241 "VDMA_FC51_Air_Suspension_Control_7";
BA_ "SystemMessageLongSymbol" BO_ 2147548242 "VDMA_FC52_Bin_Weight_and_Lift_Count";
BA_ "SystemMessageLongSymbol" BO_ 2147548243 "VDMA_FC53_Engine_Gaseous_Leakage_Informati";
BA_ "SystemMessageLongSymbol" BO_ 2147548244 "VDMA_FC54_Driving_and_Rest_Times_Driver_2";
BA_ "SystemMessageLongSymbol" BO_ 2147548245 "VDMA_FC55_Driving_and_Rest_Times_Driver_1";
BA_ "SystemMessageLongSymbol" BO_ 2147548246 "VDMA_FC56_SCR_Operator_Inducement_Informat";
BA_ "SystemMessageLongSymbol" BO_ 2147548247 "VDMA_FC57_SCR_Operator_Inducement_Informat";
BA_ "SystemMessageLongSymbol" BO_ 2147548248 "VDMA_FC58_Turbocharger_Information_7";
BA_ "SystemMessageLongSymbol" BO_ 2147548249 "VDMA_FC59_Engine_Load_Sharing_Information";
BA_ "SystemMessageLongSymbol" BO_ 2147548250 "VDMA_FC5A_Synchronized_Service_Distance_In";
BA_ "SystemMessageLongSymbol" BO_ 2147548251 "VDMA_FC5B_Synchronized_Service_Delay_Opera";
BA_ "SystemMessageLongSymbol" BO_ 2147548252 "VDMA_FC5C_Synchronized_Service_Delay_Calen";
BA_ "SystemMessageLongSymbol" BO_ 2147548253 "VDMA_FC5D_High_Voltage_Energy_Storage_Syst";
BA_ "SystemMessageLongSymbol" BO_ 2147548254 "VDMA_FC5E_High_Voltage_Energy_Storage_Syst";
BA_ "SystemMessageLongSymbol" BO_ 2147548256 "VDMA_FC60_Encoder_High_Resolution_Position";
BA_ "SystemMessageLongSymbol" BO_ 2147548259 "VDMA_FC63_Encoder_Position_with_Speed_and_";
BA_ "SystemMessageLongSymbol" BO_ 2147548260 "VDMA_FC64_Inclinometer_Slope_Longitudinal_";
BA_ "SystemMessageLongSymbol" BO_ 2147548261 "VDMA_FC65_Inclinometer_Slope_Longitudinal_";
BA_ "SystemMessageLongSymbol" BO_ 2147548262 "VDMA_FC66_Inclinometer_Slope_Lateral_16_bi";
BA_ "SystemMessageLongSymbol" BO_ 2147548263 "VDMA_FC67_Inclinometer_Slope_Lateral_32_bi";
BA_ "SystemMessageLongSymbol" BO_ 2147548264 "VDMA_FC68_CANopen_Emergency_Message";
BA_ "SystemMessageLongSymbol" BO_ 2147548265 "VDMA_FC69_EV_Operator_Indicators_1";
BA_ "SystemMessageLongSymbol" BO_ 2147548267 "VDMA_FC6B_Engine_Maximum_Net_Torque_Map_ob";
BA_ "SystemMessageLongSymbol" BO_ 2147548269 "VDMA_FC6D_Acoustic_Warning_Request";
BA_ "SystemMessageLongSymbol" BO_ 2147548272 "VDMA_FC70_Body_Application_Unit_1";
BA_ "SystemMessageLongSymbol" BO_ 2147548273 "VDMA_FC71_Body_Application_Unit_2";
BA_ "SystemMessageLongSymbol" BO_ 2147548274 "VDMA_FC72_Body_Application_Unit_3";
BA_ "SystemMessageLongSymbol" BO_ 2147548275 "VDMA_FC73_Body_Application_Unit_4";
BA_ "SystemMessageLongSymbol" BO_ 2147548276 "VDMA_FC74_Body_Application_Unit_5";
BA_ "SystemMessageLongSymbol" BO_ 2147548277 "VDMA_FC75_Body_Application_Unit_6";
BA_ "SystemMessageLongSymbol" BO_ 2147548278 "VDMA_FC76_Body_Application_Unit_7";
BA_ "SystemMessageLongSymbol" BO_ 2147548279 "VDMA_FC77_Body_Application_Unit_8";
BA_ "SystemMessageLongSymbol" BO_ 2147548280 "VDMA_FC78_Electronic_Control_Unit";
BA_ "SystemMessageLongSymbol" BO_ 2147548284 "VDMA_FC7C_Heating_And_Refrigerating_Unit_1";
BA_ "SystemMessageLongSymbol" BO_ 2147548285 "VDMA_FC7D_Heating_And_Refrigerating_Unit_2";
BA_ "SystemMessageLongSymbol" BO_ 2147548286 "VDMA_FC7E_Heating_And_Refrigerating_Unit_3";
BA_ "SystemMessageLongSymbol" BO_ 2147548287 "VDMA_FC7F_Heating_And_Refrigerating_Unit_4";
BA_ "SystemMessageLongSymbol" BO_ 2147548288 "VDMA_FC80_HRU_Temperature_Setpoint";
BA_ "SystemMessageLongSymbol" BO_ 2147548292 "VDMA_FC84_Windshield_Wiper_Request";
BA_ "SystemMessageLongSymbol" BO_ 2147548293 "VDMA_FC85_Fuel_Cell_Auxiliary_Heater_Contr";
BA_ "SystemMessageLongSymbol" BO_ 2147548294 "VDMA_FC86_Fuel_Cell_Auxiliary_Heater_Infor";
BA_ "SystemMessageLongSymbol" BO_ 2147548295 "VDMA_FC87_Fuel_Cell_Coolant_Pump_1_Command";
BA_ "SystemMessageLongSymbol" BO_ 2147548296 "VDMA_FC88_Fuel_Cell_Coolant_Pump_2_Command";
BA_ "SystemMessageLongSymbol" BO_ 2147548297 "VDMA_FC89_Fuel_Cell_Coolant_Pump_1_Status";
BA_ "SystemMessageLongSymbol" BO_ 2147548298 "VDMA_FC8A_Fuel_Cell_Coolant_Pump_2_Status";
BA_ "SystemMessageLongSymbol" BO_ 2147548299 "VDMA_FC8B_Aftertreatment_1_Particulate_Sen";
BA_ "SystemMessageLongSymbol" BO_ 2147548300 "VDMA_FC8C_Aftertreatment_1_Particulate_Sen";
BA_ "SystemMessageLongSymbol" BO_ 2147548304 "VDMA_FC90_Engine_Fuel_Injector_Metering_Ra";
BA_ "SystemMessageLongSymbol" BO_ 2147548307 "VDMA_FC93_Gaseous_Fuel_Pressure_2";
BA_ "SystemMessageLongSymbol" BO_ 2147548308 "VDMA_FC94_Aftertreatment_System_Abuse_Info";
BA_ "SystemMessageLongSymbol" BO_ 2147548309 "VDMA_FC95_Engine_Cylinder_Pressure_Monitor";
BA_ "SystemMessageLongSymbol" BO_ 2147548311 "VDMA_FC97_Electronic_Steering_Control_2";
BA_ "SystemMessageLongSymbol" BO_ 2147548313 "VDMA_FC99_Assembly_Unit_Identification";
BA_ "SystemMessageLongSymbol" BO_ 2147548317 "VDMA_FC9D_Engine_Timing_Actuator_Position_";
BA_ "SystemMessageLongSymbol" BO_ 2147548318 "VDMA_FC9E_Engine_Timing_Actuator_Position";
BA_ "SystemMessageLongSymbol" BO_ 2147548320 "VDMA_FCA0_Multi_fuel_Engine_Hours";
BA_ "SystemMessageLongSymbol" BO_ 2147548321 "VDMA_FCA1_Engine_Spark_Misfire_Rate_3";
BA_ "SystemMessageLongSymbol" BO_ 2147548322 "VDMA_FCA2_Engine_Spark_Misfire_Rate_2";
BA_ "SystemMessageLongSymbol" BO_ 2147548323 "VDMA_FCA3_Engine_Spark_Misfire_Rate_1";
BA_ "SystemMessageLongSymbol" BO_ 2147548324 "VDMA_FCA4_Engine_Spark_Maximum_Voltage_6";
BA_ "SystemMessageLongSymbol" BO_ 2147548325 "VDMA_FCA5_Engine_Spark_Maximum_Voltage_5";
BA_ "SystemMessageLongSymbol" BO_ 2147548326 "VDMA_FCA6_Engine_Spark_Maximum_Voltage_4";
BA_ "SystemMessageLongSymbol" BO_ 2147548327 "VDMA_FCA7_Engine_Spark_Maximum_Voltage_3";
BA_ "SystemMessageLongSymbol" BO_ 2147548328 "VDMA_FCA8_Engine_Spark_Maximum_Voltage_2";
BA_ "SystemMessageLongSymbol" BO_ 2147548329 "VDMA_FCA9_Engine_Spark_Maximum_Voltage_1";
BA_ "SystemMessageLongSymbol" BO_ 2147548330 "VDMA_FCAA_Engine_Spark_Minimum_Voltage_6";
BA_ "SystemMessageLongSymbol" BO_ 2147548331 "VDMA_FCAB_Engine_Spark_Minimum_Voltage_5";
BA_ "SystemMessageLongSymbol" BO_ 2147548332 "VDMA_FCAC_Engine_Spark_Minimum_Voltage_4";
BA_ "SystemMessageLongSymbol" BO_ 2147548333 "VDMA_FCAD_Engine_Spark_Minimum_Voltage_3";
BA_ "SystemMessageLongSymbol" BO_ 2147548334 "VDMA_FCAE_Engine_Spark_Minimum_Voltage_2";
BA_ "SystemMessageLongSymbol" BO_ 2147548335 "VDMA_FCAF_Engine_Spark_Minimum_Voltage_1";
BA_ "SystemMessageLongSymbol" BO_ 2147548336 "VDMA_FCB0_Engine_Ignition_Controller_Maint";
BA_ "SystemMessageLongSymbol" BO_ 2147548337 "VDMA_FCB1_Engine_Ignition_Control_Module_S";
BA_ "SystemMessageLongSymbol" BO_ 2147548339 "VDMA_FCB3_Fused_Power_Output_Current";
BA_ "SystemMessageLongSymbol" BO_ 2147548340 "VDMA_FCB4_Switched_Power_Output_Status";
BA_ "SystemMessageLongSymbol" BO_ 2147548341 "VDMA_FCB5_Fused_Power_Output_Status";
BA_ "SystemMessageLongSymbol" BO_ 2147548342 "VDMA_FCB6_Vehicle_Electrical_Power_5";
BA_ "SystemMessageLongSymbol" BO_ 2147548343 "VDMA_FCB7_Hybrid_or_EV_System_Status_2";
BA_ "SystemMessageLongSymbol" BO_ 2147548344 "VDMA_FCB8_Aftertreatment_2_Service_2";
BA_ "SystemMessageLongSymbol" BO_ 2147548345 "VDMA_FCB9_Aftertreatment_1_Service_2";
BA_ "SystemMessageLongSymbol" BO_ 2147548346 "VDMA_FCBA_Aftertreatment_2_SCR_Electronic_";
BA_ "SystemMessageLongSymbol" BO_ 2147548347 "VDMA_FCBB_Aftertreatment_1_SCR_Electronic_";
BA_ "SystemMessageLongSymbol" BO_ 2147548348 "VDMA_FCBC_Aftertreatment_2_SCR_Service_Inf";
BA_ "SystemMessageLongSymbol" BO_ 2147548349 "VDMA_FCBD_Aftertreatment_1_SCR_Service_Inf";
BA_ "SystemMessageLongSymbol" BO_ 2147548350 "VDMA_FCBE_Electronic_Transmission_Controll";
BA_ "SystemMessageLongSymbol" BO_ 2147548351 "VDMA_FCBF_Electronic_Transmission_Controll";
BA_ "SystemMessageLongSymbol" BO_ 2147548352 "VDMA_FCC0_Electronic_Transmission_Controll";
BA_ "SystemMessageLongSymbol" BO_ 2147548354 "VDMA_FCC2_Hybrid_or_EV_System_Status_1";
BA_ "SystemMessageLongSymbol" BO_ 2147548355 "VDMA_FCC3_Fuel_Information_4_Gaseous";
BA_ "SystemMessageLongSymbol" BO_ 2147548356 "VDMA_FCC4_Aftertreatment_2_SCR_Exhaust_Gas";
BA_ "SystemMessageLongSymbol" BO_ 2147548357 "VDMA_FCC5_Aftertreatment_1_SCR_Exhaust_Gas";
BA_ "SystemMessageLongSymbol" BO_ 2147548359 "VDMA_FCC7_Model_Year_and_Certification_Eng";
BA_ "SystemMessageLongSymbol" BO_ 2147548360 "VDMA_FCC8_Electronic_Engine_Controller_13";
BA_ "SystemMessageLongSymbol" BO_ 2147548361 "VDMA_FCC9_Engine_Fuel_Throttle_Valve_Infor";
BA_ "SystemMessageLongSymbol" BO_ 2147548362 "VDMA_FCCA_Engine_Exhaust_Gas_Recirculation";
BA_ "SystemMessageLongSymbol" BO_ 2147548363 "VDMA_FCCB_Engine_Exhaust_Gas_Recirculation";
BA_ "SystemMessageLongSymbol" BO_ 2147548364 "VDMA_FCCC_Electronic_Engine_Controller_12";
BA_ "SystemMessageLongSymbol" BO_ 2147548367 "VDMA_FCCF_NOx_Sensor_Self_Diagnosis_Reques";
BA_ "SystemMessageLongSymbol" BO_ 2147548368 "VDMA_FCD0_Engine_Particulate_Sensor_Inform";
BA_ "SystemMessageLongSymbol" BO_ 2147548369 "VDMA_FCD1_Active_Service_Only_DTCs";
BA_ "SystemMessageLongSymbol" BO_ 2147548370 "VDMA_FCD2_Previously_Active_Service_Only_D";
BA_ "SystemMessageLongSymbol" BO_ 2147548371 "VDMA_FCD3_Diagnostic_Data_Clear_Reset_for_";
BA_ "SystemMessageLongSymbol" BO_ 2147548373 "VDMA_FCD5_Aftertreatment_1_Diesel_Exhaust_";
BA_ "SystemMessageLongSymbol" BO_ 2147548374 "VDMA_FCD6_Aftertreatment_1_Diesel_Particul";
BA_ "SystemMessageLongSymbol" BO_ 2147548375 "VDMA_FCD7_Aftertreatment_1_Diesel_Particul";
BA_ "SystemMessageLongSymbol" BO_ 2147548376 "VDMA_FCD8_Aftertreatment_1_Diesel_Particul";
BA_ "SystemMessageLongSymbol" BO_ 2147548377 "VDMA_FCD9_Aftertreatment_1_Diesel_Particul";
BA_ "SystemMessageLongSymbol" BO_ 2147548378 "VDMA_FCDA_Aftertreatment_1_Diesel_Particul";
BA_ "SystemMessageLongSymbol" BO_ 2147548379 "VDMA_FCDB_Aftertreatment_1_Diesel_Particul";
BA_ "SystemMessageLongSymbol" BO_ 2147548380 "VDMA_FCDC_Cruise_Control_Vehicle_Speed_3";
BA_ "SystemMessageLongSymbol" BO_ 2147548381 "VDMA_FCDD_Aftertreatment_2_Air_Control_3";
BA_ "SystemMessageLongSymbol" BO_ 2147548382 "VDMA_FCDE_Aftertreatment_1_Air_Control_3";
BA_ "SystemMessageLongSymbol" BO_ 2147548383 "VDMA_FCDF_Engine_Fluid_Level_Pressure_12";
BA_ "SystemMessageLongSymbol" BO_ 2147548384 "VDMA_FCE0_Diesel_Particulate_Filter_Contro";
BA_ "SystemMessageLongSymbol" BO_ 2147548386 "VDMA_FCE2_Supplemental_Fan_Status";
BA_ "SystemMessageLongSymbol" BO_ 2147548387 "VDMA_FCE3_Engine_Exhaust_Brake_Control";
BA_ "SystemMessageLongSymbol" BO_ 2147548389 "VDMA_FCE5_Hydraulic_Oil_Properties";
BA_ "SystemMessageLongSymbol" BO_ 2147548390 "VDMA_FCE6_Vehicle_Chassis_Lubrication_Syst";
BA_ "SystemMessageLongSymbol" BO_ 2147548392 "VDMA_FCE8_Intake_Valve_Actuation_Control";
BA_ "SystemMessageLongSymbol" BO_ 2147548393 "VDMA_FCE9_Armrest_Switch_Matrix_Commands";
BA_ "SystemMessageLongSymbol" BO_ 2147548394 "VDMA_FCEA_Vehicle_Electrical_Power_4_obsol";
BA_ "SystemMessageLongSymbol" BO_ 2147548395 "VDMA_FCEB_Aftertreatment_2_NOx_Adsorber_In";
BA_ "SystemMessageLongSymbol" BO_ 2147548396 "VDMA_FCEC_Aftertreatment_1_NOx_Adsorber_In";
BA_ "SystemMessageLongSymbol" BO_ 2147548397 "VDMA_FCED_Aftertreatment_2_Warm_Up_Diesel_";
BA_ "SystemMessageLongSymbol" BO_ 2147548398 "VDMA_FCEE_Land_Leveling_System_Reference_E";
BA_ "SystemMessageLongSymbol" BO_ 2147548399 "VDMA_FCEF_Engine_Fluid_Level_Pressure_11";
BA_ "SystemMessageLongSymbol" BO_ 2147548400 "VDMA_FCF0_Engine_Fuel_Lube_x000D_Systems_2";
BA_ "SystemMessageLongSymbol" BO_ 2147548401 "VDMA_FCF1_Engine_Turbocharger_Wastegate_Ac";
BA_ "SystemMessageLongSymbol" BO_ 2147548402 "VDMA_FCF2_Engine_Fuel_Throttle_Valve_Infor";
BA_ "SystemMessageLongSymbol" BO_ 2147548403 "VDMA_FCF3_Engine_Turbocharger_Compressor_B";
BA_ "SystemMessageLongSymbol" BO_ 2147548405 "VDMA_FCF5_Charge_Air_Cooler_2_Precooler";
BA_ "SystemMessageLongSymbol" BO_ 2147548407 "VDMA_FCF7_Charge_Air_Cooler_1_Precooler";
BA_ "SystemMessageLongSymbol" BO_ 2147548408 "VDMA_FCF8_Diesel_Particulate_Filter_2_Soot";
BA_ "SystemMessageLongSymbol" BO_ 2147548409 "VDMA_FCF9_Diesel_Particulate_Filter_1_Soot";
BA_ "SystemMessageLongSymbol" BO_ 2147548410 "VDMA_FCFA_Electronic_Engine_Controller_11";
BA_ "SystemMessageLongSymbol" BO_ 2147548411 "VDMA_FCFB_Engine_Manifold_Actuator_Positio";
BA_ "SystemMessageLongSymbol" BO_ 2147548412 "VDMA_FCFC_Engine_Manifold_Actuator_Control";
BA_ "SystemMessageLongSymbol" BO_ 2147548413 "VDMA_FCFD_Electronic_Engine_Controller_9";
BA_ "SystemMessageLongSymbol" BO_ 2147548414 "VDMA_FCFE_Electronic_Engine_Controller_10";
BA_ "SystemMessageLongSymbol" BO_ 2147548416 "VDMA_FD00_Engine_Fluid_Level_Pressure_10";
BA_ "SystemMessageLongSymbol" BO_ 2147548417 "VDMA_FD01_Low_Voltage_Disconnect_Status";
BA_ "SystemMessageLongSymbol" BO_ 2147548419 "VDMA_FD03_Implement_Operating_state_comman";
BA_ "SystemMessageLongSymbol" BO_ 2147548420 "VDMA_FD04_Direct_Lamp_Control_Data_2";
BA_ "SystemMessageLongSymbol" BO_ 2147548421 "VDMA_FD05_Direct_Lamp_Control_Data_1";
BA_ "SystemMessageLongSymbol" BO_ 2147548422 "VDMA_FD06_Direct_Lamp_Control_Command_2";
BA_ "SystemMessageLongSymbol" BO_ 2147548423 "VDMA_FD07_Direct_Lamp_Control_Command_1";
BA_ "SystemMessageLongSymbol" BO_ 2147548426 "VDMA_FD0A_Aftertreatment_2_Outlet_Gas_NOx_";
BA_ "SystemMessageLongSymbol" BO_ 2147548427 "VDMA_FD0B_Aftertreatment_2_Outlet_Gas_NOx_";
BA_ "SystemMessageLongSymbol" BO_ 2147548428 "VDMA_FD0C_Aftertreatment_2_Intake_Gas_NOx_";
BA_ "SystemMessageLongSymbol" BO_ 2147548429 "VDMA_FD0D_Aftertreatment_2_Intake_Gas_NOx_";
BA_ "SystemMessageLongSymbol" BO_ 2147548430 "VDMA_FD0E_Aftertreatment_1_Outlet_Gas_NOx_";
BA_ "SystemMessageLongSymbol" BO_ 2147548431 "VDMA_FD0F_Aftertreatment_1_Outlet_Gas_NOx_";
BA_ "SystemMessageLongSymbol" BO_ 2147548432 "VDMA_FD10_Aftertreatment_1_Intake_Gas_NOx_";
BA_ "SystemMessageLongSymbol" BO_ 2147548433 "VDMA_FD11_Aftertreatment_1_Intake_Gas_NOx_";
BA_ "SystemMessageLongSymbol" BO_ 2147548434 "VDMA_FD12_Magnet_Status_Information_1";
BA_ "SystemMessageLongSymbol" BO_ 2147548435 "VDMA_FD13_Magnet_System_Configuration_Info";
BA_ "SystemMessageLongSymbol" BO_ 2147548438 "VDMA_FD16_Occupant_Classification_System_I";
BA_ "SystemMessageLongSymbol" BO_ 2147548439 "VDMA_FD17_Beltlock_and_Airbag_Deactivation";
BA_ "SystemMessageLongSymbol" BO_ 2147548440 "VDMA_FD18_Collision_Sensor_Information";
BA_ "SystemMessageLongSymbol" BO_ 2147548441 "VDMA_FD19_Ignitor_Loop_Information";
BA_ "SystemMessageLongSymbol" BO_ 2147548442 "VDMA_FD1A_Aftertreatment_1_Warm_Up_Diesel_";
BA_ "SystemMessageLongSymbol" BO_ 2147548443 "VDMA_FD1B_Diesel_Particulate_Filter_2_Soot";
BA_ "SystemMessageLongSymbol" BO_ 2147548444 "VDMA_FD1C_Diesel_Particulate_Filter_1_Soot";
BA_ "SystemMessageLongSymbol" BO_ 2147548445 "VDMA_FD1D_Aftertreatment_Differential_Temp";
BA_ "SystemMessageLongSymbol" BO_ 2147548446 "VDMA_FD1E_Aftertreatment_Differential_Temp";
BA_ "SystemMessageLongSymbol" BO_ 2147548447 "VDMA_FD1F_Aftertreatment_2_Diesel_Oxidatio";
BA_ "SystemMessageLongSymbol" BO_ 2147548448 "VDMA_FD20_Aftertreatment_1_Diesel_Oxidatio";
BA_ "SystemMessageLongSymbol" BO_ 2147548449 "VDMA_FD21_Aftertreatment_2_Gas_Oxidation_C";
BA_ "SystemMessageLongSymbol" BO_ 2147548450 "VDMA_FD22_Aftertreatment_1_Gas_Oxidation_C";
BA_ "SystemMessageLongSymbol" BO_ 2147548451 "VDMA_FD23_Extended_Joystick_Message_10";
BA_ "SystemMessageLongSymbol" BO_ 2147548452 "VDMA_FD24_Basic_Joystick_Message_10";
BA_ "SystemMessageLongSymbol" BO_ 2147548453 "VDMA_FD25_Extended_Joystick_Message_9";
BA_ "SystemMessageLongSymbol" BO_ 2147548454 "VDMA_FD26_Basic_Joystick_Message_9";
BA_ "SystemMessageLongSymbol" BO_ 2147548455 "VDMA_FD27_Extended_Joystick_Message_8";
BA_ "SystemMessageLongSymbol" BO_ 2147548456 "VDMA_FD28_Basic_Joystick_Message_8";
BA_ "SystemMessageLongSymbol" BO_ 2147548457 "VDMA_FD29_Extended_Joystick_Message_7";
BA_ "SystemMessageLongSymbol" BO_ 2147548458 "VDMA_FD2A_Basic_Joystick_Message_7";
BA_ "SystemMessageLongSymbol" BO_ 2147548459 "VDMA_FD2B_Extended_Joystick_Message_6";
BA_ "SystemMessageLongSymbol" BO_ 2147548460 "VDMA_FD2C_Basic_Joystick_Message_6";
BA_ "SystemMessageLongSymbol" BO_ 2147548461 "VDMA_FD2D_Extended_Joystick_Message_5";
BA_ "SystemMessageLongSymbol" BO_ 2147548462 "VDMA_FD2E_Basic_Joystick_Message_5";
BA_ "SystemMessageLongSymbol" BO_ 2147548463 "VDMA_FD2F_Extended_Joystick_Message_4";
BA_ "SystemMessageLongSymbol" BO_ 2147548464 "VDMA_FD30_Basic_Joystick_Message_4";
BA_ "SystemMessageLongSymbol" BO_ 2147548467 "VDMA_FD33_Aftertreatment_2_Diesel_Exhaust_";
BA_ "SystemMessageLongSymbol" BO_ 2147548468 "VDMA_FD34_Aftertreatment_2_SCR_Reagant_Tan";
BA_ "SystemMessageLongSymbol" BO_ 2147548469 "VDMA_FD35_Aftertreatment_2_Diesel_Exhaust_";
BA_ "SystemSignalLongSymbol" SG_ 2147548168 Vehicle_Electrical_Power_9_RawPa "Vehicle_Electrical_Power_9_RawPayload";
BA_ "SystemSignalLongSymbol" SG_ 2147548169 Vehicle_Electrical_Power_8_RawPa "Vehicle_Electrical_Power_8_RawPayload";
BA_ "SystemSignalLongSymbol" SG_ 2147548170 Vehicle_Electrical_Power_7_RawPa "Vehicle_Electrical_Power_7_RawPayload";
BA_ "SystemSignalLongSymbol" SG_ 2147548171 Electronic_Engine_Controller_20_ "Electronic_Engine_Controller_20_RawPayload";
BA_ "SystemSignalLongSymbol" SG_ 2147548173 Fire_Pump_Statistics_1_RawPayloa "Fire_Pump_Statistics_1_RawPayload";
BA_ "SystemSignalLongSymbol" SG_ 2147548174 Primary_or_Rear_Hitch_Roll_and_P "Primary_or_Rear_Hitch_Roll_and_P_RawPayload";
BA_ "SystemSignalLongSymbol" SG_ 2147548175 Secondary_or_Front_Hitch_Roll_an "Secondary_or_Front_Hitch_Roll_an_RawPayload";
BA_ "SystemSignalLongSymbol" SG_ 2147548177 Total_Gaseous_Fuel_Information_R "Total_Gaseous_Fuel_Information_RawPayload";
BA_ "SystemSignalLongSymbol" SG_ 2147548180 Vehicle_Electrical_Power_3_obsol "Vehicle_Electrical_Power_3_obsol_RawPayload";
BA_ "SystemSignalLongSymbol" SG_ 2147548181 Vehicle_Electrical_Power_6_RawPa "Vehicle_Electrical_Power_6_RawPayload";
BA_ "SystemSignalLongSymbol" SG_ 2147548184 Payload_System_Totals_2_RawPaylo "Payload_System_Totals_2_RawPayload";
BA_ "SystemSignalLongSymbol" SG_ 2147548185 Payload_System_Totals_1_RawPaylo "Payload_System_Totals_1_RawPayload";
BA_ "SystemSignalLongSymbol" SG_ 2147548186 HVESS_Thermal_Management_System_ "HVESS_Thermal_Management_System__RawPayload";
BA_ "SystemSignalLongSymbol" SG_ 2147548187 HVESS_Thermal_Management_System_ "HVESS_Thermal_Management_System__RawPayload";
BA_ "SystemSignalLongSymbol" SG_ 2147548188 Refrigeration_Compartment_Inform "Refrigeration_Compartment_Inform_RawPayload";
BA_ "SystemSignalLongSymbol" SG_ 2147548189 Refrigeration_Compartment_Inform "Refrigeration_Compartment_Inform_RawPayload";
BA_ "SystemSignalLongSymbol" SG_ 2147548190 Vehicle_Electrical_Power_16_RawP "Vehicle_Electrical_Power_16_RawPayload";
BA_ "SystemSignalLongSymbol" SG_ 2147548191 Vehicle_Electrical_Power_17_RawP "Vehicle_Electrical_Power_17_RawPayload";
BA_ "SystemSignalLongSymbol" SG_ 2147548192 High_Voltage_Energy_Storage_Syst "High_Voltage_Energy_Storage_Syst_RawPayload";
BA_ "SystemSignalLongSymbol" SG_ 2147548193 High_Voltage_Energy_Storage_Syst "High_Voltage_Energy_Storage_Syst_RawPayload";
BA_ "SystemSignalLongSymbol" SG_ 2147548194 Electronic_Engine_Controller_19_ "Electronic_Engine_Controller_19_RawPayload";
BA_ "SystemSignalLongSymbol" SG_ 2147548195 Fuel_Consumption_Liquid_2_RawPay "Fuel_Consumption_Liquid_2_RawPayload";
BA_ "SystemSignalLongSymbol" SG_ 2147548196 Aftertreatment_2_Diesel_Exhaust_ "Aftertreatment_2_Diesel_Exhaust__RawPayload";
BA_ "SystemSignalLongSymbol" SG_ 2147548197 Aftertreatment_1_Diesel_Exhaust_ "Aftertreatment_1_Diesel_Exhaust__RawPayload";
BA_ "SystemSignalLongSymbol" SG_ 2147548198 Aftertreatment_2_Diesel_Exhaust_ "Aftertreatment_2_Diesel_Exhaust__RawPayload";
BA_ "SystemSignalLongSymbol" SG_ 2147548199 Aftertreatment_1_Diesel_Exhaust_ "Aftertreatment_1_Diesel_Exhaust__RawPayload";
BA_ "SystemSignalLongSymbol" SG_ 2147548200 Cruise_Control_Vehicle_Speed_6_R "Cruise_Control_Vehicle_Speed_6_RawPayload";
BA_ "SystemSignalLongSymbol" SG_ 2147548202 Operator_Inducement_Information_ "Operator_Inducement_Information__RawPayload";
BA_ "SystemSignalLongSymbol" SG_ 2147548203 Cruise_Control_Vehicle_Speed_4_R "Cruise_Control_Vehicle_Speed_4_RawPayload";
BA_ "SystemSignalLongSymbol" SG_ 2147548204 Brake_Caliper_Lining_Clearance_R "Brake_Caliper_Lining_Clearance_RawPayload";
BA_ "SystemSignalLongSymbol" SG_ 2147548206 Engine_Turbocharger_Control_3_Ra "Engine_Turbocharger_Control_3_RawPayload";
BA_ "SystemSignalLongSymbol" SG_ 2147548207 Fire_Suppression_Agent_Status_Ra "Fire_Suppression_Agent_Status_RawPayload";
BA_ "SystemSignalLongSymbol" SG_ 2147548208 SCR_Operator_Inducement_Informat "SCR_Operator_Inducement_Informat_RawPayload";
BA_ "SystemSignalLongSymbol" SG_ 2147548209 Aftertreatment_System_Informatio "Aftertreatment_System_Informatio_RawPayload";
BA_ "SystemSignalLongSymbol" SG_ 2147548210 Aftertreatment_1_Particulate_Sen "Aftertreatment_1_Particulate_Sen_RawPayload";
BA_ "SystemSignalLongSymbol" SG_ 2147548211 Engine_Fuel_Injector_Metering_Ra "Engine_Fuel_Injector_Metering_Ra_RawPayload";
BA_ "SystemSignalLongSymbol" SG_ 2147548212 Engine_Fuel_Injector_Metering_Ra "Engine_Fuel_Injector_Metering_Ra_RawPayload";
BA_ "SystemSignalLongSymbol" SG_ 2147548213 Aftertreatment_2_Diesel_Exhaust_ "Aftertreatment_2_Diesel_Exhaust__RawPayload";
BA_ "SystemSignalLongSymbol" SG_ 2147548214 Gaseous_Fuel_Supply_Valve_Inform "Gaseous_Fuel_Supply_Valve_Inform_RawPayload";
BA_ "SystemSignalLongSymbol" SG_ 2147548215 Engine_Oil_Mist_Detection_Inform "Engine_Oil_Mist_Detection_Inform_RawPayload";
BA_ "SystemSignalLongSymbol" SG_ 2147548216 Engine_Oil_Mist_Detection_Inform "Engine_Oil_Mist_Detection_Inform_RawPayload";
BA_ "SystemSignalLongSymbol" SG_ 2147548217 Gaseous_Fuel_Supply_Pressure_2_R "Gaseous_Fuel_Supply_Pressure_2_RawPayload";
BA_ "SystemSignalLongSymbol" SG_ 2147548218 Gaseous_Fuel_Supply_Pressure_1_R "Gaseous_Fuel_Supply_Pressure_1_RawPayload";
BA_ "SystemSignalLongSymbol" SG_ 2147548219 Engine_End_Bearing_Temperature_3 "Engine_End_Bearing_Temperature_3_RawPayload";
BA_ "SystemSignalLongSymbol" SG_ 2147548220 Engine_End_Bearing_Temperature_2 "Engine_End_Bearing_Temperature_2_RawPayload";
BA_ "SystemSignalLongSymbol" SG_ 2147548221 Engine_End_Bearing_Temperature_1 "Engine_End_Bearing_Temperature_1_RawPayload";
BA_ "SystemSignalLongSymbol" SG_ 2147548222 Heat_Exchanger_Debris_Purge_Info "Heat_Exchanger_Debris_Purge_Info_RawPayload";
BA_ "SystemSignalLongSymbol" SG_ 2147548223 Engine_Turbocharger_Control_2_Ra "Engine_Turbocharger_Control_2_RawPayload";
BA_ "SystemSignalLongSymbol" SG_ 2147548224 Engine_Hydraulic_Fuel_2_Pump_Sta "Engine_Hydraulic_Fuel_2_Pump_Sta_RawPayload";
BA_ "SystemSignalLongSymbol" SG_ 2147548226 Tire_Condition_Message_2_RawPayl "Tire_Condition_Message_2_RawPayload";
BA_ "SystemSignalLongSymbol" SG_ 2147548227 Tire_Configuration_Status_Inform "Tire_Configuration_Status_Inform_RawPayload";
BA_ "SystemSignalLongSymbol" SG_ 2147548228 High_Voltage_Energy_Storage_Syst "High_Voltage_Energy_Storage_Syst_RawPayload";
BA_ "SystemSignalLongSymbol" SG_ 2147548229 Tire_Wireless_Signal_Strength_In "Tire_Wireless_Signal_Strength_In_RawPayload";
BA_ "SystemSignalLongSymbol" SG_ 2147548230 Tire_Sensor_Identification_Statu "Tire_Sensor_Identification_Statu_RawPayload";
BA_ "SystemSignalLongSymbol" SG_ 2147548231 Monitored_Tire_Information_RawPa "Monitored_Tire_Information_RawPayload";
BA_ "SystemSignalLongSymbol" SG_ 2147548232 Aftertreatment_2_Historical_Info "Aftertreatment_2_Historical_Info_RawPayload";
BA_ "SystemSignalLongSymbol" SG_ 2147548233 Aftertreatment_1_Historical_Info "Aftertreatment_1_Historical_Info_RawPayload";
BA_ "SystemSignalLongSymbol" SG_ 2147548235 Electronic_Engine_Controller_17_ "Electronic_Engine_Controller_17_RawPayload";
BA_ "SystemSignalLongSymbol" SG_ 2147548236 SCR_Operator_Inducement_Informat "SCR_Operator_Inducement_Informat_RawPayload";
BA_ "SystemSignalLongSymbol" SG_ 2147548237 Aftertreatment_2_SCR_Dosing_Syst "Aftertreatment_2_SCR_Dosing_Syst_RawPayload";
BA_ "SystemSignalLongSymbol" SG_ 2147548238 Aftertreatment_1_SCR_Dosing_Syst "Aftertreatment_1_SCR_Dosing_Syst_RawPayload";
BA_ "SystemSignalLongSymbol" SG_ 2147548239 Payload_Weight_Sensor_Informatio "Payload_Weight_Sensor_Informatio_RawPayload";
BA_ "SystemSignalLongSymbol" SG_ 2147548241 Air_Suspension_Control_7_RawPayl "Air_Suspension_Control_7_RawPayload";
BA_ "SystemSignalLongSymbol" SG_ 2147548242 Bin_Weight_and_Lift_Count_RawPay "Bin_Weight_and_Lift_Count_RawPayload";
BA_ "SystemSignalLongSymbol" SG_ 2147548243 Engine_Gaseous_Leakage_Informati "Engine_Gaseous_Leakage_Informati_RawPayload";
BA_ "SystemSignalLongSymbol" SG_ 2147548244 Driving_and_Rest_Times_Driver_2_ "Driving_and_Rest_Times_Driver_2_RawPayload";
BA_ "SystemSignalLongSymbol" SG_ 2147548245 Driving_and_Rest_Times_Driver_1_ "Driving_and_Rest_Times_Driver_1_RawPayload";
BA_ "SystemSignalLongSymbol" SG_ 2147548246 SCR_Operator_Inducement_Informat "SCR_Operator_Inducement_Informat_RawPayload";
BA_ "SystemSignalLongSymbol" SG_ 2147548247 SCR_Operator_Inducement_Informat "SCR_Operator_Inducement_Informat_RawPayload";
BA_ "SystemSignalLongSymbol" SG_ 2147548248 Turbocharger_Information_7_RawPa "Turbocharger_Information_7_RawPayload";
BA_ "SystemSignalLongSymbol" SG_ 2147548249 Engine_Load_Sharing_Information_ "Engine_Load_Sharing_Information_RawPayload";
BA_ "SystemSignalLongSymbol" SG_ 2147548250 Synchronized_Service_Distance_In "Synchronized_Service_Distance_In_RawPayload";
BA_ "SystemSignalLongSymbol" SG_ 2147548251 Synchronized_Service_Delay_Opera "Synchronized_Service_Delay_Opera_RawPayload";
BA_ "SystemSignalLongSymbol" SG_ 2147548252 Synchronized_Service_Delay_Calen "Synchronized_Service_Delay_Calen_RawPayload";
BA_ "SystemSignalLongSymbol" SG_ 2147548253 High_Voltage_Energy_Storage_Syst "High_Voltage_Energy_Storage_Syst_RawPayload";
BA_ "SystemSignalLongSymbol" SG_ 2147548254 High_Voltage_Energy_Storage_Syst "High_Voltage_Energy_Storage_Syst_RawPayload";
BA_ "SystemSignalLongSymbol" SG_ 2147548256 Encoder_High_Resolution_Position "Encoder_High_Resolution_Position_RawPayload";
BA_ "SystemSignalLongSymbol" SG_ 2147548259 Encoder_Position_with_Speed_and_ "Encoder_Position_with_Speed_and__RawPayload";
BA_ "SystemSignalLongSymbol" SG_ 2147548260 Inclinometer_Slope_Longitudinal_ "Inclinometer_Slope_Longitudinal__RawPayload";
BA_ "SystemSignalLongSymbol" SG_ 2147548261 Inclinometer_Slope_Longitudinal_ "Inclinometer_Slope_Longitudinal__RawPayload";
BA_ "SystemSignalLongSymbol" SG_ 2147548262 Inclinometer_Slope_Lateral_16_bi "Inclinometer_Slope_Lateral_16_bi_RawPayload";
BA_ "SystemSignalLongSymbol" SG_ 2147548263 Inclinometer_Slope_Lateral_32_bi "Inclinometer_Slope_Lateral_32_bi_RawPayload";
BA_ "SystemSignalLongSymbol" SG_ 2147548264 CANopen_Emergency_Message_RawPay "CANopen_Emergency_Message_RawPayload";
BA_ "SystemSignalLongSymbol" SG_ 2147548265 EV_Operator_Indicators_1_RawPayl "EV_Operator_Indicators_1_RawPayload";
BA_ "SystemSignalLongSymbol" SG_ 2147548267 Engine_Maximum_Net_Torque_Map_ob "Engine_Maximum_Net_Torque_Map_ob_RawPayload";
BA_ "SystemSignalLongSymbol" SG_ 2147548269 Acoustic_Warning_Request_RawPayl "Acoustic_Warning_Request_RawPayload";
BA_ "SystemSignalLongSymbol" SG_ 2147548270 Acoustic_Warning_State_RawPayloa "Acoustic_Warning_State_RawPayload";
BA_ "SystemSignalLongSymbol" SG_ 2147548272 Body_Application_Unit_1_RawPaylo "Body_Application_Unit_1_RawPayload";
BA_ "SystemSignalLongSymbol" SG_ 2147548273 Body_Application_Unit_2_RawPaylo "Body_Application_Unit_2_RawPayload";
BA_ "SystemSignalLongSymbol" SG_ 2147548274 Body_Application_Unit_3_RawPaylo "Body_Application_Unit_3_RawPayload";
BA_ "SystemSignalLongSymbol" SG_ 2147548275 Body_Application_Unit_4_RawPaylo "Body_Application_Unit_4_RawPayload";
BA_ "SystemSignalLongSymbol" SG_ 2147548276 Body_Application_Unit_5_RawPaylo "Body_Application_Unit_5_RawPayload";
BA_ "SystemSignalLongSymbol" SG_ 2147548277 Body_Application_Unit_6_RawPaylo "Body_Application_Unit_6_RawPayload";
BA_ "SystemSignalLongSymbol" SG_ 2147548278 Body_Application_Unit_7_RawPaylo "Body_Application_Unit_7_RawPayload";
BA_ "SystemSignalLongSymbol" SG_ 2147548279 Body_Application_Unit_8_RawPaylo "Body_Application_Unit_8_RawPayload";
BA_ "SystemSignalLongSymbol" SG_ 2147548280 Electronic_Control_Unit_RawPaylo "Electronic_Control_Unit_RawPayload";
BA_ "SystemSignalLongSymbol" SG_ 2147548284 Heating_And_Refrigerating_Unit_1 "Heating_And_Refrigerating_Unit_1_RawPayload";
BA_ "SystemSignalLongSymbol" SG_ 2147548285 Heating_And_Refrigerating_Unit_2 "Heating_And_Refrigerating_Unit_2_RawPayload";
BA_ "SystemSignalLongSymbol" SG_ 2147548286 Heating_And_Refrigerating_Unit_3 "Heating_And_Refrigerating_Unit_3_RawPayload";
BA_ "SystemSignalLongSymbol" SG_ 2147548287 Heating_And_Refrigerating_Unit_4 "Heating_And_Refrigerating_Unit_4_RawPayload";
BA_ "SystemSignalLongSymbol" SG_ 2147548288 HRU_Temperature_Setpoint_RawPayl "HRU_Temperature_Setpoint_RawPayload";
BA_ "SystemSignalLongSymbol" SG_ 2147548292 Windshield_Wiper_Request_RawPayl "Windshield_Wiper_Request_RawPayload";
BA_ "SystemSignalLongSymbol" SG_ 2147548293 Fuel_Cell_Auxiliary_Heater_Contr "Fuel_Cell_Auxiliary_Heater_Contr_RawPayload";
BA_ "SystemSignalLongSymbol" SG_ 2147548294 Fuel_Cell_Auxiliary_Heater_Infor "Fuel_Cell_Auxiliary_Heater_Infor_RawPayload";
BA_ "SystemSignalLongSymbol" SG_ 2147548295 Fuel_Cell_Coolant_Pump_1_Command "Fuel_Cell_Coolant_Pump_1_Command_RawPayload";
BA_ "SystemSignalLongSymbol" SG_ 2147548296 Fuel_Cell_Coolant_Pump_2_Command "Fuel_Cell_Coolant_Pump_2_Command_RawPayload";
BA_ "SystemSignalLongSymbol" SG_ 2147548297 Fuel_Cell_Coolant_Pump_1_Status_ "Fuel_Cell_Coolant_Pump_1_Status_RawPayload";
BA_ "SystemSignalLongSymbol" SG_ 2147548298 Fuel_Cell_Coolant_Pump_2_Status_ "Fuel_Cell_Coolant_Pump_2_Status_RawPayload";
BA_ "SystemSignalLongSymbol" SG_ 2147548299 Aftertreatment_1_Particulate_Sen "Aftertreatment_1_Particulate_Sen_RawPayload";
BA_ "SystemSignalLongSymbol" SG_ 2147548300 Aftertreatment_1_Particulate_Sen "Aftertreatment_1_Particulate_Sen_RawPayload";
BA_ "SystemSignalLongSymbol" SG_ 2147548304 Engine_Fuel_Injector_Metering_Ra "Engine_Fuel_Injector_Metering_Ra_RawPayload";
BA_ "SystemSignalLongSymbol" SG_ 2147548307 Gaseous_Fuel_Pressure_2_RawPaylo "Gaseous_Fuel_Pressure_2_RawPayload";
BA_ "SystemSignalLongSymbol" SG_ 2147548308 Aftertreatment_System_Abuse_Info "Aftertreatment_System_Abuse_Info_RawPayload";
BA_ "SystemSignalLongSymbol" SG_ 2147548309 Engine_Cylinder_Pressure_Monitor "Engine_Cylinder_Pressure_Monitor_RawPayload";
BA_ "SystemSignalLongSymbol" SG_ 2147548311 Electronic_Steering_Control_2_Ra "Electronic_Steering_Control_2_RawPayload";
BA_ "SystemSignalLongSymbol" SG_ 2147548313 Assembly_Unit_Identification_Raw "Assembly_Unit_Identification_RawPayload";
BA_ "SystemSignalLongSymbol" SG_ 2147548314 Joystick_3_Lamp_Status_RawPayloa "Joystick_3_Lamp_Status_RawPayload";
BA_ "SystemSignalLongSymbol" SG_ 2147548315 Joystick_2_Lamp_Status_RawPayloa "Joystick_2_Lamp_Status_RawPayload";
BA_ "SystemSignalLongSymbol" SG_ 2147548316 Joystick_1_Lamp_Status_RawPayloa "Joystick_1_Lamp_Status_RawPayload";
BA_ "SystemSignalLongSymbol" SG_ 2147548317 Engine_Timing_Actuator_Position_ "Engine_Timing_Actuator_Position__RawPayload";
BA_ "SystemSignalLongSymbol" SG_ 2147548318 Engine_Timing_Actuator_Position_ "Engine_Timing_Actuator_Position_RawPayload";
BA_ "SystemSignalLongSymbol" SG_ 2147548320 Multi_fuel_Engine_Hours_RawPaylo "Multi_fuel_Engine_Hours_RawPayload";
BA_ "SystemSignalLongSymbol" SG_ 2147548321 Engine_Spark_Misfire_Rate_3_RawP "Engine_Spark_Misfire_Rate_3_RawPayload";
BA_ "SystemSignalLongSymbol" SG_ 2147548322 Engine_Spark_Misfire_Rate_2_RawP "Engine_Spark_Misfire_Rate_2_RawPayload";
BA_ "SystemSignalLongSymbol" SG_ 2147548323 Engine_Spark_Misfire_Rate_1_RawP "Engine_Spark_Misfire_Rate_1_RawPayload";
BA_ "SystemSignalLongSymbol" SG_ 2147548324 Engine_Spark_Maximum_Voltage_6_R "Engine_Spark_Maximum_Voltage_6_RawPayload";
BA_ "SystemSignalLongSymbol" SG_ 2147548325 Engine_Spark_Maximum_Voltage_5_R "Engine_Spark_Maximum_Voltage_5_RawPayload";
BA_ "SystemSignalLongSymbol" SG_ 2147548326 Engine_Spark_Maximum_Voltage_4_R "Engine_Spark_Maximum_Voltage_4_RawPayload";
BA_ "SystemSignalLongSymbol" SG_ 2147548327 Engine_Spark_Maximum_Voltage_3_R "Engine_Spark_Maximum_Voltage_3_RawPayload";
BA_ "SystemSignalLongSymbol" SG_ 2147548328 Engine_Spark_Maximum_Voltage_2_R "Engine_Spark_Maximum_Voltage_2_RawPayload";
BA_ "SystemSignalLongSymbol" SG_ 2147548329 Engine_Spark_Maximum_Voltage_1_R "Engine_Spark_Maximum_Voltage_1_RawPayload";
BA_ "SystemSignalLongSymbol" SG_ 2147548330 Engine_Spark_Minimum_Voltage_6_R "Engine_Spark_Minimum_Voltage_6_RawPayload";
BA_ "SystemSignalLongSymbol" SG_ 2147548331 Engine_Spark_Minimum_Voltage_5_R "Engine_Spark_Minimum_Voltage_5_RawPayload";
BA_ "SystemSignalLongSymbol" SG_ 2147548332 Engine_Spark_Minimum_Voltage_4_R "Engine_Spark_Minimum_Voltage_4_RawPayload";
BA_ "SystemSignalLongSymbol" SG_ 2147548333 Engine_Spark_Minimum_Voltage_3_R "Engine_Spark_Minimum_Voltage_3_RawPayload";
BA_ "SystemSignalLongSymbol" SG_ 2147548334 Engine_Spark_Minimum_Voltage_2_R "Engine_Spark_Minimum_Voltage_2_RawPayload";
BA_ "SystemSignalLongSymbol" SG_ 2147548335 Engine_Spark_Minimum_Voltage_1_R "Engine_Spark_Minimum_Voltage_1_RawPayload";
BA_ "SystemSignalLongSymbol" SG_ 2147548336 Engine_Ignition_Controller_Maint "Engine_Ignition_Controller_Maint_RawPayload";
BA_ "SystemSignalLongSymbol" SG_ 2147548337 Engine_Ignition_Control_Module_S "Engine_Ignition_Control_Module_S_RawPayload";
BA_ "SystemSignalLongSymbol" SG_ 2147548339 Fused_Power_Output_Current_RawPa "Fused_Power_Output_Current_RawPayload";
BA_ "SystemSignalLongSymbol" SG_ 2147548340 Switched_Power_Output_Status_Raw "Switched_Power_Output_Status_RawPayload";
BA_ "SystemSignalLongSymbol" SG_ 2147548341 Fused_Power_Output_Status_RawPay "Fused_Power_Output_Status_RawPayload";
BA_ "SystemSignalLongSymbol" SG_ 2147548342 Vehicle_Electrical_Power_5_RawPa "Vehicle_Electrical_Power_5_RawPayload";
BA_ "SystemSignalLongSymbol" SG_ 2147548343 Hybrid_or_EV_System_Status_2_Raw "Hybrid_or_EV_System_Status_2_RawPayload";
BA_ "SystemSignalLongSymbol" SG_ 2147548344 Aftertreatment_2_Service_2_RawPa "Aftertreatment_2_Service_2_RawPayload";
BA_ "SystemSignalLongSymbol" SG_ 2147548345 Aftertreatment_1_Service_2_RawPa "Aftertreatment_1_Service_2_RawPayload";
BA_ "SystemSignalLongSymbol" SG_ 2147548346 Aftertreatment_2_SCR_Electronic_ "Aftertreatment_2_SCR_Electronic__RawPayload";
BA_ "SystemSignalLongSymbol" SG_ 2147548347 Aftertreatment_1_SCR_Electronic_ "Aftertreatment_1_SCR_Electronic__RawPayload";
BA_ "SystemSignalLongSymbol" SG_ 2147548348 Aftertreatment_2_SCR_Service_Inf "Aftertreatment_2_SCR_Service_Inf_RawPayload";
BA_ "SystemSignalLongSymbol" SG_ 2147548349 Aftertreatment_1_SCR_Service_Inf "Aftertreatment_1_SCR_Service_Inf_RawPayload";
BA_ "SystemSignalLongSymbol" SG_ 2147548350 Electronic_Transmission_Controll "Electronic_Transmission_Controll_RawPayload";
BA_ "SystemSignalLongSymbol" SG_ 2147548351 Electronic_Transmission_Controll "Electronic_Transmission_Controll_RawPayload";
BA_ "SystemSignalLongSymbol" SG_ 2147548352 Electronic_Transmission_Controll "Electronic_Transmission_Controll_RawPayload";
BA_ "SystemSignalLongSymbol" SG_ 2147548354 Hybrid_or_EV_System_Status_1_Raw "Hybrid_or_EV_System_Status_1_RawPayload";
BA_ "SystemSignalLongSymbol" SG_ 2147548355 Fuel_Information_4_Gaseous_RawPa "Fuel_Information_4_Gaseous_RawPayload";
BA_ "SystemSignalLongSymbol" SG_ 2147548356 Aftertreatment_2_SCR_Exhaust_Gas "Aftertreatment_2_SCR_Exhaust_Gas_RawPayload";
BA_ "SystemSignalLongSymbol" SG_ 2147548357 Aftertreatment_1_SCR_Exhaust_Gas "Aftertreatment_1_SCR_Exhaust_Gas_RawPayload";
BA_ "SystemSignalLongSymbol" SG_ 2147548359 Model_Year_and_Certification_Eng "Model_Year_and_Certification_Eng_RawPayload";
BA_ "SystemSignalLongSymbol" SG_ 2147548360 Electronic_Engine_Controller_13_ "Electronic_Engine_Controller_13_RawPayload";
BA_ "SystemSignalLongSymbol" SG_ 2147548361 Engine_Fuel_Throttle_Valve_Infor "Engine_Fuel_Throttle_Valve_Infor_RawPayload";
BA_ "SystemSignalLongSymbol" SG_ 2147548362 Engine_Exhaust_Gas_Recirculation "Engine_Exhaust_Gas_Recirculation_RawPayload";
BA_ "SystemSignalLongSymbol" SG_ 2147548363 Engine_Exhaust_Gas_Recirculation "Engine_Exhaust_Gas_Recirculation_RawPayload";
BA_ "SystemSignalLongSymbol" SG_ 2147548364 Electronic_Engine_Controller_12_ "Electronic_Engine_Controller_12_RawPayload";
BA_ "SystemSignalLongSymbol" SG_ 2147548366 Drive_Strategy_command_RawPayloa "Drive_Strategy_command_RawPayload";
BA_ "SystemSignalLongSymbol" SG_ 2147548367 NOx_Sensor_Self_Diagnosis_Reques "NOx_Sensor_Self_Diagnosis_Reques_RawPayload";
BA_ "SystemSignalLongSymbol" SG_ 2147548368 Engine_Particulate_Sensor_Inform "Engine_Particulate_Sensor_Inform_RawPayload";
BA_ "SystemSignalLongSymbol" SG_ 2147548369 Active_Service_Only_DTCs_RawPayl "Active_Service_Only_DTCs_RawPayload";
BA_ "SystemSignalLongSymbol" SG_ 2147548370 Previously_Active_Service_Only_D "Previously_Active_Service_Only_D_RawPayload";
BA_ "SystemSignalLongSymbol" SG_ 2147548371 Diagnostic_Data_Clear_Reset_for_ "Diagnostic_Data_Clear_Reset_for__RawPayload";
BA_ "SystemSignalLongSymbol" SG_ 2147548373 Aftertreatment_1_Diesel_Exhaust_ "Aftertreatment_1_Diesel_Exhaust__RawPayload";
BA_ "SystemSignalLongSymbol" SG_ 2147548374 Aftertreatment_1_Diesel_Particul "Aftertreatment_1_Diesel_Particul_RawPayload";
BA_ "SystemSignalLongSymbol" SG_ 2147548375 Aftertreatment_1_Diesel_Particul "Aftertreatment_1_Diesel_Particul_RawPayload";
BA_ "SystemSignalLongSymbol" SG_ 2147548376 Aftertreatment_1_Diesel_Particul "Aftertreatment_1_Diesel_Particul_RawPayload";
BA_ "SystemSignalLongSymbol" SG_ 2147548377 Aftertreatment_1_Diesel_Particul "Aftertreatment_1_Diesel_Particul_RawPayload";
BA_ "SystemSignalLongSymbol" SG_ 2147548378 Aftertreatment_1_Diesel_Particul "Aftertreatment_1_Diesel_Particul_RawPayload";
BA_ "SystemSignalLongSymbol" SG_ 2147548379 Aftertreatment_1_Diesel_Particul "Aftertreatment_1_Diesel_Particul_RawPayload";
BA_ "SystemSignalLongSymbol" SG_ 2147548380 Cruise_Control_Vehicle_Speed_3_R "Cruise_Control_Vehicle_Speed_3_RawPayload";
BA_ "SystemSignalLongSymbol" SG_ 2147548381 Aftertreatment_2_Air_Control_3_R "Aftertreatment_2_Air_Control_3_RawPayload";
BA_ "SystemSignalLongSymbol" SG_ 2147548382 Aftertreatment_1_Air_Control_3_R "Aftertreatment_1_Air_Control_3_RawPayload";
BA_ "SystemSignalLongSymbol" SG_ 2147548383 Engine_Fluid_Level_Pressure_12_R "Engine_Fluid_Level_Pressure_12_RawPayload";
BA_ "SystemSignalLongSymbol" SG_ 2147548384 Diesel_Particulate_Filter_Contro "Diesel_Particulate_Filter_Contro_RawPayload";
BA_ "SystemSignalLongSymbol" SG_ 2147548386 Supplemental_Fan_Status_RawPaylo "Supplemental_Fan_Status_RawPayload";
BA_ "SystemSignalLongSymbol" SG_ 2147548387 Engine_Exhaust_Brake_Control_Raw "Engine_Exhaust_Brake_Control_RawPayload";
BA_ "SystemSignalLongSymbol" SG_ 2147548388 Engine_Fuel_Properties_RawPayloa "Engine_Fuel_Properties_RawPayload";
BA_ "SystemSignalLongSymbol" SG_ 2147548389 Hydraulic_Oil_Properties_RawPayl "Hydraulic_Oil_Properties_RawPayload";
BA_ "SystemSignalLongSymbol" SG_ 2147548390 Vehicle_Chassis_Lubrication_Syst "Vehicle_Chassis_Lubrication_Syst_RawPayload";
BA_ "SystemSignalLongSymbol" SG_ 2147548391 Engine_Configuration_3_RawPayloa "Engine_Configuration_3_RawPayload";
BA_ "SystemSignalLongSymbol" SG_ 2147548392 Intake_Valve_Actuation_Control_R "Intake_Valve_Actuation_Control_RawPayload";
BA_ "SystemSignalLongSymbol" SG_ 2147548393 Armrest_Switch_Matrix_Commands_R "Armrest_Switch_Matrix_Commands_RawPayload";
BA_ "SystemSignalLongSymbol" SG_ 2147548394 Vehicle_Electrical_Power_4_obsol "Vehicle_Electrical_Power_4_obsol_RawPayload";
BA_ "SystemSignalLongSymbol" SG_ 2147548395 Aftertreatment_2_NOx_Adsorber_In "Aftertreatment_2_NOx_Adsorber_In_RawPayload";
BA_ "SystemSignalLongSymbol" SG_ 2147548396 Aftertreatment_1_NOx_Adsorber_In "Aftertreatment_1_NOx_Adsorber_In_RawPayload";
BA_ "SystemSignalLongSymbol" SG_ 2147548397 Aftertreatment_2_Warm_Up_Diesel_ "Aftertreatment_2_Warm_Up_Diesel__RawPayload";
BA_ "SystemSignalLongSymbol" SG_ 2147548398 Land_Leveling_System_Reference_E "Land_Leveling_System_Reference_E_RawPayload";
BA_ "SystemSignalLongSymbol" SG_ 2147548399 Engine_Fluid_Level_Pressure_11_R "Engine_Fluid_Level_Pressure_11_RawPayload";
BA_ "SystemSignalLongSymbol" SG_ 2147548400 Engine_Fuel_Lube_x000D_Systems_2 "Engine_Fuel_Lube_x000D_Systems_2_RawPayload";
BA_ "SystemSignalLongSymbol" SG_ 2147548401 Engine_Turbocharger_Wastegate_Ac "Engine_Turbocharger_Wastegate_Ac_RawPayload";
BA_ "SystemSignalLongSymbol" SG_ 2147548402 Engine_Fuel_Throttle_Valve_Infor "Engine_Fuel_Throttle_Valve_Infor_RawPayload";
BA_ "SystemSignalLongSymbol" SG_ 2147548403 Engine_Turbocharger_Compressor_B "Engine_Turbocharger_Compressor_B_RawPayload";
BA_ "SystemSignalLongSymbol" SG_ 2147548405 Charge_Air_Cooler_2_Precooler_Ra "Charge_Air_Cooler_2_Precooler_RawPayload";
BA_ "SystemSignalLongSymbol" SG_ 2147548407 Charge_Air_Cooler_1_Precooler_Ra "Charge_Air_Cooler_1_Precooler_RawPayload";
BA_ "SystemSignalLongSymbol" SG_ 2147548408 Diesel_Particulate_Filter_2_Soot "Diesel_Particulate_Filter_2_Soot_RawPayload";
BA_ "SystemSignalLongSymbol" SG_ 2147548409 Diesel_Particulate_Filter_1_Soot "Diesel_Particulate_Filter_1_Soot_RawPayload";
BA_ "SystemSignalLongSymbol" SG_ 2147548410 Electronic_Engine_Controller_11_ "Electronic_Engine_Controller_11_RawPayload";
BA_ "SystemSignalLongSymbol" SG_ 2147548411 Engine_Manifold_Actuator_Positio "Engine_Manifold_Actuator_Positio_RawPayload";
BA_ "SystemSignalLongSymbol" SG_ 2147548412 Engine_Manifold_Actuator_Control "Engine_Manifold_Actuator_Control_RawPayload";
BA_ "SystemSignalLongSymbol" SG_ 2147548413 Electronic_Engine_Controller_9_R "Electronic_Engine_Controller_9_RawPayload";
BA_ "SystemSignalLongSymbol" SG_ 2147548414 Electronic_Engine_Controller_10_ "Electronic_Engine_Controller_10_RawPayload";
BA_ "SystemSignalLongSymbol" SG_ 2147548416 Engine_Fluid_Level_Pressure_10_R "Engine_Fluid_Level_Pressure_10_RawPayload";
BA_ "SystemSignalLongSymbol" SG_ 2147548417 Low_Voltage_Disconnect_Status_Ra "Low_Voltage_Disconnect_Status_RawPayload";
BA_ "SystemSignalLongSymbol" SG_ 2147548419 Implement_Operating_state_comman "Implement_Operating_state_comman_RawPayload";
BA_ "SystemSignalLongSymbol" SG_ 2147548420 Direct_Lamp_Control_Data_2_RawPa "Direct_Lamp_Control_Data_2_RawPayload";
BA_ "SystemSignalLongSymbol" SG_ 2147548421 Direct_Lamp_Control_Data_1_RawPa "Direct_Lamp_Control_Data_1_RawPayload";
BA_ "SystemSignalLongSymbol" SG_ 2147548422 Direct_Lamp_Control_Command_2_Ra "Direct_Lamp_Control_Command_2_RawPayload";
BA_ "SystemSignalLongSymbol" SG_ 2147548423 Direct_Lamp_Control_Command_1_Ra "Direct_Lamp_Control_Command_1_RawPayload";
BA_ "SystemSignalLongSymbol" SG_ 2147548426 Aftertreatment_2_Outlet_Gas_NOx_ "Aftertreatment_2_Outlet_Gas_NOx__RawPayload";
BA_ "SystemSignalLongSymbol" SG_ 2147548427 Aftertreatment_2_Outlet_Gas_NOx_ "Aftertreatment_2_Outlet_Gas_NOx__RawPayload";
BA_ "SystemSignalLongSymbol" SG_ 2147548428 Aftertreatment_2_Intake_Gas_NOx_ "Aftertreatment_2_Intake_Gas_NOx__RawPayload";
BA_ "SystemSignalLongSymbol" SG_ 2147548429 Aftertreatment_2_Intake_Gas_NOx_ "Aftertreatment_2_Intake_Gas_NOx__RawPayload";
BA_ "SystemSignalLongSymbol" SG_ 2147548430 Aftertreatment_1_Outlet_Gas_NOx_ "Aftertreatment_1_Outlet_Gas_NOx__RawPayload";
BA_ "SystemSignalLongSymbol" SG_ 2147548431 Aftertreatment_1_Outlet_Gas_NOx_ "Aftertreatment_1_Outlet_Gas_NOx__RawPayload";
BA_ "SystemSignalLongSymbol" SG_ 2147548432 Aftertreatment_1_Intake_Gas_NOx_ "Aftertreatment_1_Intake_Gas_NOx__RawPayload";
BA_ "SystemSignalLongSymbol" SG_ 2147548433 Aftertreatment_1_Intake_Gas_NOx_ "Aftertreatment_1_Intake_Gas_NOx__RawPayload";
BA_ "SystemSignalLongSymbol" SG_ 2147548434 Magnet_Status_Information_1_RawP "Magnet_Status_Information_1_RawPayload";
BA_ "SystemSignalLongSymbol" SG_ 2147548435 Magnet_System_Configuration_Info "Magnet_System_Configuration_Info_RawPayload";
BA_ "SystemSignalLongSymbol" SG_ 2147548438 Occupant_Classification_System_I "Occupant_Classification_System_I_RawPayload";
BA_ "SystemSignalLongSymbol" SG_ 2147548439 Beltlock_and_Airbag_Deactivation "Beltlock_and_Airbag_Deactivation_RawPayload";
BA_ "SystemSignalLongSymbol" SG_ 2147548440 Collision_Sensor_Information_Raw "Collision_Sensor_Information_RawPayload";
BA_ "SystemSignalLongSymbol" SG_ 2147548441 Ignitor_Loop_Information_RawPayl "Ignitor_Loop_Information_RawPayload";
BA_ "SystemSignalLongSymbol" SG_ 2147548442 Aftertreatment_1_Warm_Up_Diesel_ "Aftertreatment_1_Warm_Up_Diesel__RawPayload";
BA_ "SystemSignalLongSymbol" SG_ 2147548443 Diesel_Particulate_Filter_2_Soot "Diesel_Particulate_Filter_2_Soot_RawPayload";
BA_ "SystemSignalLongSymbol" SG_ 2147548444 Diesel_Particulate_Filter_1_Soot "Diesel_Particulate_Filter_1_Soot_RawPayload";
BA_ "SystemSignalLongSymbol" SG_ 2147548445 Aftertreatment_Differential_Temp "Aftertreatment_Differential_Temp_RawPayload";
BA_ "SystemSignalLongSymbol" SG_ 2147548446 Aftertreatment_Differential_Temp "Aftertreatment_Differential_Temp_RawPayload";
BA_ "SystemSignalLongSymbol" SG_ 2147548447 Aftertreatment_2_Diesel_Oxidatio "Aftertreatment_2_Diesel_Oxidatio_RawPayload";
BA_ "SystemSignalLongSymbol" SG_ 2147548448 Aftertreatment_1_Diesel_Oxidatio "Aftertreatment_1_Diesel_Oxidatio_RawPayload";
BA_ "SystemSignalLongSymbol" SG_ 2147548449 Aftertreatment_2_Gas_Oxidation_C "Aftertreatment_2_Gas_Oxidation_C_RawPayload";
BA_ "SystemSignalLongSymbol" SG_ 2147548450 Aftertreatment_1_Gas_Oxidation_C "Aftertreatment_1_Gas_Oxidation_C_RawPayload";
BA_ "SystemSignalLongSymbol" SG_ 2147548451 Extended_Joystick_Message_10_Raw "Extended_Joystick_Message_10_RawPayload";
BA_ "SystemSignalLongSymbol" SG_ 2147548452 Basic_Joystick_Message_10_RawPay "Basic_Joystick_Message_10_RawPayload";
BA_ "SystemSignalLongSymbol" SG_ 2147548453 Extended_Joystick_Message_9_RawP "Extended_Joystick_Message_9_RawPayload";
BA_ "SystemSignalLongSymbol" SG_ 2147548454 Basic_Joystick_Message_9_RawPayl "Basic_Joystick_Message_9_RawPayload";
BA_ "SystemSignalLongSymbol" SG_ 2147548455 Extended_Joystick_Message_8_RawP "Extended_Joystick_Message_8_RawPayload";
BA_ "SystemSignalLongSymbol" SG_ 2147548456 Basic_Joystick_Message_8_RawPayl "Basic_Joystick_Message_8_RawPayload";
BA_ "SystemSignalLongSymbol" SG_ 2147548457 Extended_Joystick_Message_7_RawP "Extended_Joystick_Message_7_RawPayload";
BA_ "SystemSignalLongSymbol" SG_ 2147548458 Basic_Joystick_Message_7_RawPayl "Basic_Joystick_Message_7_RawPayload";
BA_ "SystemSignalLongSymbol" SG_ 2147548459 Extended_Joystick_Message_6_RawP "Extended_Joystick_Message_6_RawPayload";
BA_ "SystemSignalLongSymbol" SG_ 2147548460 Basic_Joystick_Message_6_RawPayl "Basic_Joystick_Message_6_RawPayload";
BA_ "SystemSignalLongSymbol" SG_ 2147548461 Extended_Joystick_Message_5_RawP "Extended_Joystick_Message_5_RawPayload";
BA_ "SystemSignalLongSymbol" SG_ 2147548462 Basic_Joystick_Message_5_RawPayl "Basic_Joystick_Message_5_RawPayload";
BA_ "SystemSignalLongSymbol" SG_ 2147548463 Extended_Joystick_Message_4_RawP "Extended_Joystick_Message_4_RawPayload";
BA_ "SystemSignalLongSymbol" SG_ 2147548464 Basic_Joystick_Message_4_RawPayl "Basic_Joystick_Message_4_RawPayload";
BA_ "SystemSignalLongSymbol" SG_ 2147548467 Aftertreatment_2_Diesel_Exhaust_ "Aftertreatment_2_Diesel_Exhaust__RawPayload";
BA_ "SystemSignalLongSymbol" SG_ 2147548468 Aftertreatment_2_SCR_Reagant_Tan "Aftertreatment_2_SCR_Reagant_Tan_RawPayload";
BA_ "SystemSignalLongSymbol" SG_ 2147548469 Aftertreatment_2_Diesel_Exhaust_ "Aftertreatment_2_Diesel_Exhaust__RawPayload";
