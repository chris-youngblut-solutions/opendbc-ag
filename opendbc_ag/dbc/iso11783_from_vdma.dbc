VERSION "created by canmatrix"

NS_ :

BS_: 250000

BU_:

BO_ 2147547577 VDMA_F9B9_Hydrogen_System_Status: 8 Vector__XXX
 SG_ Hydrogen_System_Status_RawPayloa : 0|64@1+ (1,0) [0|18446744073709551615] "" Vector__XXX

BO_ 2147547578 VDMA_F9BA_Route_Waypoint_GPS_Coo: 8 Vector__XXX
 SG_ Route_Waypoint_GPS_Coordinates_R : 0|64@1+ (1,0) [0|18446744073709551615] "" Vector__XXX

BO_ 2147547579 VDMA_F9BB_Route_Information: 8 Vector__XXX
 SG_ Route_Information_RawPayload : 0|64@1+ (1,0) [0|18446744073709551615] "" Vector__XXX

BO_ 2147547580 VDMA_F9BC_Engine_Fluid_Level_Pre: 8 Vector__XXX
 SG_ Engine_Fluid_Level_Pressure_15_R : 0|64@1+ (1,0) [0|18446744073709551615] "" Vector__XXX

BO_ 2147547581 VDMA_F9BD_Fuel_Cell_System_Coola: 8 Vector__XXX
 SG_ Fuel_Cell_System_Coolant_Informa : 0|64@1+ (1,0) [0|18446744073709551615] "" Vector__XXX

BO_ 2147547582 VDMA_F9BE_Transmission_Configura: 8 Vector__XXX
 SG_ Transmission_Configuration_3_Raw : 0|64@1+ (1,0) [0|18446744073709551615] "" Vector__XXX

BO_ 2147547583 VDMA_F9BF_Enrichment_Information: 8 Vector__XXX
 SG_ Enrichment_Information_RawPayloa : 0|64@1+ (1,0) [0|18446744073709551615] "" Vector__XXX

BO_ 2147547584 VDMA_F9C0_Fuel_Cell_System_Volta: 8 Vector__XXX
 SG_ Fuel_Cell_System_Voltage_Limit_C : 0|64@1+ (1,0) [0|18446744073709551615] "" Vector__XXX

BO_ 2147547586 VDMA_F9C2_Hydrogen_System_Inform: 8 Vector__XXX
 SG_ Hydrogen_System_Information_RawP : 0|64@1+ (1,0) [0|18446744073709551615] "" Vector__XXX

BO_ 2147547587 VDMA_F9C3_Auxiliary_Input_Output: 8 Vector__XXX
 SG_ Auxiliary_Input_Output_Status_17 : 0|64@1+ (1,0) [0|18446744073709551615] "" Vector__XXX

BO_ 2147547588 VDMA_F9C4_Auxiliary_Input_Output: 8 Vector__XXX
 SG_ Auxiliary_Input_Output_Status_16 : 0|64@1+ (1,0) [0|18446744073709551615] "" Vector__XXX

BO_ 2147547589 VDMA_F9C5_Auxiliary_Input_Output: 8 Vector__XXX
 SG_ Auxiliary_Input_Output_Status_15 : 0|64@1+ (1,0) [0|18446744073709551615] "" Vector__XXX

BO_ 2147547590 VDMA_F9C6_Auxiliary_Input_Output: 8 Vector__XXX
 SG_ Auxiliary_Input_Output_Status_14 : 0|64@1+ (1,0) [0|18446744073709551615] "" Vector__XXX

BO_ 2147547591 VDMA_F9C7_Auxiliary_Input_Output: 8 Vector__XXX
 SG_ Auxiliary_Input_Output_Status_13 : 0|64@1+ (1,0) [0|18446744073709551615] "" Vector__XXX

BO_ 2147547592 VDMA_F9C8_Auxiliary_Input_Output: 8 Vector__XXX
 SG_ Auxiliary_Input_Output_Status_12 : 0|64@1+ (1,0) [0|18446744073709551615] "" Vector__XXX

BO_ 2147547593 VDMA_F9C9_Auxiliary_Input_Output: 8 Vector__XXX
 SG_ Auxiliary_Input_Output_Status_11 : 0|64@1+ (1,0) [0|18446744073709551615] "" Vector__XXX

BO_ 2147547594 VDMA_F9CA_Auxiliary_Input_Output: 8 Vector__XXX
 SG_ Auxiliary_Input_Output_Status_10 : 0|64@1+ (1,0) [0|18446744073709551615] "" Vector__XXX

BO_ 2147547595 VDMA_F9CB_Auxiliary_Input_Output: 8 Vector__XXX
 SG_ Auxiliary_Input_Output_Status_9_ : 0|64@1+ (1,0) [0|18446744073709551615] "" Vector__XXX

BO_ 2147547596 VDMA_F9CC_Auxiliary_Input_Output: 8 Vector__XXX
 SG_ Auxiliary_Input_Output_Status_8_ : 0|64@1+ (1,0) [0|18446744073709551615] "" Vector__XXX

BO_ 2147547597 VDMA_F9CD_Aftertreatment_System_: 8 Vector__XXX
 SG_ Aftertreatment_System_Informatio : 0|64@1+ (1,0) [0|18446744073709551615] "" Vector__XXX

BO_ 2147547598 VDMA_F9CE_Brake_Temperature_6: 8 Vector__XXX
 SG_ Brake_Temperature_6_RawPayload : 0|64@1+ (1,0) [0|18446744073709551615] "" Vector__XXX

BO_ 2147547599 VDMA_F9CF_Brake_Temperature_5: 8 Vector__XXX
 SG_ Brake_Temperature_5_RawPayload : 0|64@1+ (1,0) [0|18446744073709551615] "" Vector__XXX

BO_ 2147547600 VDMA_F9D0_Brake_Temperature_4: 8 Vector__XXX
 SG_ Brake_Temperature_4_RawPayload : 0|64@1+ (1,0) [0|18446744073709551615] "" Vector__XXX

BO_ 2147547601 VDMA_F9D1_Brake_Temperature_3: 8 Vector__XXX
 SG_ Brake_Temperature_3_RawPayload : 0|64@1+ (1,0) [0|18446744073709551615] "" Vector__XXX

BO_ 2147547602 VDMA_F9D2_Brake_Temperature_2: 8 Vector__XXX
 SG_ Brake_Temperature_2_RawPayload : 0|64@1+ (1,0) [0|18446744073709551615] "" Vector__XXX

BO_ 2147547603 VDMA_F9D3_Brake_Temperature_1: 8 Vector__XXX
 SG_ Brake_Temperature_1_RawPayload : 0|64@1+ (1,0) [0|18446744073709551615] "" Vector__XXX

BO_ 2147547604 VDMA_F9D4_Wheel_Brake_Lining_Rem: 8 Vector__XXX
 SG_ Wheel_Brake_Lining_Remaining_Inf : 0|64@1+ (1,0) [0|18446744073709551615] "" Vector__XXX

BO_ 2147547605 VDMA_F9D5_Wheel_Brake_Lining_Rem: 8 Vector__XXX
 SG_ Wheel_Brake_Lining_Remaining_Inf : 0|64@1+ (1,0) [0|18446744073709551615] "" Vector__XXX

BO_ 2147547606 VDMA_F9D6_High_Voltage_Bus_Conta: 8 Vector__XXX
 SG_ High_Voltage_Bus_Contactor_Statu : 0|64@1+ (1,0) [0|18446744073709551615] "" Vector__XXX

BO_ 2147547607 VDMA_F9D7_High_Voltage_Bus_Conta: 8 Vector__XXX
 SG_ High_Voltage_Bus_Contactor_Statu : 0|64@1+ (1,0) [0|18446744073709551615] "" Vector__XXX

BO_ 2147547608 VDMA_F9D8_High_Voltage_Bus_Conne: 8 Vector__XXX
 SG_ High_Voltage_Bus_Connection_Comm : 0|64@1+ (1,0) [0|18446744073709551615] "" Vector__XXX

BO_ 2147547609 VDMA_F9D9_Cab_Illumination_Data: 8 Vector__XXX
 SG_ Cab_Illumination_Data_RawPayload : 0|64@1+ (1,0) [0|18446744073709551615] "" Vector__XXX

BO_ 2147547610 VDMA_F9DA_Service_Needed_DTC_Inf: 8 Vector__XXX
 SG_ Service_Needed_DTC_Information_R : 0|64@1+ (1,0) [0|18446744073709551615] "" Vector__XXX

BO_ 2147547611 VDMA_F9DB_EVSE_Status_2: 8 Vector__XXX
 SG_ EVSE_Status_2_RawPayload : 0|64@1+ (1,0) [0|18446744073709551615] "" Vector__XXX

BO_ 2147547612 VDMA_F9DC_High_Voltage_Energy_St: 8 Vector__XXX
 SG_ High_Voltage_Energy_Storage_Syst : 0|64@1+ (1,0) [0|18446744073709551615] "" Vector__XXX

BO_ 2147547613 VDMA_F9DD_High_Voltage_Energy_St: 8 Vector__XXX
 SG_ High_Voltage_Energy_Storage_Syst : 0|64@1+ (1,0) [0|18446744073709551615] "" Vector__XXX

BO_ 2147547614 VDMA_F9DE_High_Voltage_Energy_St: 8 Vector__XXX
 SG_ High_Voltage_Energy_Storage_Syst : 0|64@1+ (1,0) [0|18446744073709551615] "" Vector__XXX

BO_ 2147547615 VDMA_F9DF_HVESS_Coolant_Pump_1_S: 8 Vector__XXX
 SG_ HVESS_Coolant_Pump_1_Status_1_Ra : 0|64@1+ (1,0) [0|18446744073709551615] "" Vector__XXX

BO_ 2147547616 VDMA_F9E0_HVESS_Coolant_Pump_1_C: 8 Vector__XXX
 SG_ HVESS_Coolant_Pump_1_Command_Raw : 0|64@1+ (1,0) [0|18446744073709551615] "" Vector__XXX

BO_ 2147547617 VDMA_F9E1_HVESS_Coolant_Pump_2_S: 8 Vector__XXX
 SG_ HVESS_Coolant_Pump_2_Status_1_Ra : 0|64@1+ (1,0) [0|18446744073709551615] "" Vector__XXX

BO_ 2147547618 VDMA_F9E2_HVESS_Coolant_Pump_2_C: 8 Vector__XXX
 SG_ HVESS_Coolant_Pump_2_Command_Raw : 0|64@1+ (1,0) [0|18446744073709551615] "" Vector__XXX

BO_ 2147547619 VDMA_F9E3_Hydrogen_Sensor_Inform: 8 Vector__XXX
 SG_ Hydrogen_Sensor_Information_RawP : 0|64@1+ (1,0) [0|18446744073709551615] "" Vector__XXX

BO_ 2147547620 VDMA_F9E4_Operator_Inducement_In: 8 Vector__XXX
 SG_ Operator_Inducement_Information_ : 0|64@1+ (1,0) [0|18446744073709551615] "" Vector__XXX

BO_ 2147547621 VDMA_F9E5_Operator_Inducement_Ve: 8 Vector__XXX
 SG_ Operator_Inducement_Vehicle_Spee : 0|64@1+ (1,0) [0|18446744073709551615] "" Vector__XXX

BO_ 2147547622 VDMA_F9E6_Operator_Inducement_Ve: 8 Vector__XXX
 SG_ Operator_Inducement_Vehicle_Spee : 0|64@1+ (1,0) [0|18446744073709551615] "" Vector__XXX

BO_ 2147547623 VDMA_F9E7_Engine_Protection_Spee: 8 Vector__XXX
 SG_ Engine_Protection_Speed_Derate_I : 0|64@1+ (1,0) [0|18446744073709551615] "" Vector__XXX

BO_ 2147547624 VDMA_F9E8_Engine_Protection_Torq: 8 Vector__XXX
 SG_ Engine_Protection_Torque_Derate_ : 0|64@1+ (1,0) [0|18446744073709551615] "" Vector__XXX

BO_ 2147547625 VDMA_F9E9_Aftertreatment_System_: 8 Vector__XXX
 SG_ Aftertreatment_System_Informatio : 0|64@1+ (1,0) [0|18446744073709551615] "" Vector__XXX

BO_ 2147547626 VDMA_F9EA_SAE_J2012_3_Byte_DTC_D: 8 Vector__XXX
 SG_ SAE_J2012_3_Byte_DTC_Display_Raw : 0|64@1+ (1,0) [0|18446744073709551615] "" Vector__XXX

BO_ 2147547627 VDMA_F9EB_High_Voltage_Energy_St: 8 Vector__XXX
 SG_ High_Voltage_Energy_Storage_Syst : 0|64@1+ (1,0) [0|18446744073709551615] "" Vector__XXX

BO_ 2147547628 VDMA_F9EC_High_Voltage_Energy_St: 8 Vector__XXX
 SG_ High_Voltage_Energy_Storage_Syst : 0|64@1+ (1,0) [0|18446744073709551615] "" Vector__XXX

BO_ 2147547629 VDMA_F9ED_High_Voltage_Energy_St: 8 Vector__XXX
 SG_ High_Voltage_Energy_Storage_Syst : 0|64@1+ (1,0) [0|18446744073709551615] "" Vector__XXX

BO_ 2147547630 VDMA_F9EE_Engine_Cylinder_Averag: 8 Vector__XXX
 SG_ Engine_Cylinder_Average_Ignition : 0|64@1+ (1,0) [0|18446744073709551615] "" Vector__XXX

BO_ 2147547631 VDMA_F9EF_Engine_Cylinder_Averag: 8 Vector__XXX
 SG_ Engine_Cylinder_Average_Ignition : 0|64@1+ (1,0) [0|18446744073709551615] "" Vector__XXX

BO_ 2147547632 VDMA_F9F0_Engine_Cylinder_Averag: 8 Vector__XXX
 SG_ Engine_Cylinder_Average_Ignition : 0|64@1+ (1,0) [0|18446744073709551615] "" Vector__XXX

BO_ 2147547633 VDMA_F9F1_Engine_Cylinder_Averag: 8 Vector__XXX
 SG_ Engine_Cylinder_Average_Ignition : 0|64@1+ (1,0) [0|18446744073709551615] "" Vector__XXX

BO_ 2147547634 VDMA_F9F2_Engine_Cylinder_Averag: 8 Vector__XXX
 SG_ Engine_Cylinder_Average_Ignition : 0|64@1+ (1,0) [0|18446744073709551615] "" Vector__XXX

BO_ 2147547635 VDMA_F9F3_Engine_Indicated_Mean_: 8 Vector__XXX
 SG_ Engine_Indicated_Mean_Effective_ : 0|64@1+ (1,0) [0|18446744073709551615] "" Vector__XXX

BO_ 2147547636 VDMA_F9F4_Engine_Indicated_Mean_: 8 Vector__XXX
 SG_ Engine_Indicated_Mean_Effective_ : 0|64@1+ (1,0) [0|18446744073709551615] "" Vector__XXX

BO_ 2147547637 VDMA_F9F5_Engine_Indicated_Mean_: 8 Vector__XXX
 SG_ Engine_Indicated_Mean_Effective_ : 0|64@1+ (1,0) [0|18446744073709551615] "" Vector__XXX

BO_ 2147547638 VDMA_F9F6_Fuel_Cell_System_Coola: 8 Vector__XXX
 SG_ Fuel_Cell_System_Coolant_Fan_1_C : 0|64@1+ (1,0) [0|18446744073709551615] "" Vector__XXX

BO_ 2147547639 VDMA_F9F7_Fuel_Cell_System_Coola: 8 Vector__XXX
 SG_ Fuel_Cell_System_Coolant_Fan_1_S : 0|64@1+ (1,0) [0|18446744073709551615] "" Vector__XXX

BO_ 2147547640 VDMA_F9F8_Fuel_Cell_System_Coola: 8 Vector__XXX
 SG_ Fuel_Cell_System_Coolant_Fan_2_C : 0|64@1+ (1,0) [0|18446744073709551615] "" Vector__XXX

BO_ 2147547641 VDMA_F9F9_Fuel_Cell_System_Coola: 8 Vector__XXX
 SG_ Fuel_Cell_System_Coolant_Fan_2_S : 0|64@1+ (1,0) [0|18446744073709551615] "" Vector__XXX

BO_ 2147547642 VDMA_F9FA_Fuel_Cell_System_Coola: 8 Vector__XXX
 SG_ Fuel_Cell_System_Coolant_Fan_3_C : 0|64@1+ (1,0) [0|18446744073709551615] "" Vector__XXX

BO_ 2147547643 VDMA_F9FB_Fuel_Cell_System_Coola: 8 Vector__XXX
 SG_ Fuel_Cell_System_Coolant_Fan_3_S : 0|64@1+ (1,0) [0|18446744073709551615] "" Vector__XXX

BO_ 2147547644 VDMA_F9FC_Fuel_Cell_System_Coola: 8 Vector__XXX
 SG_ Fuel_Cell_System_Coolant_Fan_4_C : 0|64@1+ (1,0) [0|18446744073709551615] "" Vector__XXX

BO_ 2147547645 VDMA_F9FD_Fuel_Cell_System_Coola: 8 Vector__XXX
 SG_ Fuel_Cell_System_Coolant_Fan_4_S : 0|64@1+ (1,0) [0|18446744073709551615] "" Vector__XXX

BO_ 2147547646 VDMA_F9FE_APIs_Supported: 8 Vector__XXX
 SG_ APIs_Supported_RawPayload : 0|64@1+ (1,0) [0|18446744073709551615] "" Vector__XXX

BO_ 2147547647 VDMA_F9FF_Fuel_Cell_System_Confi: 8 Vector__XXX
 SG_ Fuel_Cell_System_Configuration_R : 0|64@1+ (1,0) [0|18446744073709551615] "" Vector__XXX

BO_ 2147547648 VDMA_FA00_Fuel_Cell_System_Coola: 8 Vector__XXX
 SG_ Fuel_Cell_System_Coolant_Informa : 0|64@1+ (1,0) [0|18446744073709551615] "" Vector__XXX

BO_ 2147547649 VDMA_FA01_Fuel_Cell_System_Coola: 8 Vector__XXX
 SG_ Fuel_Cell_System_Coolant_Informa : 0|64@1+ (1,0) [0|18446744073709551615] "" Vector__XXX

BO_ 2147547654 VDMA_FA06_Dash_Display_3: 8 Vector__XXX
 SG_ Dash_Display_3_RawPayload : 0|64@1+ (1,0) [0|18446744073709551615] "" Vector__XXX

BO_ 2147547655 VDMA_FA07_Vehicle_Speed_Profile: 8 Vector__XXX
 SG_ Vehicle_Speed_Profile_RawPayload : 0|64@1+ (1,0) [0|18446744073709551615] "" Vector__XXX

BO_ 2147547656 VDMA_FA08_Reference_Time: 8 Vector__XXX
 SG_ Reference_Time_RawPayload : 0|64@1+ (1,0) [0|18446744073709551615] "" Vector__XXX

BO_ 2147547657 VDMA_FA09_Software_History: 8 Vector__XXX
 SG_ Software_History_RawPayload : 0|64@1+ (1,0) [0|18446744073709551615] "" Vector__XXX

BO_ 2147547658 VDMA_FA0A_Motor_Generator_1_Ther: 8 Vector__XXX
 SG_ Motor_Generator_1_Thermal_Perfor : 0|64@1+ (1,0) [0|18446744073709551615] "" Vector__XXX

BO_ 2147547659 VDMA_FA0B_Motor_Generator_2_Ther: 8 Vector__XXX
 SG_ Motor_Generator_2_Thermal_Perfor : 0|64@1+ (1,0) [0|18446744073709551615] "" Vector__XXX

BO_ 2147547660 VDMA_FA0C_Motor_Generator_3_Ther: 8 Vector__XXX
 SG_ Motor_Generator_3_Thermal_Perfor : 0|64@1+ (1,0) [0|18446744073709551615] "" Vector__XXX

BO_ 2147547661 VDMA_FA0D_Motor_Generator_4_Ther: 8 Vector__XXX
 SG_ Motor_Generator_4_Thermal_Perfor : 0|64@1+ (1,0) [0|18446744073709551615] "" Vector__XXX

BO_ 2147547662 VDMA_FA0E_Motor_Generator_5_Ther: 8 Vector__XXX
 SG_ Motor_Generator_5_Thermal_Perfor : 0|64@1+ (1,0) [0|18446744073709551615] "" Vector__XXX

BO_ 2147547663 VDMA_FA0F_Motor_Generator_6_Ther: 8 Vector__XXX
 SG_ Motor_Generator_6_Thermal_Perfor : 0|64@1+ (1,0) [0|18446744073709551615] "" Vector__XXX

BO_ 2147547664 VDMA_FA10_On_Board_Programming_E: 8 Vector__XXX
 SG_ On_Board_Programming_Event_Time_ : 0|64@1+ (1,0) [0|18446744073709551615] "" Vector__XXX

BO_ 2147547665 VDMA_FA11_Aftertreatment_1_Light: 8 Vector__XXX
 SG_ Aftertreatment_1_Light_Off_SCR_S : 0|64@1+ (1,0) [0|18446744073709551615] "" Vector__XXX

BO_ 2147547666 VDMA_FA12_Motor_Generator_Locati: 8 Vector__XXX
 SG_ Motor_Generator_Location_Extende : 0|64@1+ (1,0) [0|18446744073709551615] "" Vector__XXX

BO_ 2147547667 VDMA_FA13_Cold_Start_Emissions_R: 8 Vector__XXX
 SG_ Cold_Start_Emissions_Reduction_S : 0|64@1+ (1,0) [0|18446744073709551615] "" Vector__XXX

BO_ 2147547668 VDMA_FA14_Cold_Start_Emissions_R: 8 Vector__XXX
 SG_ Cold_Start_Emissions_Reduction_S : 0|64@1+ (1,0) [0|18446744073709551615] "" Vector__XXX

BO_ 2147547669 VDMA_FA15_Genset_Supporting_Func: 8 Vector__XXX
 SG_ Genset_Supporting_Functions_RawP : 0|64@1+ (1,0) [0|18446744073709551615] "" Vector__XXX

BO_ 2147547670 VDMA_FA16_High_Voltage_Energy_St: 8 Vector__XXX
 SG_ High_Voltage_Energy_Storage_Syst : 0|64@1+ (1,0) [0|18446744073709551615] "" Vector__XXX

BO_ 2147547671 VDMA_FA17_High_Voltage_Energy_St: 8 Vector__XXX
 SG_ High_Voltage_Energy_Storage_Syst : 0|64@1+ (1,0) [0|18446744073709551615] "" Vector__XXX

BO_ 2147547672 VDMA_FA18_High_Voltage_Energy_St: 8 Vector__XXX
 SG_ High_Voltage_Energy_Storage_Syst : 0|64@1+ (1,0) [0|18446744073709551615] "" Vector__XXX

BO_ 2147547673 VDMA_FA19_High_Voltage_Energy_St: 8 Vector__XXX
 SG_ High_Voltage_Energy_Storage_Syst : 0|64@1+ (1,0) [0|18446744073709551615] "" Vector__XXX

BO_ 2147547674 VDMA_FA1A_Electronic_Engine_Cont: 8 Vector__XXX
 SG_ Electronic_Engine_Controller_23_ : 0|64@1+ (1,0) [0|18446744073709551615] "" Vector__XXX

BO_ 2147547675 VDMA_FA1B_Electronic_Engine_Cont: 8 Vector__XXX
 SG_ Electronic_Engine_Controller_24_ : 0|64@1+ (1,0) [0|18446744073709551615] "" Vector__XXX

BO_ 2147547676 VDMA_FA1C_Electronic_Engine_Cont: 8 Vector__XXX
 SG_ Electronic_Engine_Controller_25_ : 0|64@1+ (1,0) [0|18446744073709551615] "" Vector__XXX

BO_ 2147547677 VDMA_FA1D_High_Voltage_Bus_Conne: 8 Vector__XXX
 SG_ High_Voltage_Bus_Connection_Comm : 0|64@1+ (1,0) [0|18446744073709551615] "" Vector__XXX

BO_ 2147547678 VDMA_FA1E_High_Voltage_Bus_Conta: 8 Vector__XXX
 SG_ High_Voltage_Bus_Contactor_Statu : 0|64@1+ (1,0) [0|18446744073709551615] "" Vector__XXX

BO_ 2147547679 VDMA_FA1F_Aftertreatment_System_: 8 Vector__XXX
 SG_ Aftertreatment_System_Informatio : 0|64@1+ (1,0) [0|18446744073709551615] "" Vector__XXX

BO_ 2147547680 VDMA_FA20_EV_Multi_Connection_DC: 8 Vector__XXX
 SG_ EV_Multi_Connection_DC_Charging_ : 0|64@1+ (1,0) [0|18446744073709551615] "" Vector__XXX

BO_ 2147547681 VDMA_FA21_EV_Multi_Connection_Ch: 8 Vector__XXX
 SG_ EV_Multi_Connection_Charging_In_ : 0|64@1+ (1,0) [0|18446744073709551615] "" Vector__XXX

BO_ 2147547682 VDMA_FA22_Sensor_Supply_Voltage: 8 Vector__XXX
 SG_ Sensor_Supply_Voltage_RawPayload : 0|64@1+ (1,0) [0|18446744073709551615] "" Vector__XXX

BO_ 2147547683 VDMA_FA23_Motor_Generator_Locati: 8 Vector__XXX
 SG_ Motor_Generator_Location_obsolet : 0|64@1+ (1,0) [0|18446744073709551615] "" Vector__XXX

BO_ 2147547684 VDMA_FA24_High_Voltage_Energy_St: 8 Vector__XXX
 SG_ High_Voltage_Energy_Storage_Syst : 0|64@1+ (1,0) [0|18446744073709551615] "" Vector__XXX

BO_ 2147547685 VDMA_FA25_High_Voltage_Energy_St: 8 Vector__XXX
 SG_ High_Voltage_Energy_Storage_Syst : 0|64@1+ (1,0) [0|18446744073709551615] "" Vector__XXX

BO_ 2147547686 VDMA_FA26_High_Voltage_Energy_St: 8 Vector__XXX
 SG_ High_Voltage_Energy_Storage_Syst : 0|64@1+ (1,0) [0|18446744073709551615] "" Vector__XXX

BO_ 2147547687 VDMA_FA27_High_Voltage_Energy_St: 8 Vector__XXX
 SG_ High_Voltage_Energy_Storage_Pack : 0|64@1+ (1,0) [0|18446744073709551615] "" Vector__XXX

BO_ 2147547688 VDMA_FA28_High_Voltage_Energy_St: 8 Vector__XXX
 SG_ High_Voltage_Energy_Storage_Pack : 0|64@1+ (1,0) [0|18446744073709551615] "" Vector__XXX

BO_ 2147547689 VDMA_FA29_High_Voltage_Energy_St: 8 Vector__XXX
 SG_ High_Voltage_Energy_Storage_Pack : 0|64@1+ (1,0) [0|18446744073709551615] "" Vector__XXX

BO_ 2147547690 VDMA_FA2A_High_Voltage_Energy_St: 8 Vector__XXX
 SG_ High_Voltage_Energy_Storage_Pack : 0|64@1+ (1,0) [0|18446744073709551615] "" Vector__XXX

BO_ 2147547691 VDMA_FA2B_High_Voltage_Energy_St: 8 Vector__XXX
 SG_ High_Voltage_Energy_Storage_Pack : 0|64@1+ (1,0) [0|18446744073709551615] "" Vector__XXX

BO_ 2147547692 VDMA_FA2C_High_Voltage_Energy_St: 8 Vector__XXX
 SG_ High_Voltage_Energy_Storage_Pack : 0|64@1+ (1,0) [0|18446744073709551615] "" Vector__XXX

BO_ 2147547693 VDMA_FA2D_High_Voltage_Energy_St: 8 Vector__XXX
 SG_ High_Voltage_Energy_Storage_Pack : 0|64@1+ (1,0) [0|18446744073709551615] "" Vector__XXX

BO_ 2147547694 VDMA_FA2E_High_Voltage_Energy_St: 8 Vector__XXX
 SG_ High_Voltage_Energy_Storage_Pack : 0|64@1+ (1,0) [0|18446744073709551615] "" Vector__XXX

BO_ 2147547695 VDMA_FA2F_High_Voltage_Energy_St: 8 Vector__XXX
 SG_ High_Voltage_Energy_Storage_Pack : 0|64@1+ (1,0) [0|18446744073709551615] "" Vector__XXX

BO_ 2147547696 VDMA_FA30_High_Voltage_Energy_St: 8 Vector__XXX
 SG_ High_Voltage_Energy_Storage_Pack : 0|64@1+ (1,0) [0|18446744073709551615] "" Vector__XXX

BO_ 2147547697 VDMA_FA31_High_Voltage_Energy_St: 8 Vector__XXX
 SG_ High_Voltage_Energy_Storage_Pack : 0|64@1+ (1,0) [0|18446744073709551615] "" Vector__XXX

BO_ 2147547698 VDMA_FA32_High_Voltage_Energy_St: 8 Vector__XXX
 SG_ High_Voltage_Energy_Storage_Pack : 0|64@1+ (1,0) [0|18446744073709551615] "" Vector__XXX

BO_ 2147547699 VDMA_FA33_Multi_Color_Indicator_: 8 Vector__XXX
 SG_ Multi_Color_Indicator_Lamp_Comma : 0|64@1+ (1,0) [0|18446744073709551615] "" Vector__XXX

BO_ 2147547700 VDMA_FA34_Multi_Color_Indicator_: 8 Vector__XXX
 SG_ Multi_Color_Indicator_Lamp_Statu : 0|64@1+ (1,0) [0|18446744073709551615] "" Vector__XXX

BO_ 2147547701 VDMA_FA35_Refuse_Truck_Body_Info: 8 Vector__XXX
 SG_ Refuse_Truck_Body_Information_Ra : 0|64@1+ (1,0) [0|18446744073709551615] "" Vector__XXX

BO_ 2147547702 VDMA_FA36_Engine_Fluid_Level_Pre: 8 Vector__XXX
 SG_ Engine_Fluid_Level_Pressure_14_R : 0|64@1+ (1,0) [0|18446744073709551615] "" Vector__XXX

BO_ 2147547703 VDMA_FA37_Well_Stimulation_Trans: 8 Vector__XXX
 SG_ Well_Stimulation_Transmission_Co : 0|64@1+ (1,0) [0|18446744073709551615] "" Vector__XXX

BO_ 2147547704 VDMA_FA38_Well_Stimulation_Pump_: 8 Vector__XXX
 SG_ Well_Stimulation_Pump_Protection : 0|64@1+ (1,0) [0|18446744073709551615] "" Vector__XXX

BO_ 2147547705 VDMA_FA39_Well_Stimulation_Pump_: 8 Vector__XXX
 SG_ Well_Stimulation_Pump_Protection : 0|64@1+ (1,0) [0|18446744073709551615] "" Vector__XXX

BO_ 2147547706 VDMA_FA3A_Electric_PTO_Drive_Eng: 8 Vector__XXX
 SG_ Electric_PTO_Drive_Engagement_1_ : 0|64@1+ (1,0) [0|18446744073709551615] "" Vector__XXX

BO_ 2147547707 VDMA_FA3B_Electric_PTO_1_Informa: 8 Vector__XXX
 SG_ Electric_PTO_1_Information_RawPa : 0|64@1+ (1,0) [0|18446744073709551615] "" Vector__XXX

BO_ 2147547708 VDMA_FA3C_Engine_Exhaust_O2_Sens: 8 Vector__XXX
 SG_ Engine_Exhaust_O2_Sensor_Informa : 0|64@1+ (1,0) [0|18446744073709551615] "" Vector__XXX

BO_ 2147547709 VDMA_FA3D_Gaseous_Fuel_Supply_Pr: 8 Vector__XXX
 SG_ Gaseous_Fuel_Supply_Pressure_3_R : 0|64@1+ (1,0) [0|18446744073709551615] "" Vector__XXX

BO_ 2147547710 VDMA_FA3E_Traffic_Signage: 8 Vector__XXX
 SG_ Traffic_Signage_RawPayload : 0|64@1+ (1,0) [0|18446744073709551615] "" Vector__XXX

BO_ 2147547711 VDMA_FA3F_Engine_Configuration_4: 8 Vector__XXX
 SG_ Engine_Configuration_4_RawPayloa : 0|64@1+ (1,0) [0|18446744073709551615] "" Vector__XXX

BO_ 2147547712 VDMA_FA40_Electronic_Transmissio: 8 Vector__XXX
 SG_ Electronic_Transmission_Controll : 0|64@1+ (1,0) [0|18446744073709551615] "" Vector__XXX

BO_ 2147547713 VDMA_FA41_Automated_Driving_Syst: 8 Vector__XXX
 SG_ Automated_Driving_System_Network : 0|64@1+ (1,0) [0|18446744073709551615] "" Vector__XXX

BO_ 2147547714 VDMA_FA42_Automated_Driving_Syst: 8 Vector__XXX
 SG_ Automated_Driving_System_Network : 0|64@1+ (1,0) [0|18446744073709551615] "" Vector__XXX

BO_ 2147547715 VDMA_FA43_Hybrid_or_EV_System_In: 8 Vector__XXX
 SG_ Hybrid_or_EV_System_Inputs_2_Raw : 0|64@1+ (1,0) [0|18446744073709551615] "" Vector__XXX

BO_ 2147547716 VDMA_FA44_Engine_Speed_Load_Fact: 8 Vector__XXX
 SG_ Engine_Speed_Load_Factor_Informa : 0|64@1+ (1,0) [0|18446744073709551615] "" Vector__XXX

BO_ 2147547717 VDMA_FA45_Generator_Trip_Energy_: 8 Vector__XXX
 SG_ Generator_Trip_Energy_2_RawPaylo : 0|64@1+ (1,0) [0|18446744073709551615] "" Vector__XXX

BO_ 2147547718 VDMA_FA46_Security_System_Machin: 8 Vector__XXX
 SG_ Security_System_Machine_Operatio : 0|64@1+ (1,0) [0|18446744073709551615] "" Vector__XXX

BO_ 2147547719 VDMA_FA47_Engine_Fuel_Actuator_S: 8 Vector__XXX
 SG_ Engine_Fuel_Actuator_Service_Mod : 0|64@1+ (1,0) [0|18446744073709551615] "" Vector__XXX

BO_ 2147547720 VDMA_FA48_Steering_Wheel_Control: 8 Vector__XXX
 SG_ Steering_Wheel_Controls_RawPaylo : 0|64@1+ (1,0) [0|18446744073709551615] "" Vector__XXX

BO_ 2147547721 VDMA_FA49_Park_Assist: 8 Vector__XXX
 SG_ Park_Assist_RawPayload : 0|64@1+ (1,0) [0|18446744073709551615] "" Vector__XXX

BO_ 2147547722 VDMA_FA4A_Extended_DTC_informati: 8 Vector__XXX
 SG_ Extended_DTC_information_RawPayl : 0|64@1+ (1,0) [0|18446744073709551615] "" Vector__XXX

BO_ 2147547723 VDMA_FA4B_Aftertreatment_2_SCR_D: 8 Vector__XXX
 SG_ Aftertreatment_2_SCR_Dosing_Syst : 0|64@1+ (1,0) [0|18446744073709551615] "" Vector__XXX

BO_ 2147547724 VDMA_FA4C_Aftertreatment_1_SCR_D: 8 Vector__XXX
 SG_ Aftertreatment_1_SCR_Dosing_Syst : 0|64@1+ (1,0) [0|18446744073709551615] "" Vector__XXX

BO_ 2147547725 VDMA_FA4D_EV_Economy_Information: 8 Vector__XXX
 SG_ EV_Economy_Information_RawPayloa : 0|64@1+ (1,0) [0|18446744073709551615] "" Vector__XXX

BO_ 2147547726 VDMA_FA4E_Automated_Driving_Syst: 8 Vector__XXX
 SG_ Automated_Driving_System_Status_ : 0|64@1+ (1,0) [0|18446744073709551615] "" Vector__XXX

BO_ 2147547727 VDMA_FA4F_Automated_Driving_Syst: 8 Vector__XXX
 SG_ Automated_Driving_System_Control : 0|64@1+ (1,0) [0|18446744073709551615] "" Vector__XXX

BO_ 2147547728 VDMA_FA50_Aftercooler_Valve: 8 Vector__XXX
 SG_ Aftercooler_Valve_RawPayload : 0|64@1+ (1,0) [0|18446744073709551615] "" Vector__XXX

BO_ 2147547729 VDMA_FA51_Engine_Radiator_1: 8 Vector__XXX
 SG_ Engine_Radiator_1_RawPayload : 0|64@1+ (1,0) [0|18446744073709551615] "" Vector__XXX

BO_ 2147547730 VDMA_FA52_Engine_Radiator_2: 8 Vector__XXX
 SG_ Engine_Radiator_2_RawPayload : 0|64@1+ (1,0) [0|18446744073709551615] "" Vector__XXX

BO_ 2147547731 VDMA_FA53_Genset_Enclosure_Venti: 8 Vector__XXX
 SG_ Genset_Enclosure_Ventilation_Raw : 0|64@1+ (1,0) [0|18446744073709551615] "" Vector__XXX

BO_ 2147547732 VDMA_FA54_Heat_Exchanger_1: 8 Vector__XXX
 SG_ Heat_Exchanger_1_RawPayload : 0|64@1+ (1,0) [0|18446744073709551615] "" Vector__XXX

BO_ 2147547733 VDMA_FA55_Heat_Exchanger_2: 8 Vector__XXX
 SG_ Heat_Exchanger_2_RawPayload : 0|64@1+ (1,0) [0|18446744073709551615] "" Vector__XXX

BO_ 2147547734 VDMA_FA56_Heat_Exchanger_3: 8 Vector__XXX
 SG_ Heat_Exchanger_3_RawPayload : 0|64@1+ (1,0) [0|18446744073709551615] "" Vector__XXX

BO_ 2147547735 VDMA_FA57_Heat_Exchanger_4: 8 Vector__XXX
 SG_ Heat_Exchanger_4_RawPayload : 0|64@1+ (1,0) [0|18446744073709551615] "" Vector__XXX

BO_ 2147547736 VDMA_FA58_Engine_Exhaust_Gas_Hea: 8 Vector__XXX
 SG_ Engine_Exhaust_Gas_Heat_Exchange : 0|64@1+ (1,0) [0|18446744073709551615] "" Vector__XXX

BO_ 2147547737 VDMA_FA59_Genset_Enclosure_Venti: 8 Vector__XXX
 SG_ Genset_Enclosure_Ventilation_Lou : 0|64@1+ (1,0) [0|18446744073709551615] "" Vector__XXX

BO_ 2147547738 VDMA_FA5A_Genset_External_Coolan: 8 Vector__XXX
 SG_ Genset_External_Coolant_System_R : 0|64@1+ (1,0) [0|18446744073709551615] "" Vector__XXX

BO_ 2147547739 VDMA_FA5B_EV_DC_Status_1: 8 Vector__XXX
 SG_ EV_DC_Status_1_RawPayload : 0|64@1+ (1,0) [0|18446744073709551615] "" Vector__XXX

BO_ 2147547740 VDMA_FA5C_EVSE_DC_Charging_Limit: 8 Vector__XXX
 SG_ EVSE_DC_Charging_Limits_3_RawPay : 0|64@1+ (1,0) [0|18446744073709551615] "" Vector__XXX

BO_ 2147547741 VDMA_FA5D_EVSE_Power_Max_Schedul: 8 Vector__XXX
 SG_ EVSE_Power_Max_Schedule_RawPaylo : 0|64@1+ (1,0) [0|18446744073709551615] "" Vector__XXX

BO_ 2147547742 VDMA_FA5E_EV_Charge_Profile: 8 Vector__XXX
 SG_ EV_Charge_Profile_RawPayload : 0|64@1+ (1,0) [0|18446744073709551615] "" Vector__XXX

BO_ 2147547743 VDMA_FA5F_EV_DC_Charging_Limits_: 8 Vector__XXX
 SG_ EV_DC_Charging_Limits_2_RawPaylo : 0|64@1+ (1,0) [0|18446744073709551615] "" Vector__XXX

BO_ 2147547744 VDMA_FA60_EV_DC_Charging_In_Prog: 8 Vector__XXX
 SG_ EV_DC_Charging_In_Progress_RawPa : 0|64@1+ (1,0) [0|18446744073709551615] "" Vector__XXX

BO_ 2147547746 VDMA_FA62_Lighting_Data_2: 8 Vector__XXX
 SG_ Lighting_Data_2_RawPayload : 0|64@1+ (1,0) [0|18446744073709551615] "" Vector__XXX

BO_ 2147547747 VDMA_FA63_Lighting_Command_2: 8 Vector__XXX
 SG_ Lighting_Command_2_RawPayload : 0|64@1+ (1,0) [0|18446744073709551615] "" Vector__XXX

BO_ 2147547748 VDMA_FA64_Aftertreatment_System_: 8 Vector__XXX
 SG_ Aftertreatment_System_Informatio : 0|64@1+ (1,0) [0|18446744073709551615] "" Vector__XXX

BO_ 2147547749 VDMA_FA65_Aftertreatment_System_: 8 Vector__XXX
 SG_ Aftertreatment_System_Informatio : 0|64@1+ (1,0) [0|18446744073709551615] "" Vector__XXX

BO_ 2147547750 VDMA_FA66_Aftertreatment_System_: 8 Vector__XXX
 SG_ Aftertreatment_System_Informatio : 0|64@1+ (1,0) [0|18446744073709551615] "" Vector__XXX

BO_ 2147547751 VDMA_FA67_Fluid_Resistance_1: 8 Vector__XXX
 SG_ Fluid_Resistance_1_RawPayload : 0|64@1+ (1,0) [0|18446744073709551615] "" Vector__XXX

BO_ 2147547752 VDMA_FA68_Power_Converter_2_Isol: 8 Vector__XXX
 SG_ Power_Converter_2_Isolation_Inte : 0|64@1+ (1,0) [0|18446744073709551615] "" Vector__XXX

BO_ 2147547753 VDMA_FA69_Power_Converter_1_Isol: 8 Vector__XXX
 SG_ Power_Converter_1_Isolation_Inte : 0|64@1+ (1,0) [0|18446744073709551615] "" Vector__XXX

BO_ 2147547754 VDMA_FA6A_Power_Converter_2_Limi: 8 Vector__XXX
 SG_ Power_Converter_2_Limits_Request : 0|64@1+ (1,0) [0|18446744073709551615] "" Vector__XXX

BO_ 2147547755 VDMA_FA6B_Power_Converter_2_Limi: 8 Vector__XXX
 SG_ Power_Converter_2_Limits_Request : 0|64@1+ (1,0) [0|18446744073709551615] "" Vector__XXX

BO_ 2147547756 VDMA_FA6C_Power_Converter_2_Limi: 8 Vector__XXX
 SG_ Power_Converter_2_Limits_Request : 0|64@1+ (1,0) [0|18446744073709551615] "" Vector__XXX

BO_ 2147547757 VDMA_FA6D_Power_Converter_1_Limi: 8 Vector__XXX
 SG_ Power_Converter_1_Limits_Request : 0|64@1+ (1,0) [0|18446744073709551615] "" Vector__XXX

BO_ 2147547758 VDMA_FA6E_Power_Converter_1_Limi: 8 Vector__XXX
 SG_ Power_Converter_1_Limits_Request : 0|64@1+ (1,0) [0|18446744073709551615] "" Vector__XXX

BO_ 2147547759 VDMA_FA6F_Power_Converter_1_Limi: 8 Vector__XXX
 SG_ Power_Converter_1_Limits_Request : 0|64@1+ (1,0) [0|18446744073709551615] "" Vector__XXX

BO_ 2147547760 VDMA_FA70_Inverter_1_Lifetime_Da: 8 Vector__XXX
 SG_ Inverter_1_Lifetime_Data_RawPayl : 0|64@1+ (1,0) [0|18446744073709551615] "" Vector__XXX

BO_ 2147547761 VDMA_FA71_Inverter_2_Lifetime_Da: 8 Vector__XXX
 SG_ Inverter_2_Lifetime_Data_RawPayl : 0|64@1+ (1,0) [0|18446744073709551615] "" Vector__XXX

BO_ 2147547762 VDMA_FA72_Power_Converter_2_Acti: 8 Vector__XXX
 SG_ Power_Converter_2_Active_Power_L : 0|64@1+ (1,0) [0|18446744073709551615] "" Vector__XXX

BO_ 2147547763 VDMA_FA73_Power_Converter_1_Acti: 8 Vector__XXX
 SG_ Power_Converter_1_Active_Power_L : 0|64@1+ (1,0) [0|18446744073709551615] "" Vector__XXX

BO_ 2147547764 VDMA_FA74_Power_Converter_2_Refe: 8 Vector__XXX
 SG_ Power_Converter_2_Reference_1_Ra : 0|64@1+ (1,0) [0|18446744073709551615] "" Vector__XXX

BO_ 2147547765 VDMA_FA75_Power_Converter_2_Refe: 8 Vector__XXX
 SG_ Power_Converter_2_Reference_2_Ra : 0|64@1+ (1,0) [0|18446744073709551615] "" Vector__XXX

BO_ 2147547766 VDMA_FA76_Power_Converter_2_Temp: 8 Vector__XXX
 SG_ Power_Converter_2_Temperature_Ra : 0|64@1+ (1,0) [0|18446744073709551615] "" Vector__XXX

BO_ 2147547767 VDMA_FA77_Power_Converter_1_Temp: 8 Vector__XXX
 SG_ Power_Converter_1_Temperature_Ra : 0|64@1+ (1,0) [0|18446744073709551615] "" Vector__XXX

BO_ 2147547768 VDMA_FA78_Power_Converter_1_Refe: 8 Vector__XXX
 SG_ Power_Converter_1_Reference_2_Ra : 0|64@1+ (1,0) [0|18446744073709551615] "" Vector__XXX

BO_ 2147547769 VDMA_FA79_Power_Converter_1_Refe: 8 Vector__XXX
 SG_ Power_Converter_1_Reference_1_Ra : 0|64@1+ (1,0) [0|18446744073709551615] "" Vector__XXX

BO_ 2147547770 VDMA_FA7A_Power_Converter_1_Phas: 8 Vector__XXX
 SG_ Power_Converter_1_Phase_Current_ : 0|64@1+ (1,0) [0|18446744073709551615] "" Vector__XXX

BO_ 2147547771 VDMA_FA7B_Power_Converter_2_Phas: 8 Vector__XXX
 SG_ Power_Converter_2_Phase_Current_ : 0|64@1+ (1,0) [0|18446744073709551615] "" Vector__XXX

BO_ 2147547772 VDMA_FA7C_Power_Converter_1_Phas: 8 Vector__XXX
 SG_ Power_Converter_1_Phase_Voltage_ : 0|64@1+ (1,0) [0|18446744073709551615] "" Vector__XXX

BO_ 2147547773 VDMA_FA7D_Power_Converter_2_Phas: 8 Vector__XXX
 SG_ Power_Converter_2_Phase_Voltage_ : 0|64@1+ (1,0) [0|18446744073709551615] "" Vector__XXX

BO_ 2147547774 VDMA_FA7E_Power_Converter_Power_: 8 Vector__XXX
 SG_ Power_Converter_Power_Module_Swi : 0|64@1+ (1,0) [0|18446744073709551615] "" Vector__XXX

BO_ 2147547775 VDMA_FA7F_Power_Converter_1_Powe: 8 Vector__XXX
 SG_ Power_Converter_1_Power_Module_S : 0|64@1+ (1,0) [0|18446744073709551615] "" Vector__XXX

BO_ 2147547776 VDMA_FA80_Power_Converter_2_Powe: 8 Vector__XXX
 SG_ Power_Converter_2_Power_Module_S : 0|64@1+ (1,0) [0|18446744073709551615] "" Vector__XXX

BO_ 2147547777 VDMA_FA81_Power_Converter_Totals: 8 Vector__XXX
 SG_ Power_Converter_Totals_1_RawPayl : 0|64@1+ (1,0) [0|18446744073709551615] "" Vector__XXX

BO_ 2147547778 VDMA_FA82_Transformer_Temperatur: 8 Vector__XXX
 SG_ Transformer_Temperatures_RawPayl : 0|64@1+ (1,0) [0|18446744073709551615] "" Vector__XXX

BO_ 2147547779 VDMA_FA83_Electrified_Accessory_: 8 Vector__XXX
 SG_ Electrified_Accessory_Engine_Coo : 0|64@1+ (1,0) [0|18446744073709551615] "" Vector__XXX

BO_ 2147547780 VDMA_FA84_High_Voltage_Energy_St: 8 Vector__XXX
 SG_ High_Voltage_Energy_Storage_Pack : 0|64@1+ (1,0) [0|18446744073709551615] "" Vector__XXX

BO_ 2147547781 VDMA_FA85_High_Voltage_Energy_St: 8 Vector__XXX
 SG_ High_Voltage_Energy_Storage_Pack : 0|64@1+ (1,0) [0|18446744073709551615] "" Vector__XXX

BO_ 2147547782 VDMA_FA86_High_Voltage_Energy_St: 8 Vector__XXX
 SG_ High_Voltage_Energy_Storage_Pack : 0|64@1+ (1,0) [0|18446744073709551615] "" Vector__XXX

BO_ 2147547783 VDMA_FA87_High_Voltage_Energy_St: 8 Vector__XXX
 SG_ High_Voltage_Energy_Storage_Pack : 0|64@1+ (1,0) [0|18446744073709551615] "" Vector__XXX

BO_ 2147547784 VDMA_FA88_High_Voltage_Energy_St: 8 Vector__XXX
 SG_ High_Voltage_Energy_Storage_Pack : 0|64@1+ (1,0) [0|18446744073709551615] "" Vector__XXX

BO_ 2147547785 VDMA_FA89_High_Voltage_Energy_St: 8 Vector__XXX
 SG_ High_Voltage_Energy_Storage_Pack : 0|64@1+ (1,0) [0|18446744073709551615] "" Vector__XXX

BO_ 2147547786 VDMA_FA8A_High_Voltage_Energy_St: 8 Vector__XXX
 SG_ High_Voltage_Energy_Storage_Pack : 0|64@1+ (1,0) [0|18446744073709551615] "" Vector__XXX

BO_ 2147547787 VDMA_FA8B_High_Voltage_Energy_St: 8 Vector__XXX
 SG_ High_Voltage_Energy_Storage_Pack : 0|64@1+ (1,0) [0|18446744073709551615] "" Vector__XXX

BO_ 2147547788 VDMA_FA8C_High_Voltage_Energy_St: 8 Vector__XXX
 SG_ High_Voltage_Energy_Storage_Pack : 0|64@1+ (1,0) [0|18446744073709551615] "" Vector__XXX

BO_ 2147547789 VDMA_FA8D_High_Voltage_Energy_St: 8 Vector__XXX
 SG_ High_Voltage_Energy_Storage_Pack : 0|64@1+ (1,0) [0|18446744073709551615] "" Vector__XXX

BO_ 2147547790 VDMA_FA8E_High_Voltage_Energy_St: 8 Vector__XXX
 SG_ High_Voltage_Energy_Storage_Pack : 0|64@1+ (1,0) [0|18446744073709551615] "" Vector__XXX

BO_ 2147547791 VDMA_FA8F_High_Voltage_Energy_St: 8 Vector__XXX
 SG_ High_Voltage_Energy_Storage_Pack : 0|64@1+ (1,0) [0|18446744073709551615] "" Vector__XXX

BO_ 2147547792 VDMA_FA90_High_Voltage_Energy_St: 8 Vector__XXX
 SG_ High_Voltage_Energy_Storage_Pack : 0|64@1+ (1,0) [0|18446744073709551615] "" Vector__XXX

BO_ 2147547793 VDMA_FA91_High_Voltage_Energy_St: 8 Vector__XXX
 SG_ High_Voltage_Energy_Storage_Pack : 0|64@1+ (1,0) [0|18446744073709551615] "" Vector__XXX

BO_ 2147547794 VDMA_FA92_High_Voltage_Energy_St: 8 Vector__XXX
 SG_ High_Voltage_Energy_Storage_Pack : 0|64@1+ (1,0) [0|18446744073709551615] "" Vector__XXX

BO_ 2147547795 VDMA_FA93_High_Voltage_Energy_St: 8 Vector__XXX
 SG_ High_Voltage_Energy_Storage_Pack : 0|64@1+ (1,0) [0|18446744073709551615] "" Vector__XXX

BO_ 2147547796 VDMA_FA94_High_Voltage_Energy_St: 8 Vector__XXX
 SG_ High_Voltage_Energy_Storage_Pack : 0|64@1+ (1,0) [0|18446744073709551615] "" Vector__XXX

BO_ 2147547797 VDMA_FA95_High_Voltage_Energy_St: 8 Vector__XXX
 SG_ High_Voltage_Energy_Storage_Pack : 0|64@1+ (1,0) [0|18446744073709551615] "" Vector__XXX

BO_ 2147547798 VDMA_FA96_High_Voltage_Energy_St: 8 Vector__XXX
 SG_ High_Voltage_Energy_Storage_Pack : 0|64@1+ (1,0) [0|18446744073709551615] "" Vector__XXX

BO_ 2147547799 VDMA_FA97_High_Voltage_Energy_St: 8 Vector__XXX
 SG_ High_Voltage_Energy_Storage_Pack : 0|64@1+ (1,0) [0|18446744073709551615] "" Vector__XXX

BO_ 2147547800 VDMA_FA98_High_Voltage_Energy_St: 8 Vector__XXX
 SG_ High_Voltage_Energy_Storage_Pack : 0|64@1+ (1,0) [0|18446744073709551615] "" Vector__XXX

BO_ 2147547801 VDMA_FA99_High_Voltage_Energy_St: 8 Vector__XXX
 SG_ High_Voltage_Energy_Storage_Pack : 0|64@1+ (1,0) [0|18446744073709551615] "" Vector__XXX

BO_ 2147547802 VDMA_FA9A_High_Voltage_Energy_St: 8 Vector__XXX
 SG_ High_Voltage_Energy_Storage_Pack : 0|64@1+ (1,0) [0|18446744073709551615] "" Vector__XXX

BO_ 2147547803 VDMA_FA9B_High_Voltage_Energy_St: 8 Vector__XXX
 SG_ High_Voltage_Energy_Storage_Pack : 0|64@1+ (1,0) [0|18446744073709551615] "" Vector__XXX

BO_ 2147547804 VDMA_FA9C_High_Voltage_Energy_St: 8 Vector__XXX
 SG_ High_Voltage_Energy_Storage_Pack : 0|64@1+ (1,0) [0|18446744073709551615] "" Vector__XXX

BO_ 2147547805 VDMA_FA9D_High_Voltage_Energy_St: 8 Vector__XXX
 SG_ High_Voltage_Energy_Storage_Pack : 0|64@1+ (1,0) [0|18446744073709551615] "" Vector__XXX

BO_ 2147547806 VDMA_FA9E_High_Voltage_Energy_St: 8 Vector__XXX
 SG_ High_Voltage_Energy_Storage_Pack : 0|64@1+ (1,0) [0|18446744073709551615] "" Vector__XXX

BO_ 2147547807 VDMA_FA9F_High_Voltage_Energy_St: 8 Vector__XXX
 SG_ High_Voltage_Energy_Storage_Pack : 0|64@1+ (1,0) [0|18446744073709551615] "" Vector__XXX

BO_ 2147547808 VDMA_FAA0_High_Voltage_Energy_St: 8 Vector__XXX
 SG_ High_Voltage_Energy_Storage_Pack : 0|64@1+ (1,0) [0|18446744073709551615] "" Vector__XXX

BO_ 2147547809 VDMA_FAA1_High_Voltage_Energy_St: 8 Vector__XXX
 SG_ High_Voltage_Energy_Storage_Pack : 0|64@1+ (1,0) [0|18446744073709551615] "" Vector__XXX

BO_ 2147547810 VDMA_FAA2_High_Voltage_Energy_St: 8 Vector__XXX
 SG_ High_Voltage_Energy_Storage_Pack : 0|64@1+ (1,0) [0|18446744073709551615] "" Vector__XXX

BO_ 2147547811 VDMA_FAA3_High_Voltage_Energy_St: 8 Vector__XXX
 SG_ High_Voltage_Energy_Storage_Pack : 0|64@1+ (1,0) [0|18446744073709551615] "" Vector__XXX

BO_ 2147547812 VDMA_FAA4_Automated_Driving_Syst: 8 Vector__XXX
 SG_ Automated_Driving_System_Control : 0|64@1+ (1,0) [0|18446744073709551615] "" Vector__XXX

BO_ 2147547813 VDMA_FAA5_Dual_Fuel_Mode_3: 8 Vector__XXX
 SG_ Dual_Fuel_Mode_3_RawPayload : 0|64@1+ (1,0) [0|18446744073709551615] "" Vector__XXX

BO_ 2147547814 VDMA_FAA6_Dual_Fuel_Mode_2: 8 Vector__XXX
 SG_ Dual_Fuel_Mode_2_RawPayload : 0|64@1+ (1,0) [0|18446744073709551615] "" Vector__XXX

BO_ 2147547815 VDMA_FAA7_Dual_Fuel_Mode_1: 8 Vector__XXX
 SG_ Dual_Fuel_Mode_1_RawPayload : 0|64@1+ (1,0) [0|18446744073709551615] "" Vector__XXX

BO_ 2147547816 VDMA_FAA8_Transmission_1_History: 8 Vector__XXX
 SG_ Transmission_1_History_RawPayloa : 0|64@1+ (1,0) [0|18446744073709551615] "" Vector__XXX

BO_ 2147547817 VDMA_FAA9_Transmission_Shaft_Twi: 8 Vector__XXX
 SG_ Transmission_Shaft_Twist_Informa : 0|64@1+ (1,0) [0|18446744073709551615] "" Vector__XXX

BO_ 2147547818 VDMA_FAAA_Electronic_Auxiliary_T: 8 Vector__XXX
 SG_ Electronic_Auxiliary_Transmissio : 0|64@1+ (1,0) [0|18446744073709551615] "" Vector__XXX

BO_ 2147547819 VDMA_FAAB_High_Voltage_Energy_St: 8 Vector__XXX
 SG_ High_Voltage_Energy_Storage_Pack : 0|64@1+ (1,0) [0|18446744073709551615] "" Vector__XXX

BO_ 2147547820 VDMA_FAAC_High_Voltage_Energy_St: 8 Vector__XXX
 SG_ High_Voltage_Energy_Storage_Pack : 0|64@1+ (1,0) [0|18446744073709551615] "" Vector__XXX

BO_ 2147547821 VDMA_FAAD_High_Voltage_Energy_St: 8 Vector__XXX
 SG_ High_Voltage_Energy_Storage_Pack : 0|64@1+ (1,0) [0|18446744073709551615] "" Vector__XXX

BO_ 2147547822 VDMA_FAAE_High_Voltage_Energy_St: 8 Vector__XXX
 SG_ High_Voltage_Energy_Storage_Pack : 0|64@1+ (1,0) [0|18446744073709551615] "" Vector__XXX

BO_ 2147547823 VDMA_FAAF_High_Voltage_Energy_St: 8 Vector__XXX
 SG_ High_Voltage_Energy_Storage_Pack : 0|64@1+ (1,0) [0|18446744073709551615] "" Vector__XXX

BO_ 2147547824 VDMA_FAB0_High_Voltage_Energy_St: 8 Vector__XXX
 SG_ High_Voltage_Energy_Storage_Pack : 0|64@1+ (1,0) [0|18446744073709551615] "" Vector__XXX

BO_ 2147547825 VDMA_FAB1_High_Voltage_Energy_St: 8 Vector__XXX
 SG_ High_Voltage_Energy_Storage_Pack : 0|64@1+ (1,0) [0|18446744073709551615] "" Vector__XXX

BO_ 2147547826 VDMA_FAB2_High_Voltage_Energy_St: 8 Vector__XXX
 SG_ High_Voltage_Energy_Storage_Pack : 0|64@1+ (1,0) [0|18446744073709551615] "" Vector__XXX

BO_ 2147547827 VDMA_FAB3_AUTOSAR_Time_Synchroni: 8 Vector__XXX
 SG_ AUTOSAR_Time_Synchronization_Raw : 0|64@1+ (1,0) [0|18446744073709551615] "" Vector__XXX

BO_ 2147547828 VDMA_FAB4_EV_DC_Charging_Limits_: 8 Vector__XXX
 SG_ EV_DC_Charging_Limits_1_RawPaylo : 0|64@1+ (1,0) [0|18446744073709551615] "" Vector__XXX

BO_ 2147547829 VDMA_FAB5_EVSE_DC_Charging_Limit: 8 Vector__XXX
 SG_ EVSE_DC_Charging_Limits_1_RawPay : 0|64@1+ (1,0) [0|18446744073709551615] "" Vector__XXX

BO_ 2147547830 VDMA_FAB6_EVSE_DC_Charging_Limit: 8 Vector__XXX
 SG_ EVSE_DC_Charging_Limits_2_RawPay : 0|64@1+ (1,0) [0|18446744073709551615] "" Vector__XXX

BO_ 2147547831 VDMA_FAB7_EV_DC_Charging_Target: 8 Vector__XXX
 SG_ EV_DC_Charging_Target_RawPayload : 0|64@1+ (1,0) [0|18446744073709551615] "" Vector__XXX

BO_ 2147547832 VDMA_FAB8_EVSE_DC_Status_1: 8 Vector__XXX
 SG_ EVSE_DC_Status_1_RawPayload : 0|64@1+ (1,0) [0|18446744073709551615] "" Vector__XXX

BO_ 2147547833 VDMA_FAB9_EVSE_1_Contactor_Cmd_1: 8 Vector__XXX
 SG_ EVSE_1_Contactor_Cmd_1_RawPayloa : 0|64@1+ (1,0) [0|18446744073709551615] "" Vector__XXX

BO_ 2147547834 VDMA_FABA_EVSE_1_Contactor_Statu: 8 Vector__XXX
 SG_ EVSE_1_Contactor_Status_1_RawPay : 0|64@1+ (1,0) [0|18446744073709551615] "" Vector__XXX

BO_ 2147547835 VDMA_FABB_Direct_Lamp_Control_Co: 8 Vector__XXX
 SG_ Direct_Lamp_Control_Command_3_Ra : 0|64@1+ (1,0) [0|18446744073709551615] "" Vector__XXX

BO_ 2147547836 VDMA_FABC_Direct_Lamp_Control_Da: 8 Vector__XXX
 SG_ Direct_Lamp_Control_Data_3_RawPa : 0|64@1+ (1,0) [0|18446744073709551615] "" Vector__XXX

BO_ 2147547837 VDMA_FABD_Motor_Generator_1_Life: 8 Vector__XXX
 SG_ Motor_Generator_1_Lifetime_Data_ : 0|64@1+ (1,0) [0|18446744073709551615] "" Vector__XXX

BO_ 2147547838 VDMA_FABE_Motor_Generator_2_Life: 8 Vector__XXX
 SG_ Motor_Generator_2_Lifetime_Data_ : 0|64@1+ (1,0) [0|18446744073709551615] "" Vector__XXX

BO_ 2147547839 VDMA_FABF_Motor_Generator_3_Life: 8 Vector__XXX
 SG_ Motor_Generator_3_Lifetime_Data_ : 0|64@1+ (1,0) [0|18446744073709551615] "" Vector__XXX

BO_ 2147547840 VDMA_FAC0_Motor_Generator_4_Life: 8 Vector__XXX
 SG_ Motor_Generator_4_Lifetime_Data_ : 0|64@1+ (1,0) [0|18446744073709551615] "" Vector__XXX

BO_ 2147547841 VDMA_FAC1_Motor_Generator_5_Life: 8 Vector__XXX
 SG_ Motor_Generator_5_Lifetime_Data_ : 0|64@1+ (1,0) [0|18446744073709551615] "" Vector__XXX

BO_ 2147547842 VDMA_FAC2_Motor_Generator_6_Life: 8 Vector__XXX
 SG_ Motor_Generator_6_Lifetime_Data_ : 0|64@1+ (1,0) [0|18446744073709551615] "" Vector__XXX

BO_ 2147547843 VDMA_FAC3_Air_Supply_Pressure_3: 8 Vector__XXX
 SG_ Air_Supply_Pressure_3_RawPayload : 0|64@1+ (1,0) [0|18446744073709551615] "" Vector__XXX

BO_ 2147547844 VDMA_FAC4_EVSE_AC_Supply_Voltage: 8 Vector__XXX
 SG_ EVSE_AC_Supply_Voltage_RawPayloa : 0|64@1+ (1,0) [0|18446744073709551615] "" Vector__XXX

BO_ 2147547845 VDMA_FAC5_EVSE_AC_3_Phase_Load: 8 Vector__XXX
 SG_ EVSE_AC_3_Phase_Load_RawPayload : 0|64@1+ (1,0) [0|18446744073709551615] "" Vector__XXX

BO_ 2147547846 VDMA_FAC6_Electronic_Retarder_Co: 8 Vector__XXX
 SG_ Electronic_Retarder_Controller_3 : 0|64@1+ (1,0) [0|18446744073709551615] "" Vector__XXX

BO_ 2147547848 VDMA_FAC8_Electronic_Transmissio: 8 Vector__XXX
 SG_ Electronic_Transmission_Controll : 0|64@1+ (1,0) [0|18446744073709551615] "" Vector__XXX

BO_ 2147547851 VDMA_FACB_Collision_Avoidance_Sy: 8 Vector__XXX
 SG_ Collision_Avoidance_System_4_Raw : 0|64@1+ (1,0) [0|18446744073709551615] "" Vector__XXX

BO_ 2147547852 VDMA_FACC_Collision_Avoidance_Sy: 8 Vector__XXX
 SG_ Collision_Avoidance_System_3_Raw : 0|64@1+ (1,0) [0|18446744073709551615] "" Vector__XXX

BO_ 2147547853 VDMA_FACD_Aftertreatment_1_SCR_E: 8 Vector__XXX
 SG_ Aftertreatment_1_SCR_Exhaust_Gas : 0|64@1+ (1,0) [0|18446744073709551615] "" Vector__XXX

BO_ 2147547854 VDMA_FACE_PTO_Information_2: 8 Vector__XXX
 SG_ PTO_Information_2_RawPayload : 0|64@1+ (1,0) [0|18446744073709551615] "" Vector__XXX

BO_ 2147547855 VDMA_FACF_EVCC_Diagnostic_Data_1: 8 Vector__XXX
 SG_ EVCC_Diagnostic_Data_1_RawPayloa : 0|64@1+ (1,0) [0|18446744073709551615] "" Vector__XXX

BO_ 2147547856 VDMA_FAD0_Cab_Door_Control_2: 8 Vector__XXX
 SG_ Cab_Door_Control_2_RawPayload : 0|64@1+ (1,0) [0|18446744073709551615] "" Vector__XXX

BO_ 2147547857 VDMA_FAD1_Engine_Average_Informa: 8 Vector__XXX
 SG_ Engine_Average_Information_2_Raw : 0|64@1+ (1,0) [0|18446744073709551615] "" Vector__XXX

BO_ 2147547858 VDMA_FAD2_Turbocharger_Informati: 8 Vector__XXX
 SG_ Turbocharger_Information_9_RawPa : 0|64@1+ (1,0) [0|18446744073709551615] "" Vector__XXX

BO_ 2147547859 VDMA_FAD3_Automated_Driving_Syst: 8 Vector__XXX
 SG_ Automated_Driving_System_Control : 0|64@1+ (1,0) [0|18446744073709551615] "" Vector__XXX

BO_ 2147547860 VDMA_FAD4_EVSE_AC_Status_2: 8 Vector__XXX
 SG_ EVSE_AC_Status_2_RawPayload : 0|64@1+ (1,0) [0|18446744073709551615] "" Vector__XXX

BO_ 2147547861 VDMA_FAD5_EVSE_AC_Status_1: 8 Vector__XXX
 SG_ EVSE_AC_Status_1_RawPayload : 0|64@1+ (1,0) [0|18446744073709551615] "" Vector__XXX

BO_ 2147547862 VDMA_FAD6_EVSE_Status_1: 8 Vector__XXX
 SG_ EVSE_Status_1_RawPayload : 0|64@1+ (1,0) [0|18446744073709551615] "" Vector__XXX

BO_ 2147547863 VDMA_FAD7_Object_Detection_Messa: 8 Vector__XXX
 SG_ Object_Detection_Message_1_1_Raw : 0|64@1+ (1,0) [0|18446744073709551615] "" Vector__XXX

BO_ 2147547864 VDMA_FAD8_Object_Detection_Messa: 8 Vector__XXX
 SG_ Object_Detection_Message_2_1_Raw : 0|64@1+ (1,0) [0|18446744073709551615] "" Vector__XXX

BO_ 2147547865 VDMA_FAD9_Object_Detection_Messa: 8 Vector__XXX
 SG_ Object_Detection_Message_2_2_Raw : 0|64@1+ (1,0) [0|18446744073709551615] "" Vector__XXX

BO_ 2147547866 VDMA_FADA_Object_Detection_Messa: 8 Vector__XXX
 SG_ Object_Detection_Message_2_3_Raw : 0|64@1+ (1,0) [0|18446744073709551615] "" Vector__XXX

BO_ 2147547867 VDMA_FADB_Object_Detection_Messa: 8 Vector__XXX
 SG_ Object_Detection_Message_2_4_Raw : 0|64@1+ (1,0) [0|18446744073709551615] "" Vector__XXX

BO_ 2147547868 VDMA_FADC_Object_Detection_Messa: 8 Vector__XXX
 SG_ Object_Detection_Message_2_5_Raw : 0|64@1+ (1,0) [0|18446744073709551615] "" Vector__XXX

BO_ 2147547869 VDMA_FADD_Object_Detection_Messa: 8 Vector__XXX
 SG_ Object_Detection_Message_2_6_Raw : 0|64@1+ (1,0) [0|18446744073709551615] "" Vector__XXX

BO_ 2147547870 VDMA_FADE_Object_Detection_Messa: 8 Vector__XXX
 SG_ Object_Detection_Message_2_7_Raw : 0|64@1+ (1,0) [0|18446744073709551615] "" Vector__XXX

BO_ 2147547871 VDMA_FADF_Object_Detection_Messa: 8 Vector__XXX
 SG_ Object_Detection_Message_2_8_Raw : 0|64@1+ (1,0) [0|18446744073709551615] "" Vector__XXX

BO_ 2147547872 VDMA_FAE0_Object_Detection_Messa: 8 Vector__XXX
 SG_ Object_Detection_Message_2_9_Raw : 0|64@1+ (1,0) [0|18446744073709551615] "" Vector__XXX

BO_ 2147547873 VDMA_FAE1_Object_Detection_Messa: 8 Vector__XXX
 SG_ Object_Detection_Message_2_10_Ra : 0|64@1+ (1,0) [0|18446744073709551615] "" Vector__XXX

BO_ 2147547874 VDMA_FAE2_Object_Detection_Messa: 8 Vector__XXX
 SG_ Object_Detection_Message_2_11_Ra : 0|64@1+ (1,0) [0|18446744073709551615] "" Vector__XXX

BO_ 2147547875 VDMA_FAE3_Object_Detection_Messa: 8 Vector__XXX
 SG_ Object_Detection_Message_2_12_Ra : 0|64@1+ (1,0) [0|18446744073709551615] "" Vector__XXX

BO_ 2147547876 VDMA_FAE4_Object_Detection_Messa: 8 Vector__XXX
 SG_ Object_Detection_Message_2_13_Ra : 0|64@1+ (1,0) [0|18446744073709551615] "" Vector__XXX

BO_ 2147547877 VDMA_FAE5_Object_Detection_Messa: 8 Vector__XXX
 SG_ Object_Detection_Message_2_14_Ra : 0|64@1+ (1,0) [0|18446744073709551615] "" Vector__XXX

BO_ 2147547878 VDMA_FAE6_Object_Detection_Messa: 8 Vector__XXX
 SG_ Object_Detection_Message_2_15_Ra : 0|64@1+ (1,0) [0|18446744073709551615] "" Vector__XXX

BO_ 2147547879 VDMA_FAE7_Object_Detection_Messa: 8 Vector__XXX
 SG_ Object_Detection_Message_2_16_Ra : 0|64@1+ (1,0) [0|18446744073709551615] "" Vector__XXX

BO_ 2147547880 VDMA_FAE8_Object_Detection_Messa: 8 Vector__XXX
 SG_ Object_Detection_Message_2_17_Ra : 0|64@1+ (1,0) [0|18446744073709551615] "" Vector__XXX

BO_ 2147547881 VDMA_FAE9_Object_Detection_Messa: 8 Vector__XXX
 SG_ Object_Detection_Message_2_18_Ra : 0|64@1+ (1,0) [0|18446744073709551615] "" Vector__XXX

CM_ BO_ 2147547577  "Source: isobus.net VDMA Data Dictionary (https://www.isobus.net/isobus/pGNAndSPN/8821?type=PGN)";
CM_ BO_ 2147547578  "Source: isobus.net VDMA Data Dictionary (https://www.isobus.net/isobus/pGNAndSPN/8824?type=PGN)";
CM_ BO_ 2147547579  "Source: isobus.net VDMA Data Dictionary (https://www.isobus.net/isobus/pGNAndSPN/8828?type=PGN)";
CM_ BO_ 2147547580  "Source: isobus.net VDMA Data Dictionary (https://www.isobus.net/isobus/pGNAndSPN/8830?type=PGN)";
CM_ BO_ 2147547581  "Source: isobus.net VDMA Data Dictionary (https://www.isobus.net/isobus/pGNAndSPN/8832?type=PGN)";
CM_ BO_ 2147547582  "Source: isobus.net VDMA Data Dictionary (https://www.isobus.net/isobus/pGNAndSPN/8852?type=PGN)";
CM_ BO_ 2147547583  "Source: isobus.net VDMA Data Dictionary (https://www.isobus.net/isobus/pGNAndSPN/8860?type=PGN)";
CM_ BO_ 2147547584  "Source: isobus.net VDMA Data Dictionary (https://www.isobus.net/isobus/pGNAndSPN/8865?type=PGN)";
CM_ BO_ 2147547586  "Source: isobus.net VDMA Data Dictionary (https://www.isobus.net/isobus/pGNAndSPN/8867?type=PGN)";
CM_ BO_ 2147547587  "Source: isobus.net VDMA Data Dictionary (https://www.isobus.net/isobus/pGNAndSPN/8871?type=PGN)";
CM_ BO_ 2147547588  "Source: isobus.net VDMA Data Dictionary (https://www.isobus.net/isobus/pGNAndSPN/8875?type=PGN)";
CM_ BO_ 2147547589  "Source: isobus.net VDMA Data Dictionary (https://www.isobus.net/isobus/pGNAndSPN/8879?type=PGN)";
CM_ BO_ 2147547590  "Source: isobus.net VDMA Data Dictionary (https://www.isobus.net/isobus/pGNAndSPN/8883?type=PGN)";
CM_ BO_ 2147547591  "Source: isobus.net VDMA Data Dictionary (https://www.isobus.net/isobus/pGNAndSPN/8887?type=PGN)";
CM_ BO_ 2147547592  "Source: isobus.net VDMA Data Dictionary (https://www.isobus.net/isobus/pGNAndSPN/8891?type=PGN)";
CM_ BO_ 2147547593  "Source: isobus.net VDMA Data Dictionary (https://www.isobus.net/isobus/pGNAndSPN/8895?type=PGN)";
CM_ BO_ 2147547594  "Source: isobus.net VDMA Data Dictionary (https://www.isobus.net/isobus/pGNAndSPN/8899?type=PGN)";
CM_ BO_ 2147547595  "Source: isobus.net VDMA Data Dictionary (https://www.isobus.net/isobus/pGNAndSPN/8903?type=PGN)";
CM_ BO_ 2147547596  "Source: isobus.net VDMA Data Dictionary (https://www.isobus.net/isobus/pGNAndSPN/8907?type=PGN)";
CM_ BO_ 2147547597  "Source: isobus.net VDMA Data Dictionary (https://www.isobus.net/isobus/pGNAndSPN/8909?type=PGN)";
CM_ BO_ 2147547598  "Source: isobus.net VDMA Data Dictionary (https://www.isobus.net/isobus/pGNAndSPN/8911?type=PGN)";
CM_ BO_ 2147547599  "Source: isobus.net VDMA Data Dictionary (https://www.isobus.net/isobus/pGNAndSPN/8915?type=PGN)";
CM_ BO_ 2147547600  "Source: isobus.net VDMA Data Dictionary (https://www.isobus.net/isobus/pGNAndSPN/8919?type=PGN)";
CM_ BO_ 2147547601  "Source: isobus.net VDMA Data Dictionary (https://www.isobus.net/isobus/pGNAndSPN/8923?type=PGN)";
CM_ BO_ 2147547602  "Source: isobus.net VDMA Data Dictionary (https://www.isobus.net/isobus/pGNAndSPN/8927?type=PGN)";
CM_ BO_ 2147547603  "Source: isobus.net VDMA Data Dictionary (https://www.isobus.net/isobus/pGNAndSPN/8931?type=PGN)";
CM_ BO_ 2147547604  "Source: isobus.net VDMA Data Dictionary (https://www.isobus.net/isobus/pGNAndSPN/8937?type=PGN)";
CM_ BO_ 2147547605  "Source: isobus.net VDMA Data Dictionary (https://www.isobus.net/isobus/pGNAndSPN/8945?type=PGN)";
CM_ BO_ 2147547606  "Source: isobus.net VDMA Data Dictionary (https://www.isobus.net/isobus/pGNAndSPN/8964?type=PGN)";
CM_ BO_ 2147547607  "Source: isobus.net VDMA Data Dictionary (https://www.isobus.net/isobus/pGNAndSPN/8991?type=PGN)";
CM_ BO_ 2147547608  "Source: isobus.net VDMA Data Dictionary (https://www.isobus.net/isobus/pGNAndSPN/9002?type=PGN)";
CM_ BO_ 2147547609  "Source: isobus.net VDMA Data Dictionary (https://www.isobus.net/isobus/pGNAndSPN/9004?type=PGN)";
CM_ BO_ 2147547610  "Source: isobus.net VDMA Data Dictionary (https://www.isobus.net/isobus/pGNAndSPN/9008?type=PGN)";
CM_ BO_ 2147547611  "Source: isobus.net VDMA Data Dictionary (https://www.isobus.net/isobus/pGNAndSPN/9012?type=PGN)";
CM_ BO_ 2147547612  "Source: isobus.net VDMA Data Dictionary (https://www.isobus.net/isobus/pGNAndSPN/9016?type=PGN)";
CM_ BO_ 2147547613  "Source: isobus.net VDMA Data Dictionary (https://www.isobus.net/isobus/pGNAndSPN/9020?type=PGN)";
CM_ BO_ 2147547614  "Source: isobus.net VDMA Data Dictionary (https://www.isobus.net/isobus/pGNAndSPN/9024?type=PGN)";
CM_ BO_ 2147547615  "Source: isobus.net VDMA Data Dictionary (https://www.isobus.net/isobus/pGNAndSPN/9032?type=PGN)";
CM_ BO_ 2147547616  "Source: isobus.net VDMA Data Dictionary (https://www.isobus.net/isobus/pGNAndSPN/9039?type=PGN)";
CM_ BO_ 2147547617  "Source: isobus.net VDMA Data Dictionary (https://www.isobus.net/isobus/pGNAndSPN/9047?type=PGN)";
CM_ BO_ 2147547618  "Source: isobus.net VDMA Data Dictionary (https://www.isobus.net/isobus/pGNAndSPN/9054?type=PGN)";
CM_ BO_ 2147547619  "Source: isobus.net VDMA Data Dictionary (https://www.isobus.net/isobus/pGNAndSPN/9058?type=PGN)";
CM_ BO_ 2147547620  "Source: isobus.net VDMA Data Dictionary (https://www.isobus.net/isobus/pGNAndSPN/9061?type=PGN)";
CM_ BO_ 2147547621  "Source: isobus.net VDMA Data Dictionary (https://www.isobus.net/isobus/pGNAndSPN/9064?type=PGN)";
CM_ BO_ 2147547622  "Source: isobus.net VDMA Data Dictionary (https://www.isobus.net/isobus/pGNAndSPN/9067?type=PGN)";
CM_ BO_ 2147547623  "Source: isobus.net VDMA Data Dictionary (https://www.isobus.net/isobus/pGNAndSPN/9073?type=PGN)";
CM_ BO_ 2147547624  "Source: isobus.net VDMA Data Dictionary (https://www.isobus.net/isobus/pGNAndSPN/9080?type=PGN)";
CM_ BO_ 2147547625  "Source: isobus.net VDMA Data Dictionary (https://www.isobus.net/isobus/pGNAndSPN/9082?type=PGN)";
CM_ BO_ 2147547626  "Source: isobus.net VDMA Data Dictionary (https://www.isobus.net/isobus/pGNAndSPN/9088?type=PGN)";
CM_ BO_ 2147547627  "Source: isobus.net VDMA Data Dictionary (https://www.isobus.net/isobus/pGNAndSPN/9098?type=PGN)";
CM_ BO_ 2147547628  "Source: isobus.net VDMA Data Dictionary (https://www.isobus.net/isobus/pGNAndSPN/9108?type=PGN)";
CM_ BO_ 2147547629  "Source: isobus.net VDMA Data Dictionary (https://www.isobus.net/isobus/pGNAndSPN/9109?type=PGN)";
CM_ BO_ 2147547630  "Source: isobus.net VDMA Data Dictionary (https://www.isobus.net/isobus/pGNAndSPN/9113?type=PGN)";
CM_ BO_ 2147547631  "Source: isobus.net VDMA Data Dictionary (https://www.isobus.net/isobus/pGNAndSPN/9117?type=PGN)";
CM_ BO_ 2147547632  "Source: isobus.net VDMA Data Dictionary (https://www.isobus.net/isobus/pGNAndSPN/9121?type=PGN)";
CM_ BO_ 2147547633  "Source: isobus.net VDMA Data Dictionary (https://www.isobus.net/isobus/pGNAndSPN/9125?type=PGN)";
CM_ BO_ 2147547634  "Source: isobus.net VDMA Data Dictionary (https://www.isobus.net/isobus/pGNAndSPN/9129?type=PGN)";
CM_ BO_ 2147547635  "Source: isobus.net VDMA Data Dictionary (https://www.isobus.net/isobus/pGNAndSPN/9137?type=PGN)";
CM_ BO_ 2147547636  "Source: isobus.net VDMA Data Dictionary (https://www.isobus.net/isobus/pGNAndSPN/9145?type=PGN)";
CM_ BO_ 2147547637  "Source: isobus.net VDMA Data Dictionary (https://www.isobus.net/isobus/pGNAndSPN/9153?type=PGN)";
CM_ BO_ 2147547638  "Source: isobus.net VDMA Data Dictionary (https://www.isobus.net/isobus/pGNAndSPN/9160?type=PGN)";
CM_ BO_ 2147547639  "Source: isobus.net VDMA Data Dictionary (https://www.isobus.net/isobus/pGNAndSPN/9168?type=PGN)";
CM_ BO_ 2147547640  "Source: isobus.net VDMA Data Dictionary (https://www.isobus.net/isobus/pGNAndSPN/9175?type=PGN)";
CM_ BO_ 2147547641  "Source: isobus.net VDMA Data Dictionary (https://www.isobus.net/isobus/pGNAndSPN/9183?type=PGN)";
CM_ BO_ 2147547642  "Source: isobus.net VDMA Data Dictionary (https://www.isobus.net/isobus/pGNAndSPN/9190?type=PGN)";
CM_ BO_ 2147547643  "Source: isobus.net VDMA Data Dictionary (https://www.isobus.net/isobus/pGNAndSPN/9198?type=PGN)";
CM_ BO_ 2147547644  "Source: isobus.net VDMA Data Dictionary (https://www.isobus.net/isobus/pGNAndSPN/9205?type=PGN)";
CM_ BO_ 2147547645  "Source: isobus.net VDMA Data Dictionary (https://www.isobus.net/isobus/pGNAndSPN/9213?type=PGN)";
CM_ BO_ 2147547646  "Source: isobus.net VDMA Data Dictionary (https://www.isobus.net/isobus/pGNAndSPN/9222?type=PGN)";
CM_ BO_ 2147547647  "Source: isobus.net VDMA Data Dictionary (https://www.isobus.net/isobus/pGNAndSPN/9227?type=PGN)";
CM_ BO_ 2147547648  "Source: isobus.net VDMA Data Dictionary (https://www.isobus.net/isobus/pGNAndSPN/9231?type=PGN)";
CM_ BO_ 2147547649  "Source: isobus.net VDMA Data Dictionary (https://www.isobus.net/isobus/pGNAndSPN/9236?type=PGN)";
CM_ BO_ 2147547654  "Source: isobus.net VDMA Data Dictionary (https://www.isobus.net/isobus/pGNAndSPN/9238?type=PGN)";
CM_ BO_ 2147547655  "Source: isobus.net VDMA Data Dictionary (https://www.isobus.net/isobus/pGNAndSPN/9241?type=PGN)";
CM_ BO_ 2147547656  "Source: isobus.net VDMA Data Dictionary (https://www.isobus.net/isobus/pGNAndSPN/9245?type=PGN)";
CM_ BO_ 2147547657  "Source: isobus.net VDMA Data Dictionary (https://www.isobus.net/isobus/pGNAndSPN/9246?type=PGN)";
CM_ BO_ 2147547658  "Source: isobus.net VDMA Data Dictionary (https://www.isobus.net/isobus/pGNAndSPN/9248?type=PGN)";
CM_ BO_ 2147547659  "Source: isobus.net VDMA Data Dictionary (https://www.isobus.net/isobus/pGNAndSPN/9250?type=PGN)";
CM_ BO_ 2147547660  "Source: isobus.net VDMA Data Dictionary (https://www.isobus.net/isobus/pGNAndSPN/9252?type=PGN)";
CM_ BO_ 2147547661  "Source: isobus.net VDMA Data Dictionary (https://www.isobus.net/isobus/pGNAndSPN/9254?type=PGN)";
CM_ BO_ 2147547662  "Source: isobus.net VDMA Data Dictionary (https://www.isobus.net/isobus/pGNAndSPN/9256?type=PGN)";
CM_ BO_ 2147547663  "Source: isobus.net VDMA Data Dictionary (https://www.isobus.net/isobus/pGNAndSPN/9258?type=PGN)";
CM_ BO_ 2147547664  "Source: isobus.net VDMA Data Dictionary (https://www.isobus.net/isobus/pGNAndSPN/9266?type=PGN)";
CM_ BO_ 2147547665  "Source: isobus.net VDMA Data Dictionary (https://www.isobus.net/isobus/pGNAndSPN/9268?type=PGN)";
CM_ BO_ 2147547666  "Source: isobus.net VDMA Data Dictionary (https://www.isobus.net/isobus/pGNAndSPN/9276?type=PGN)";
CM_ BO_ 2147547667  "Source: isobus.net VDMA Data Dictionary (https://www.isobus.net/isobus/pGNAndSPN/9286?type=PGN)";
CM_ BO_ 2147547668  "Source: isobus.net VDMA Data Dictionary (https://www.isobus.net/isobus/pGNAndSPN/9296?type=PGN)";
CM_ BO_ 2147547669  "Source: isobus.net VDMA Data Dictionary (https://www.isobus.net/isobus/pGNAndSPN/9300?type=PGN)";
CM_ BO_ 2147547670  "Source: isobus.net VDMA Data Dictionary (https://www.isobus.net/isobus/pGNAndSPN/9304?type=PGN)";
CM_ BO_ 2147547671  "Source: isobus.net VDMA Data Dictionary (https://www.isobus.net/isobus/pGNAndSPN/9308?type=PGN)";
CM_ BO_ 2147547672  "Source: isobus.net VDMA Data Dictionary (https://www.isobus.net/isobus/pGNAndSPN/9312?type=PGN)";
CM_ BO_ 2147547673  "Source: isobus.net VDMA Data Dictionary (https://www.isobus.net/isobus/pGNAndSPN/9316?type=PGN)";
CM_ BO_ 2147547674  "Source: isobus.net VDMA Data Dictionary (https://www.isobus.net/isobus/pGNAndSPN/9318?type=PGN)";
CM_ BO_ 2147547675  "Source: isobus.net VDMA Data Dictionary (https://www.isobus.net/isobus/pGNAndSPN/9324?type=PGN)";
CM_ BO_ 2147547676  "Source: isobus.net VDMA Data Dictionary (https://www.isobus.net/isobus/pGNAndSPN/9330?type=PGN)";
CM_ BO_ 2147547677  "Source: isobus.net VDMA Data Dictionary (https://www.isobus.net/isobus/pGNAndSPN/9357?type=PGN)";
CM_ BO_ 2147547678  "Source: isobus.net VDMA Data Dictionary (https://www.isobus.net/isobus/pGNAndSPN/9384?type=PGN)";
CM_ BO_ 2147547679  "Source: isobus.net VDMA Data Dictionary (https://www.isobus.net/isobus/pGNAndSPN/9385?type=PGN)";
CM_ BO_ 2147547680  "Source: isobus.net VDMA Data Dictionary (https://www.isobus.net/isobus/pGNAndSPN/9390?type=PGN)";
CM_ BO_ 2147547681  "Source: isobus.net VDMA Data Dictionary (https://www.isobus.net/isobus/pGNAndSPN/9396?type=PGN)";
CM_ BO_ 2147547682  "Source: isobus.net VDMA Data Dictionary (https://www.isobus.net/isobus/pGNAndSPN/9403?type=PGN)";
CM_ BO_ 2147547683  "Source: isobus.net VDMA Data Dictionary (https://www.isobus.net/isobus/pGNAndSPN/9410?type=PGN)";
CM_ BO_ 2147547684  "Source: isobus.net VDMA Data Dictionary (https://www.isobus.net/isobus/pGNAndSPN/9417?type=PGN)";
CM_ BO_ 2147547685  "Source: isobus.net VDMA Data Dictionary (https://www.isobus.net/isobus/pGNAndSPN/9421?type=PGN)";
CM_ BO_ 2147547686  "Source: isobus.net VDMA Data Dictionary (https://www.isobus.net/isobus/pGNAndSPN/9425?type=PGN)";
CM_ BO_ 2147547687  "Source: isobus.net VDMA Data Dictionary (https://www.isobus.net/isobus/pGNAndSPN/9441?type=PGN)";
CM_ BO_ 2147547688  "Source: isobus.net VDMA Data Dictionary (https://www.isobus.net/isobus/pGNAndSPN/9457?type=PGN)";
CM_ BO_ 2147547689  "Source: isobus.net VDMA Data Dictionary (https://www.isobus.net/isobus/pGNAndSPN/9473?type=PGN)";
CM_ BO_ 2147547690  "Source: isobus.net VDMA Data Dictionary (https://www.isobus.net/isobus/pGNAndSPN/9489?type=PGN)";
CM_ BO_ 2147547691  "Source: isobus.net VDMA Data Dictionary (https://www.isobus.net/isobus/pGNAndSPN/9505?type=PGN)";
CM_ BO_ 2147547692  "Source: isobus.net VDMA Data Dictionary (https://www.isobus.net/isobus/pGNAndSPN/9521?type=PGN)";
CM_ BO_ 2147547693  "Source: isobus.net VDMA Data Dictionary (https://www.isobus.net/isobus/pGNAndSPN/9537?type=PGN)";
CM_ BO_ 2147547694  "Source: isobus.net VDMA Data Dictionary (https://www.isobus.net/isobus/pGNAndSPN/9553?type=PGN)";
CM_ BO_ 2147547695  "Source: isobus.net VDMA Data Dictionary (https://www.isobus.net/isobus/pGNAndSPN/9569?type=PGN)";
CM_ BO_ 2147547696  "Source: isobus.net VDMA Data Dictionary (https://www.isobus.net/isobus/pGNAndSPN/9585?type=PGN)";
CM_ BO_ 2147547697  "Source: isobus.net VDMA Data Dictionary (https://www.isobus.net/isobus/pGNAndSPN/9601?type=PGN)";
CM_ BO_ 2147547698  "Source: isobus.net VDMA Data Dictionary (https://www.isobus.net/isobus/pGNAndSPN/9617?type=PGN)";
CM_ BO_ 2147547699  "Source: isobus.net VDMA Data Dictionary (https://www.isobus.net/isobus/pGNAndSPN/9631?type=PGN)";
CM_ BO_ 2147547700  "Source: isobus.net VDMA Data Dictionary (https://www.isobus.net/isobus/pGNAndSPN/9647?type=PGN)";
CM_ BO_ 2147547701  "Source: isobus.net VDMA Data Dictionary (https://www.isobus.net/isobus/pGNAndSPN/9652?type=PGN)";
CM_ BO_ 2147547702  "Source: isobus.net VDMA Data Dictionary (https://www.isobus.net/isobus/pGNAndSPN/9656?type=PGN)";
CM_ BO_ 2147547703  "Source: isobus.net VDMA Data Dictionary (https://www.isobus.net/isobus/pGNAndSPN/9663?type=PGN)";
CM_ BO_ 2147547704  "Source: isobus.net VDMA Data Dictionary (https://www.isobus.net/isobus/pGNAndSPN/9671?type=PGN)";
CM_ BO_ 2147547705  "Source: isobus.net VDMA Data Dictionary (https://www.isobus.net/isobus/pGNAndSPN/9678?type=PGN)";
CM_ BO_ 2147547706  "Source: isobus.net VDMA Data Dictionary (https://www.isobus.net/isobus/pGNAndSPN/9686?type=PGN)";
CM_ BO_ 2147547707  "Source: isobus.net VDMA Data Dictionary (https://www.isobus.net/isobus/pGNAndSPN/9689?type=PGN)";
CM_ BO_ 2147547708  "Source: isobus.net VDMA Data Dictionary (https://www.isobus.net/isobus/pGNAndSPN/9693?type=PGN)";
CM_ BO_ 2147547709  "Source: isobus.net VDMA Data Dictionary (https://www.isobus.net/isobus/pGNAndSPN/9698?type=PGN)";
CM_ BO_ 2147547710  "Source: isobus.net VDMA Data Dictionary (https://www.isobus.net/isobus/pGNAndSPN/9699?type=PGN)";
CM_ BO_ 2147547711  "Source: isobus.net VDMA Data Dictionary (https://www.isobus.net/isobus/pGNAndSPN/9701?type=PGN)";
CM_ BO_ 2147547712  "Source: isobus.net VDMA Data Dictionary (https://www.isobus.net/isobus/pGNAndSPN/9706?type=PGN)";
CM_ BO_ 2147547713  "Source: isobus.net VDMA Data Dictionary (https://www.isobus.net/isobus/pGNAndSPN/9714?type=PGN)";
CM_ BO_ 2147547714  "Source: isobus.net VDMA Data Dictionary (https://www.isobus.net/isobus/pGNAndSPN/9722?type=PGN)";
CM_ BO_ 2147547715  "Source: isobus.net VDMA Data Dictionary (https://www.isobus.net/isobus/pGNAndSPN/9723?type=PGN)";
CM_ BO_ 2147547716  "Source: isobus.net VDMA Data Dictionary (https://www.isobus.net/isobus/pGNAndSPN/9725?type=PGN)";
CM_ BO_ 2147547717  "Source: isobus.net VDMA Data Dictionary (https://www.isobus.net/isobus/pGNAndSPN/9726?type=PGN)";
CM_ BO_ 2147547718  "Source: isobus.net VDMA Data Dictionary (https://www.isobus.net/isobus/pGNAndSPN/9731?type=PGN)";
CM_ BO_ 2147547719  "Source: isobus.net VDMA Data Dictionary (https://www.isobus.net/isobus/pGNAndSPN/9733?type=PGN)";
CM_ BO_ 2147547720  "Source: isobus.net VDMA Data Dictionary (https://www.isobus.net/isobus/pGNAndSPN/9740?type=PGN)";
CM_ BO_ 2147547721  "Source: isobus.net VDMA Data Dictionary (https://www.isobus.net/isobus/pGNAndSPN/9742?type=PGN)";
CM_ BO_ 2147547722  "Source: isobus.net VDMA Data Dictionary (https://www.isobus.net/isobus/pGNAndSPN/9743?type=PGN)";
CM_ BO_ 2147547723  "Source: isobus.net VDMA Data Dictionary (https://www.isobus.net/isobus/pGNAndSPN/9745?type=PGN)";
CM_ BO_ 2147547724  "Source: isobus.net VDMA Data Dictionary (https://www.isobus.net/isobus/pGNAndSPN/9747?type=PGN)";
CM_ BO_ 2147547725  "Source: isobus.net VDMA Data Dictionary (https://www.isobus.net/isobus/pGNAndSPN/9749?type=PGN)";
CM_ BO_ 2147547726  "Source: isobus.net VDMA Data Dictionary (https://www.isobus.net/isobus/pGNAndSPN/9761?type=PGN)";
CM_ BO_ 2147547727  "Source: isobus.net VDMA Data Dictionary (https://www.isobus.net/isobus/pGNAndSPN/9765?type=PGN)";
CM_ BO_ 2147547728  "Source: isobus.net VDMA Data Dictionary (https://www.isobus.net/isobus/pGNAndSPN/9770?type=PGN)";
CM_ BO_ 2147547729  "Source: isobus.net VDMA Data Dictionary (https://www.isobus.net/isobus/pGNAndSPN/9781?type=PGN)";
CM_ BO_ 2147547730  "Source: isobus.net VDMA Data Dictionary (https://www.isobus.net/isobus/pGNAndSPN/9791?type=PGN)";
CM_ BO_ 2147547731  "Source: isobus.net VDMA Data Dictionary (https://www.isobus.net/isobus/pGNAndSPN/9795?type=PGN)";
CM_ BO_ 2147547732  "Source: isobus.net VDMA Data Dictionary (https://www.isobus.net/isobus/pGNAndSPN/9799?type=PGN)";
CM_ BO_ 2147547733  "Source: isobus.net VDMA Data Dictionary (https://www.isobus.net/isobus/pGNAndSPN/9803?type=PGN)";
CM_ BO_ 2147547734  "Source: isobus.net VDMA Data Dictionary (https://www.isobus.net/isobus/pGNAndSPN/9807?type=PGN)";
CM_ BO_ 2147547735  "Source: isobus.net VDMA Data Dictionary (https://www.isobus.net/isobus/pGNAndSPN/9811?type=PGN)";
CM_ BO_ 2147547736  "Source: isobus.net VDMA Data Dictionary (https://www.isobus.net/isobus/pGNAndSPN/9814?type=PGN)";
CM_ BO_ 2147547737  "Source: isobus.net VDMA Data Dictionary (https://www.isobus.net/isobus/pGNAndSPN/9820?type=PGN)";
CM_ BO_ 2147547738  "Source: isobus.net VDMA Data Dictionary (https://www.isobus.net/isobus/pGNAndSPN/9826?type=PGN)";
CM_ BO_ 2147547739  "Source: isobus.net VDMA Data Dictionary (https://www.isobus.net/isobus/pGNAndSPN/9829?type=PGN)";
CM_ BO_ 2147547740  "Source: isobus.net VDMA Data Dictionary (https://www.isobus.net/isobus/pGNAndSPN/9830?type=PGN)";
CM_ BO_ 2147547741  "Source: isobus.net VDMA Data Dictionary (https://www.isobus.net/isobus/pGNAndSPN/9837?type=PGN)";
CM_ BO_ 2147547742  "Source: isobus.net VDMA Data Dictionary (https://www.isobus.net/isobus/pGNAndSPN/9840?type=PGN)";
CM_ BO_ 2147547743  "Source: isobus.net VDMA Data Dictionary (https://www.isobus.net/isobus/pGNAndSPN/9844?type=PGN)";
CM_ BO_ 2147547744  "Source: isobus.net VDMA Data Dictionary (https://www.isobus.net/isobus/pGNAndSPN/9849?type=PGN)";
CM_ BO_ 2147547746  "Source: isobus.net VDMA Data Dictionary (https://www.isobus.net/isobus/pGNAndSPN/9850?type=PGN)";
CM_ BO_ 2147547747  "Source: isobus.net VDMA Data Dictionary (https://www.isobus.net/isobus/pGNAndSPN/9852?type=PGN)";
CM_ BO_ 2147547748  "Source: isobus.net VDMA Data Dictionary (https://www.isobus.net/isobus/pGNAndSPN/9854?type=PGN)";
CM_ BO_ 2147547749  "Source: isobus.net VDMA Data Dictionary (https://www.isobus.net/isobus/pGNAndSPN/9856?type=PGN)";
CM_ BO_ 2147547750  "Source: isobus.net VDMA Data Dictionary (https://www.isobus.net/isobus/pGNAndSPN/9858?type=PGN)";
CM_ BO_ 2147547751  "Source: isobus.net VDMA Data Dictionary (https://www.isobus.net/isobus/pGNAndSPN/9860?type=PGN)";
CM_ BO_ 2147547752  "Source: isobus.net VDMA Data Dictionary (https://www.isobus.net/isobus/pGNAndSPN/9864?type=PGN)";
CM_ BO_ 2147547753  "Source: isobus.net VDMA Data Dictionary (https://www.isobus.net/isobus/pGNAndSPN/9868?type=PGN)";
CM_ BO_ 2147547754  "Source: isobus.net VDMA Data Dictionary (https://www.isobus.net/isobus/pGNAndSPN/9874?type=PGN)";
CM_ BO_ 2147547755  "Source: isobus.net VDMA Data Dictionary (https://www.isobus.net/isobus/pGNAndSPN/9880?type=PGN)";
CM_ BO_ 2147547756  "Source: isobus.net VDMA Data Dictionary (https://www.isobus.net/isobus/pGNAndSPN/9886?type=PGN)";
CM_ BO_ 2147547757  "Source: isobus.net VDMA Data Dictionary (https://www.isobus.net/isobus/pGNAndSPN/9892?type=PGN)";
CM_ BO_ 2147547758  "Source: isobus.net VDMA Data Dictionary (https://www.isobus.net/isobus/pGNAndSPN/9898?type=PGN)";
CM_ BO_ 2147547759  "Source: isobus.net VDMA Data Dictionary (https://www.isobus.net/isobus/pGNAndSPN/9904?type=PGN)";
CM_ BO_ 2147547760  "Source: isobus.net VDMA Data Dictionary (https://www.isobus.net/isobus/pGNAndSPN/9908?type=PGN)";
CM_ BO_ 2147547761  "Source: isobus.net VDMA Data Dictionary (https://www.isobus.net/isobus/pGNAndSPN/9912?type=PGN)";
CM_ BO_ 2147547762  "Source: isobus.net VDMA Data Dictionary (https://www.isobus.net/isobus/pGNAndSPN/9930?type=PGN)";
CM_ BO_ 2147547763  "Source: isobus.net VDMA Data Dictionary (https://www.isobus.net/isobus/pGNAndSPN/9948?type=PGN)";
CM_ BO_ 2147547764  "Source: isobus.net VDMA Data Dictionary (https://www.isobus.net/isobus/pGNAndSPN/9953?type=PGN)";
CM_ BO_ 2147547765  "Source: isobus.net VDMA Data Dictionary (https://www.isobus.net/isobus/pGNAndSPN/9957?type=PGN)";
CM_ BO_ 2147547766  "Source: isobus.net VDMA Data Dictionary (https://www.isobus.net/isobus/pGNAndSPN/9961?type=PGN)";
CM_ BO_ 2147547767  "Source: isobus.net VDMA Data Dictionary (https://www.isobus.net/isobus/pGNAndSPN/9965?type=PGN)";
CM_ BO_ 2147547768  "Source: isobus.net VDMA Data Dictionary (https://www.isobus.net/isobus/pGNAndSPN/9969?type=PGN)";
CM_ BO_ 2147547769  "Source: isobus.net VDMA Data Dictionary (https://www.isobus.net/isobus/pGNAndSPN/9974?type=PGN)";
CM_ BO_ 2147547770  "Source: isobus.net VDMA Data Dictionary (https://www.isobus.net/isobus/pGNAndSPN/9977?type=PGN)";
CM_ BO_ 2147547771  "Source: isobus.net VDMA Data Dictionary (https://www.isobus.net/isobus/pGNAndSPN/9980?type=PGN)";
CM_ BO_ 2147547772  "Source: isobus.net VDMA Data Dictionary (https://www.isobus.net/isobus/pGNAndSPN/9983?type=PGN)";
CM_ BO_ 2147547773  "Source: isobus.net VDMA Data Dictionary (https://www.isobus.net/isobus/pGNAndSPN/9986?type=PGN)";
CM_ BO_ 2147547774  "Source: isobus.net VDMA Data Dictionary (https://www.isobus.net/isobus/pGNAndSPN/9992?type=PGN)";
CM_ BO_ 2147547775  "Source: isobus.net VDMA Data Dictionary (https://www.isobus.net/isobus/pGNAndSPN/9995?type=PGN)";
CM_ BO_ 2147547776  "Source: isobus.net VDMA Data Dictionary (https://www.isobus.net/isobus/pGNAndSPN/9998?type=PGN)";
CM_ BO_ 2147547777  "Source: isobus.net VDMA Data Dictionary (https://www.isobus.net/isobus/pGNAndSPN/10002?type=PGN)";
CM_ BO_ 2147547778  "Source: isobus.net VDMA Data Dictionary (https://www.isobus.net/isobus/pGNAndSPN/10008?type=PGN)";
CM_ BO_ 2147547779  "Source: isobus.net VDMA Data Dictionary (https://www.isobus.net/isobus/pGNAndSPN/10016?type=PGN)";
CM_ BO_ 2147547780  "Source: isobus.net VDMA Data Dictionary (https://www.isobus.net/isobus/pGNAndSPN/10022?type=PGN)";
CM_ BO_ 2147547781  "Source: isobus.net VDMA Data Dictionary (https://www.isobus.net/isobus/pGNAndSPN/10032?type=PGN)";
CM_ BO_ 2147547782  "Source: isobus.net VDMA Data Dictionary (https://www.isobus.net/isobus/pGNAndSPN/10038?type=PGN)";
CM_ BO_ 2147547783  "Source: isobus.net VDMA Data Dictionary (https://www.isobus.net/isobus/pGNAndSPN/10048?type=PGN)";
CM_ BO_ 2147547784  "Source: isobus.net VDMA Data Dictionary (https://www.isobus.net/isobus/pGNAndSPN/10054?type=PGN)";
CM_ BO_ 2147547785  "Source: isobus.net VDMA Data Dictionary (https://www.isobus.net/isobus/pGNAndSPN/10064?type=PGN)";
CM_ BO_ 2147547786  "Source: isobus.net VDMA Data Dictionary (https://www.isobus.net/isobus/pGNAndSPN/10070?type=PGN)";
CM_ BO_ 2147547787  "Source: isobus.net VDMA Data Dictionary (https://www.isobus.net/isobus/pGNAndSPN/10080?type=PGN)";
CM_ BO_ 2147547788  "Source: isobus.net VDMA Data Dictionary (https://www.isobus.net/isobus/pGNAndSPN/10086?type=PGN)";
CM_ BO_ 2147547789  "Source: isobus.net VDMA Data Dictionary (https://www.isobus.net/isobus/pGNAndSPN/10096?type=PGN)";
CM_ BO_ 2147547790  "Source: isobus.net VDMA Data Dictionary (https://www.isobus.net/isobus/pGNAndSPN/10102?type=PGN)";
CM_ BO_ 2147547791  "Source: isobus.net VDMA Data Dictionary (https://www.isobus.net/isobus/pGNAndSPN/10112?type=PGN)";
CM_ BO_ 2147547792  "Source: isobus.net VDMA Data Dictionary (https://www.isobus.net/isobus/pGNAndSPN/10118?type=PGN)";
CM_ BO_ 2147547793  "Source: isobus.net VDMA Data Dictionary (https://www.isobus.net/isobus/pGNAndSPN/10128?type=PGN)";
CM_ BO_ 2147547794  "Source: isobus.net VDMA Data Dictionary (https://www.isobus.net/isobus/pGNAndSPN/10134?type=PGN)";
CM_ BO_ 2147547795  "Source: isobus.net VDMA Data Dictionary (https://www.isobus.net/isobus/pGNAndSPN/10144?type=PGN)";
CM_ BO_ 2147547796  "Source: isobus.net VDMA Data Dictionary (https://www.isobus.net/isobus/pGNAndSPN/10150?type=PGN)";
CM_ BO_ 2147547797  "Source: isobus.net VDMA Data Dictionary (https://www.isobus.net/isobus/pGNAndSPN/10160?type=PGN)";
CM_ BO_ 2147547798  "Source: isobus.net VDMA Data Dictionary (https://www.isobus.net/isobus/pGNAndSPN/10166?type=PGN)";
CM_ BO_ 2147547799  "Source: isobus.net VDMA Data Dictionary (https://www.isobus.net/isobus/pGNAndSPN/10176?type=PGN)";
CM_ BO_ 2147547800  "Source: isobus.net VDMA Data Dictionary (https://www.isobus.net/isobus/pGNAndSPN/10182?type=PGN)";
CM_ BO_ 2147547801  "Source: isobus.net VDMA Data Dictionary (https://www.isobus.net/isobus/pGNAndSPN/10192?type=PGN)";
CM_ BO_ 2147547802  "Source: isobus.net VDMA Data Dictionary (https://www.isobus.net/isobus/pGNAndSPN/10198?type=PGN)";
CM_ BO_ 2147547803  "Source: isobus.net VDMA Data Dictionary (https://www.isobus.net/isobus/pGNAndSPN/10208?type=PGN)";
CM_ BO_ 2147547804  "Source: isobus.net VDMA Data Dictionary (https://www.isobus.net/isobus/pGNAndSPN/10214?type=PGN)";
CM_ BO_ 2147547805  "Source: isobus.net VDMA Data Dictionary (https://www.isobus.net/isobus/pGNAndSPN/10224?type=PGN)";
CM_ BO_ 2147547806  "Source: isobus.net VDMA Data Dictionary (https://www.isobus.net/isobus/pGNAndSPN/10230?type=PGN)";
CM_ BO_ 2147547807  "Source: isobus.net VDMA Data Dictionary (https://www.isobus.net/isobus/pGNAndSPN/10240?type=PGN)";
CM_ BO_ 2147547808  "Source: isobus.net VDMA Data Dictionary (https://www.isobus.net/isobus/pGNAndSPN/10246?type=PGN)";
CM_ BO_ 2147547809  "Source: isobus.net VDMA Data Dictionary (https://www.isobus.net/isobus/pGNAndSPN/10256?type=PGN)";
CM_ BO_ 2147547810  "Source: isobus.net VDMA Data Dictionary (https://www.isobus.net/isobus/pGNAndSPN/10262?type=PGN)";
CM_ BO_ 2147547811  "Source: isobus.net VDMA Data Dictionary (https://www.isobus.net/isobus/pGNAndSPN/10272?type=PGN)";
CM_ BO_ 2147547812  "Source: isobus.net VDMA Data Dictionary (https://www.isobus.net/isobus/pGNAndSPN/10277?type=PGN)";
CM_ BO_ 2147547813  "Source: isobus.net VDMA Data Dictionary (https://www.isobus.net/isobus/pGNAndSPN/10280?type=PGN)";
CM_ BO_ 2147547814  "Source: isobus.net VDMA Data Dictionary (https://www.isobus.net/isobus/pGNAndSPN/10282?type=PGN)";
CM_ BO_ 2147547815  "Source: isobus.net VDMA Data Dictionary (https://www.isobus.net/isobus/pGNAndSPN/10287?type=PGN)";
CM_ BO_ 2147547816  "Source: isobus.net VDMA Data Dictionary (https://www.isobus.net/isobus/pGNAndSPN/10290?type=PGN)";
CM_ BO_ 2147547817  "Source: isobus.net VDMA Data Dictionary (https://www.isobus.net/isobus/pGNAndSPN/10293?type=PGN)";
CM_ BO_ 2147547818  "Source: isobus.net VDMA Data Dictionary (https://www.isobus.net/isobus/pGNAndSPN/10295?type=PGN)";
CM_ BO_ 2147547819  "Source: isobus.net VDMA Data Dictionary (https://www.isobus.net/isobus/pGNAndSPN/10305?type=PGN)";
CM_ BO_ 2147547820  "Source: isobus.net VDMA Data Dictionary (https://www.isobus.net/isobus/pGNAndSPN/10311?type=PGN)";
CM_ BO_ 2147547821  "Source: isobus.net VDMA Data Dictionary (https://www.isobus.net/isobus/pGNAndSPN/10321?type=PGN)";
CM_ BO_ 2147547822  "Source: isobus.net VDMA Data Dictionary (https://www.isobus.net/isobus/pGNAndSPN/10327?type=PGN)";
CM_ BO_ 2147547823  "Source: isobus.net VDMA Data Dictionary (https://www.isobus.net/isobus/pGNAndSPN/10337?type=PGN)";
CM_ BO_ 2147547824  "Source: isobus.net VDMA Data Dictionary (https://www.isobus.net/isobus/pGNAndSPN/10343?type=PGN)";
CM_ BO_ 2147547825  "Source: isobus.net VDMA Data Dictionary (https://www.isobus.net/isobus/pGNAndSPN/10353?type=PGN)";
CM_ BO_ 2147547826  "Source: isobus.net VDMA Data Dictionary (https://www.isobus.net/isobus/pGNAndSPN/10359?type=PGN)";
CM_ BO_ 2147547827  "Source: isobus.net VDMA Data Dictionary (https://www.isobus.net/isobus/pGNAndSPN/10360?type=PGN)";
CM_ BO_ 2147547828  "Source: isobus.net VDMA Data Dictionary (https://www.isobus.net/isobus/pGNAndSPN/10364?type=PGN)";
CM_ BO_ 2147547829  "Source: isobus.net VDMA Data Dictionary (https://www.isobus.net/isobus/pGNAndSPN/10368?type=PGN)";
CM_ BO_ 2147547830  "Source: isobus.net VDMA Data Dictionary (https://www.isobus.net/isobus/pGNAndSPN/10372?type=PGN)";
CM_ BO_ 2147547831  "Source: isobus.net VDMA Data Dictionary (https://www.isobus.net/isobus/pGNAndSPN/10376?type=PGN)";
CM_ BO_ 2147547832  "Source: isobus.net VDMA Data Dictionary (https://www.isobus.net/isobus/pGNAndSPN/10386?type=PGN)";
CM_ BO_ 2147547833  "Source: isobus.net VDMA Data Dictionary (https://www.isobus.net/isobus/pGNAndSPN/10387?type=PGN)";
CM_ BO_ 2147547834  "Source: isobus.net VDMA Data Dictionary (https://www.isobus.net/isobus/pGNAndSPN/10390?type=PGN)";
CM_ BO_ 2147547835  "Source: isobus.net VDMA Data Dictionary (https://www.isobus.net/isobus/pGNAndSPN/10392?type=PGN)";
CM_ BO_ 2147547836  "Source: isobus.net VDMA Data Dictionary (https://www.isobus.net/isobus/pGNAndSPN/10394?type=PGN)";
CM_ BO_ 2147547837  "Source: isobus.net VDMA Data Dictionary (https://www.isobus.net/isobus/pGNAndSPN/10398?type=PGN)";
CM_ BO_ 2147547838  "Source: isobus.net VDMA Data Dictionary (https://www.isobus.net/isobus/pGNAndSPN/10402?type=PGN)";
CM_ BO_ 2147547839  "Source: isobus.net VDMA Data Dictionary (https://www.isobus.net/isobus/pGNAndSPN/10406?type=PGN)";
CM_ BO_ 2147547840  "Source: isobus.net VDMA Data Dictionary (https://www.isobus.net/isobus/pGNAndSPN/10410?type=PGN)";
CM_ BO_ 2147547841  "Source: isobus.net VDMA Data Dictionary (https://www.isobus.net/isobus/pGNAndSPN/10414?type=PGN)";
CM_ BO_ 2147547842  "Source: isobus.net VDMA Data Dictionary (https://www.isobus.net/isobus/pGNAndSPN/10418?type=PGN)";
CM_ BO_ 2147547843  "Source: isobus.net VDMA Data Dictionary (https://www.isobus.net/isobus/pGNAndSPN/10420?type=PGN)";
CM_ BO_ 2147547844  "Source: isobus.net VDMA Data Dictionary (https://www.isobus.net/isobus/pGNAndSPN/10423?type=PGN)";
CM_ BO_ 2147547845  "Source: isobus.net VDMA Data Dictionary (https://www.isobus.net/isobus/pGNAndSPN/10427?type=PGN)";
CM_ BO_ 2147547846  "Source: isobus.net VDMA Data Dictionary (https://www.isobus.net/isobus/pGNAndSPN/10429?type=PGN)";
CM_ BO_ 2147547848  "Source: isobus.net VDMA Data Dictionary (https://www.isobus.net/isobus/pGNAndSPN/10434?type=PGN)";
CM_ BO_ 2147547851  "Source: isobus.net VDMA Data Dictionary (https://www.isobus.net/isobus/pGNAndSPN/10435?type=PGN)";
CM_ BO_ 2147547852  "Source: isobus.net VDMA Data Dictionary (https://www.isobus.net/isobus/pGNAndSPN/10436?type=PGN)";
CM_ BO_ 2147547853  "Source: isobus.net VDMA Data Dictionary (https://www.isobus.net/isobus/pGNAndSPN/10438?type=PGN)";
CM_ BO_ 2147547854  "Source: isobus.net VDMA Data Dictionary (https://www.isobus.net/isobus/pGNAndSPN/10440?type=PGN)";
CM_ BO_ 2147547855  "Source: isobus.net VDMA Data Dictionary (https://www.isobus.net/isobus/pGNAndSPN/10449?type=PGN)";
CM_ BO_ 2147547856  "Source: isobus.net VDMA Data Dictionary (https://www.isobus.net/isobus/pGNAndSPN/10452?type=PGN)";
CM_ BO_ 2147547857  "Source: isobus.net VDMA Data Dictionary (https://www.isobus.net/isobus/pGNAndSPN/10455?type=PGN)";
CM_ BO_ 2147547858  "Source: isobus.net VDMA Data Dictionary (https://www.isobus.net/isobus/pGNAndSPN/10459?type=PGN)";
CM_ BO_ 2147547859  "Source: isobus.net VDMA Data Dictionary (https://www.isobus.net/isobus/pGNAndSPN/10464?type=PGN)";
CM_ BO_ 2147547860  "Source: isobus.net VDMA Data Dictionary (https://www.isobus.net/isobus/pGNAndSPN/10466?type=PGN)";
CM_ BO_ 2147547861  "Source: isobus.net VDMA Data Dictionary (https://www.isobus.net/isobus/pGNAndSPN/10470?type=PGN)";
CM_ BO_ 2147547862  "Source: isobus.net VDMA Data Dictionary (https://www.isobus.net/isobus/pGNAndSPN/10478?type=PGN)";
CM_ BO_ 2147547863  "Source: isobus.net VDMA Data Dictionary (https://www.isobus.net/isobus/pGNAndSPN/10479?type=PGN)";
CM_ BO_ 2147547864  "Source: isobus.net VDMA Data Dictionary (https://www.isobus.net/isobus/pGNAndSPN/10480?type=PGN)";
CM_ BO_ 2147547865  "Source: isobus.net VDMA Data Dictionary (https://www.isobus.net/isobus/pGNAndSPN/10481?type=PGN)";
CM_ BO_ 2147547866  "Source: isobus.net VDMA Data Dictionary (https://www.isobus.net/isobus/pGNAndSPN/10482?type=PGN)";
CM_ BO_ 2147547867  "Source: isobus.net VDMA Data Dictionary (https://www.isobus.net/isobus/pGNAndSPN/10483?type=PGN)";
CM_ BO_ 2147547868  "Source: isobus.net VDMA Data Dictionary (https://www.isobus.net/isobus/pGNAndSPN/10484?type=PGN)";
CM_ BO_ 2147547869  "Source: isobus.net VDMA Data Dictionary (https://www.isobus.net/isobus/pGNAndSPN/10485?type=PGN)";
CM_ BO_ 2147547870  "Source: isobus.net VDMA Data Dictionary (https://www.isobus.net/isobus/pGNAndSPN/10486?type=PGN)";
CM_ BO_ 2147547871  "Source: isobus.net VDMA Data Dictionary (https://www.isobus.net/isobus/pGNAndSPN/10487?type=PGN)";
CM_ BO_ 2147547872  "Source: isobus.net VDMA Data Dictionary (https://www.isobus.net/isobus/pGNAndSPN/10488?type=PGN)";
CM_ BO_ 2147547873  "Source: isobus.net VDMA Data Dictionary (https://www.isobus.net/isobus/pGNAndSPN/10489?type=PGN)";
CM_ BO_ 2147547874  "Source: isobus.net VDMA Data Dictionary (https://www.isobus.net/isobus/pGNAndSPN/10490?type=PGN)";
CM_ BO_ 2147547875  "Source: isobus.net VDMA Data Dictionary (https://www.isobus.net/isobus/pGNAndSPN/10491?type=PGN)";
CM_ BO_ 2147547876  "Source: isobus.net VDMA Data Dictionary (https://www.isobus.net/isobus/pGNAndSPN/10492?type=PGN)";
CM_ BO_ 2147547877  "Source: isobus.net VDMA Data Dictionary (https://www.isobus.net/isobus/pGNAndSPN/10493?type=PGN)";
CM_ BO_ 2147547878  "Source: isobus.net VDMA Data Dictionary (https://www.isobus.net/isobus/pGNAndSPN/10494?type=PGN)";
CM_ BO_ 2147547879  "Source: isobus.net VDMA Data Dictionary (https://www.isobus.net/isobus/pGNAndSPN/10495?type=PGN)";
CM_ BO_ 2147547880  "Source: isobus.net VDMA Data Dictionary (https://www.isobus.net/isobus/pGNAndSPN/10496?type=PGN)";
CM_ BO_ 2147547881  "Source: isobus.net VDMA Data Dictionary (https://www.isobus.net/isobus/pGNAndSPN/10497?type=PGN)";
CM_ SG_ 2147547577 Hydrogen_System_Status_RawPayloa "Generic 8-byte raw payload. Detail page: https://www.isobus.net/isobus/pGNAndSPN/8821?type=PGN. Signal-level enrichment via PR welcome  see CONTRIBUTING.md.";
CM_ SG_ 2147547578 Route_Waypoint_GPS_Coordinates_R "Generic 8-byte raw payload. Detail page: https://www.isobus.net/isobus/pGNAndSPN/8824?type=PGN. Signal-level enrichment via PR welcome  see CONTRIBUTING.md.";
CM_ SG_ 2147547579 Route_Information_RawPayload "Generic 8-byte raw payload. Detail page: https://www.isobus.net/isobus/pGNAndSPN/8828?type=PGN. Signal-level enrichment via PR welcome  see CONTRIBUTING.md.";
CM_ SG_ 2147547580 Engine_Fluid_Level_Pressure_15_R "Generic 8-byte raw payload. Detail page: https://www.isobus.net/isobus/pGNAndSPN/8830?type=PGN. Signal-level enrichment via PR welcome  see CONTRIBUTING.md.";
CM_ SG_ 2147547581 Fuel_Cell_System_Coolant_Informa "Generic 8-byte raw payload. Detail page: https://www.isobus.net/isobus/pGNAndSPN/8832?type=PGN. Signal-level enrichment via PR welcome  see CONTRIBUTING.md.";
CM_ SG_ 2147547582 Transmission_Configuration_3_Raw "Generic 8-byte raw payload. Detail page: https://www.isobus.net/isobus/pGNAndSPN/8852?type=PGN. Signal-level enrichment via PR welcome  see CONTRIBUTING.md.";
CM_ SG_ 2147547583 Enrichment_Information_RawPayloa "Generic 8-byte raw payload. Detail page: https://www.isobus.net/isobus/pGNAndSPN/8860?type=PGN. Signal-level enrichment via PR welcome  see CONTRIBUTING.md.";
CM_ SG_ 2147547584 Fuel_Cell_System_Voltage_Limit_C "Generic 8-byte raw payload. Detail page: https://www.isobus.net/isobus/pGNAndSPN/8865?type=PGN. Signal-level enrichment via PR welcome  see CONTRIBUTING.md.";
CM_ SG_ 2147547586 Hydrogen_System_Information_RawP "Generic 8-byte raw payload. Detail page: https://www.isobus.net/isobus/pGNAndSPN/8867?type=PGN. Signal-level enrichment via PR welcome  see CONTRIBUTING.md.";
CM_ SG_ 2147547587 Auxiliary_Input_Output_Status_17 "Generic 8-byte raw payload. Detail page: https://www.isobus.net/isobus/pGNAndSPN/8871?type=PGN. Signal-level enrichment via PR welcome  see CONTRIBUTING.md.";
CM_ SG_ 2147547588 Auxiliary_Input_Output_Status_16 "Generic 8-byte raw payload. Detail page: https://www.isobus.net/isobus/pGNAndSPN/8875?type=PGN. Signal-level enrichment via PR welcome  see CONTRIBUTING.md.";
CM_ SG_ 2147547589 Auxiliary_Input_Output_Status_15 "Generic 8-byte raw payload. Detail page: https://www.isobus.net/isobus/pGNAndSPN/8879?type=PGN. Signal-level enrichment via PR welcome  see CONTRIBUTING.md.";
CM_ SG_ 2147547590 Auxiliary_Input_Output_Status_14 "Generic 8-byte raw payload. Detail page: https://www.isobus.net/isobus/pGNAndSPN/8883?type=PGN. Signal-level enrichment via PR welcome  see CONTRIBUTING.md.";
CM_ SG_ 2147547591 Auxiliary_Input_Output_Status_13 "Generic 8-byte raw payload. Detail page: https://www.isobus.net/isobus/pGNAndSPN/8887?type=PGN. Signal-level enrichment via PR welcome  see CONTRIBUTING.md.";
CM_ SG_ 2147547592 Auxiliary_Input_Output_Status_12 "Generic 8-byte raw payload. Detail page: https://www.isobus.net/isobus/pGNAndSPN/8891?type=PGN. Signal-level enrichment via PR welcome  see CONTRIBUTING.md.";
CM_ SG_ 2147547593 Auxiliary_Input_Output_Status_11 "Generic 8-byte raw payload. Detail page: https://www.isobus.net/isobus/pGNAndSPN/8895?type=PGN. Signal-level enrichment via PR welcome  see CONTRIBUTING.md.";
CM_ SG_ 2147547594 Auxiliary_Input_Output_Status_10 "Generic 8-byte raw payload. Detail page: https://www.isobus.net/isobus/pGNAndSPN/8899?type=PGN. Signal-level enrichment via PR welcome  see CONTRIBUTING.md.";
CM_ SG_ 2147547595 Auxiliary_Input_Output_Status_9_ "Generic 8-byte raw payload. Detail page: https://www.isobus.net/isobus/pGNAndSPN/8903?type=PGN. Signal-level enrichment via PR welcome  see CONTRIBUTING.md.";
CM_ SG_ 2147547596 Auxiliary_Input_Output_Status_8_ "Generic 8-byte raw payload. Detail page: https://www.isobus.net/isobus/pGNAndSPN/8907?type=PGN. Signal-level enrichment via PR welcome  see CONTRIBUTING.md.";
CM_ SG_ 2147547597 Aftertreatment_System_Informatio "Generic 8-byte raw payload. Detail page: https://www.isobus.net/isobus/pGNAndSPN/8909?type=PGN. Signal-level enrichment via PR welcome  see CONTRIBUTING.md.";
CM_ SG_ 2147547598 Brake_Temperature_6_RawPayload "Generic 8-byte raw payload. Detail page: https://www.isobus.net/isobus/pGNAndSPN/8911?type=PGN. Signal-level enrichment via PR welcome  see CONTRIBUTING.md.";
CM_ SG_ 2147547599 Brake_Temperature_5_RawPayload "Generic 8-byte raw payload. Detail page: https://www.isobus.net/isobus/pGNAndSPN/8915?type=PGN. Signal-level enrichment via PR welcome  see CONTRIBUTING.md.";
CM_ SG_ 2147547600 Brake_Temperature_4_RawPayload "Generic 8-byte raw payload. Detail page: https://www.isobus.net/isobus/pGNAndSPN/8919?type=PGN. Signal-level enrichment via PR welcome  see CONTRIBUTING.md.";
CM_ SG_ 2147547601 Brake_Temperature_3_RawPayload "Generic 8-byte raw payload. Detail page: https://www.isobus.net/isobus/pGNAndSPN/8923?type=PGN. Signal-level enrichment via PR welcome  see CONTRIBUTING.md.";
CM_ SG_ 2147547602 Brake_Temperature_2_RawPayload "Generic 8-byte raw payload. Detail page: https://www.isobus.net/isobus/pGNAndSPN/8927?type=PGN. Signal-level enrichment via PR welcome  see CONTRIBUTING.md.";
CM_ SG_ 2147547603 Brake_Temperature_1_RawPayload "Generic 8-byte raw payload. Detail page: https://www.isobus.net/isobus/pGNAndSPN/8931?type=PGN. Signal-level enrichment via PR welcome  see CONTRIBUTING.md.";
CM_ SG_ 2147547604 Wheel_Brake_Lining_Remaining_Inf "Generic 8-byte raw payload. Detail page: https://www.isobus.net/isobus/pGNAndSPN/8937?type=PGN. Signal-level enrichment via PR welcome  see CONTRIBUTING.md.";
CM_ SG_ 2147547605 Wheel_Brake_Lining_Remaining_Inf "Generic 8-byte raw payload. Detail page: https://www.isobus.net/isobus/pGNAndSPN/8945?type=PGN. Signal-level enrichment via PR welcome  see CONTRIBUTING.md.";
CM_ SG_ 2147547606 High_Voltage_Bus_Contactor_Statu "Generic 8-byte raw payload. Detail page: https://www.isobus.net/isobus/pGNAndSPN/8964?type=PGN. Signal-level enrichment via PR welcome  see CONTRIBUTING.md.";
CM_ SG_ 2147547607 High_Voltage_Bus_Contactor_Statu "Generic 8-byte raw payload. Detail page: https://www.isobus.net/isobus/pGNAndSPN/8991?type=PGN. Signal-level enrichment via PR welcome  see CONTRIBUTING.md.";
CM_ SG_ 2147547608 High_Voltage_Bus_Connection_Comm "Generic 8-byte raw payload. Detail page: https://www.isobus.net/isobus/pGNAndSPN/9002?type=PGN. Signal-level enrichment via PR welcome  see CONTRIBUTING.md.";
CM_ SG_ 2147547609 Cab_Illumination_Data_RawPayload "Generic 8-byte raw payload. Detail page: https://www.isobus.net/isobus/pGNAndSPN/9004?type=PGN. Signal-level enrichment via PR welcome  see CONTRIBUTING.md.";
CM_ SG_ 2147547610 Service_Needed_DTC_Information_R "Generic 8-byte raw payload. Detail page: https://www.isobus.net/isobus/pGNAndSPN/9008?type=PGN. Signal-level enrichment via PR welcome  see CONTRIBUTING.md.";
CM_ SG_ 2147547611 EVSE_Status_2_RawPayload "Generic 8-byte raw payload. Detail page: https://www.isobus.net/isobus/pGNAndSPN/9012?type=PGN. Signal-level enrichment via PR welcome  see CONTRIBUTING.md.";
CM_ SG_ 2147547612 High_Voltage_Energy_Storage_Syst "Generic 8-byte raw payload. Detail page: https://www.isobus.net/isobus/pGNAndSPN/9016?type=PGN. Signal-level enrichment via PR welcome  see CONTRIBUTING.md.";
CM_ SG_ 2147547613 High_Voltage_Energy_Storage_Syst "Generic 8-byte raw payload. Detail page: https://www.isobus.net/isobus/pGNAndSPN/9020?type=PGN. Signal-level enrichment via PR welcome  see CONTRIBUTING.md.";
CM_ SG_ 2147547614 High_Voltage_Energy_Storage_Syst "Generic 8-byte raw payload. Detail page: https://www.isobus.net/isobus/pGNAndSPN/9024?type=PGN. Signal-level enrichment via PR welcome  see CONTRIBUTING.md.";
CM_ SG_ 2147547615 HVESS_Coolant_Pump_1_Status_1_Ra "Generic 8-byte raw payload. Detail page: https://www.isobus.net/isobus/pGNAndSPN/9032?type=PGN. Signal-level enrichment via PR welcome  see CONTRIBUTING.md.";
CM_ SG_ 2147547616 HVESS_Coolant_Pump_1_Command_Raw "Generic 8-byte raw payload. Detail page: https://www.isobus.net/isobus/pGNAndSPN/9039?type=PGN. Signal-level enrichment via PR welcome  see CONTRIBUTING.md.";
CM_ SG_ 2147547617 HVESS_Coolant_Pump_2_Status_1_Ra "Generic 8-byte raw payload. Detail page: https://www.isobus.net/isobus/pGNAndSPN/9047?type=PGN. Signal-level enrichment via PR welcome  see CONTRIBUTING.md.";
CM_ SG_ 2147547618 HVESS_Coolant_Pump_2_Command_Raw "Generic 8-byte raw payload. Detail page: https://www.isobus.net/isobus/pGNAndSPN/9054?type=PGN. Signal-level enrichment via PR welcome  see CONTRIBUTING.md.";
CM_ SG_ 2147547619 Hydrogen_Sensor_Information_RawP "Generic 8-byte raw payload. Detail page: https://www.isobus.net/isobus/pGNAndSPN/9058?type=PGN. Signal-level enrichment via PR welcome  see CONTRIBUTING.md.";
CM_ SG_ 2147547620 Operator_Inducement_Information_ "Generic 8-byte raw payload. Detail page: https://www.isobus.net/isobus/pGNAndSPN/9061?type=PGN. Signal-level enrichment via PR welcome  see CONTRIBUTING.md.";
CM_ SG_ 2147547621 Operator_Inducement_Vehicle_Spee "Generic 8-byte raw payload. Detail page: https://www.isobus.net/isobus/pGNAndSPN/9064?type=PGN. Signal-level enrichment via PR welcome  see CONTRIBUTING.md.";
CM_ SG_ 2147547622 Operator_Inducement_Vehicle_Spee "Generic 8-byte raw payload. Detail page: https://www.isobus.net/isobus/pGNAndSPN/9067?type=PGN. Signal-level enrichment via PR welcome  see CONTRIBUTING.md.";
CM_ SG_ 2147547623 Engine_Protection_Speed_Derate_I "Generic 8-byte raw payload. Detail page: https://www.isobus.net/isobus/pGNAndSPN/9073?type=PGN. Signal-level enrichment via PR welcome  see CONTRIBUTING.md.";
CM_ SG_ 2147547624 Engine_Protection_Torque_Derate_ "Generic 8-byte raw payload. Detail page: https://www.isobus.net/isobus/pGNAndSPN/9080?type=PGN. Signal-level enrichment via PR welcome  see CONTRIBUTING.md.";
CM_ SG_ 2147547625 Aftertreatment_System_Informatio "Generic 8-byte raw payload. Detail page: https://www.isobus.net/isobus/pGNAndSPN/9082?type=PGN. Signal-level enrichment via PR welcome  see CONTRIBUTING.md.";
CM_ SG_ 2147547626 SAE_J2012_3_Byte_DTC_Display_Raw "Generic 8-byte raw payload. Detail page: https://www.isobus.net/isobus/pGNAndSPN/9088?type=PGN. Signal-level enrichment via PR welcome  see CONTRIBUTING.md.";
CM_ SG_ 2147547627 High_Voltage_Energy_Storage_Syst "Generic 8-byte raw payload. Detail page: https://www.isobus.net/isobus/pGNAndSPN/9098?type=PGN. Signal-level enrichment via PR welcome  see CONTRIBUTING.md.";
CM_ SG_ 2147547628 High_Voltage_Energy_Storage_Syst "Generic 8-byte raw payload. Detail page: https://www.isobus.net/isobus/pGNAndSPN/9108?type=PGN. Signal-level enrichment via PR welcome  see CONTRIBUTING.md.";
CM_ SG_ 2147547629 High_Voltage_Energy_Storage_Syst "Generic 8-byte raw payload. Detail page: https://www.isobus.net/isobus/pGNAndSPN/9109?type=PGN. Signal-level enrichment via PR welcome  see CONTRIBUTING.md.";
CM_ SG_ 2147547630 Engine_Cylinder_Average_Ignition "Generic 8-byte raw payload. Detail page: https://www.isobus.net/isobus/pGNAndSPN/9113?type=PGN. Signal-level enrichment via PR welcome  see CONTRIBUTING.md.";
CM_ SG_ 2147547631 Engine_Cylinder_Average_Ignition "Generic 8-byte raw payload. Detail page: https://www.isobus.net/isobus/pGNAndSPN/9117?type=PGN. Signal-level enrichment via PR welcome  see CONTRIBUTING.md.";
CM_ SG_ 2147547632 Engine_Cylinder_Average_Ignition "Generic 8-byte raw payload. Detail page: https://www.isobus.net/isobus/pGNAndSPN/9121?type=PGN. Signal-level enrichment via PR welcome  see CONTRIBUTING.md.";
CM_ SG_ 2147547633 Engine_Cylinder_Average_Ignition "Generic 8-byte raw payload. Detail page: https://www.isobus.net/isobus/pGNAndSPN/9125?type=PGN. Signal-level enrichment via PR welcome  see CONTRIBUTING.md.";
CM_ SG_ 2147547634 Engine_Cylinder_Average_Ignition "Generic 8-byte raw payload. Detail page: https://www.isobus.net/isobus/pGNAndSPN/9129?type=PGN. Signal-level enrichment via PR welcome  see CONTRIBUTING.md.";
CM_ SG_ 2147547635 Engine_Indicated_Mean_Effective_ "Generic 8-byte raw payload. Detail page: https://www.isobus.net/isobus/pGNAndSPN/9137?type=PGN. Signal-level enrichment via PR welcome  see CONTRIBUTING.md.";
CM_ SG_ 2147547636 Engine_Indicated_Mean_Effective_ "Generic 8-byte raw payload. Detail page: https://www.isobus.net/isobus/pGNAndSPN/9145?type=PGN. Signal-level enrichment via PR welcome  see CONTRIBUTING.md.";
CM_ SG_ 2147547637 Engine_Indicated_Mean_Effective_ "Generic 8-byte raw payload. Detail page: https://www.isobus.net/isobus/pGNAndSPN/9153?type=PGN. Signal-level enrichment via PR welcome  see CONTRIBUTING.md.";
CM_ SG_ 2147547638 Fuel_Cell_System_Coolant_Fan_1_C "Generic 8-byte raw payload. Detail page: https://www.isobus.net/isobus/pGNAndSPN/9160?type=PGN. Signal-level enrichment via PR welcome  see CONTRIBUTING.md.";
CM_ SG_ 2147547639 Fuel_Cell_System_Coolant_Fan_1_S "Generic 8-byte raw payload. Detail page: https://www.isobus.net/isobus/pGNAndSPN/9168?type=PGN. Signal-level enrichment via PR welcome  see CONTRIBUTING.md.";
CM_ SG_ 2147547640 Fuel_Cell_System_Coolant_Fan_2_C "Generic 8-byte raw payload. Detail page: https://www.isobus.net/isobus/pGNAndSPN/9175?type=PGN. Signal-level enrichment via PR welcome  see CONTRIBUTING.md.";
CM_ SG_ 2147547641 Fuel_Cell_System_Coolant_Fan_2_S "Generic 8-byte raw payload. Detail page: https://www.isobus.net/isobus/pGNAndSPN/9183?type=PGN. Signal-level enrichment via PR welcome  see CONTRIBUTING.md.";
CM_ SG_ 2147547642 Fuel_Cell_System_Coolant_Fan_3_C "Generic 8-byte raw payload. Detail page: https://www.isobus.net/isobus/pGNAndSPN/9190?type=PGN. Signal-level enrichment via PR welcome  see CONTRIBUTING.md.";
CM_ SG_ 2147547643 Fuel_Cell_System_Coolant_Fan_3_S "Generic 8-byte raw payload. Detail page: https://www.isobus.net/isobus/pGNAndSPN/9198?type=PGN. Signal-level enrichment via PR welcome  see CONTRIBUTING.md.";
CM_ SG_ 2147547644 Fuel_Cell_System_Coolant_Fan_4_C "Generic 8-byte raw payload. Detail page: https://www.isobus.net/isobus/pGNAndSPN/9205?type=PGN. Signal-level enrichment via PR welcome  see CONTRIBUTING.md.";
CM_ SG_ 2147547645 Fuel_Cell_System_Coolant_Fan_4_S "Generic 8-byte raw payload. Detail page: https://www.isobus.net/isobus/pGNAndSPN/9213?type=PGN. Signal-level enrichment via PR welcome  see CONTRIBUTING.md.";
CM_ SG_ 2147547646 APIs_Supported_RawPayload "Generic 8-byte raw payload. Detail page: https://www.isobus.net/isobus/pGNAndSPN/9222?type=PGN. Signal-level enrichment via PR welcome  see CONTRIBUTING.md.";
CM_ SG_ 2147547647 Fuel_Cell_System_Configuration_R "Generic 8-byte raw payload. Detail page: https://www.isobus.net/isobus/pGNAndSPN/9227?type=PGN. Signal-level enrichment via PR welcome  see CONTRIBUTING.md.";
CM_ SG_ 2147547648 Fuel_Cell_System_Coolant_Informa "Generic 8-byte raw payload. Detail page: https://www.isobus.net/isobus/pGNAndSPN/9231?type=PGN. Signal-level enrichment via PR welcome  see CONTRIBUTING.md.";
CM_ SG_ 2147547649 Fuel_Cell_System_Coolant_Informa "Generic 8-byte raw payload. Detail page: https://www.isobus.net/isobus/pGNAndSPN/9236?type=PGN. Signal-level enrichment via PR welcome  see CONTRIBUTING.md.";
CM_ SG_ 2147547654 Dash_Display_3_RawPayload "Generic 8-byte raw payload. Detail page: https://www.isobus.net/isobus/pGNAndSPN/9238?type=PGN. Signal-level enrichment via PR welcome  see CONTRIBUTING.md.";
CM_ SG_ 2147547655 Vehicle_Speed_Profile_RawPayload "Generic 8-byte raw payload. Detail page: https://www.isobus.net/isobus/pGNAndSPN/9241?type=PGN. Signal-level enrichment via PR welcome  see CONTRIBUTING.md.";
CM_ SG_ 2147547656 Reference_Time_RawPayload "Generic 8-byte raw payload. Detail page: https://www.isobus.net/isobus/pGNAndSPN/9245?type=PGN. Signal-level enrichment via PR welcome  see CONTRIBUTING.md.";
CM_ SG_ 2147547657 Software_History_RawPayload "Generic 8-byte raw payload. Detail page: https://www.isobus.net/isobus/pGNAndSPN/9246?type=PGN. Signal-level enrichment via PR welcome  see CONTRIBUTING.md.";
CM_ SG_ 2147547658 Motor_Generator_1_Thermal_Perfor "Generic 8-byte raw payload. Detail page: https://www.isobus.net/isobus/pGNAndSPN/9248?type=PGN. Signal-level enrichment via PR welcome  see CONTRIBUTING.md.";
CM_ SG_ 2147547659 Motor_Generator_2_Thermal_Perfor "Generic 8-byte raw payload. Detail page: https://www.isobus.net/isobus/pGNAndSPN/9250?type=PGN. Signal-level enrichment via PR welcome  see CONTRIBUTING.md.";
CM_ SG_ 2147547660 Motor_Generator_3_Thermal_Perfor "Generic 8-byte raw payload. Detail page: https://www.isobus.net/isobus/pGNAndSPN/9252?type=PGN. Signal-level enrichment via PR welcome  see CONTRIBUTING.md.";
CM_ SG_ 2147547661 Motor_Generator_4_Thermal_Perfor "Generic 8-byte raw payload. Detail page: https://www.isobus.net/isobus/pGNAndSPN/9254?type=PGN. Signal-level enrichment via PR welcome  see CONTRIBUTING.md.";
CM_ SG_ 2147547662 Motor_Generator_5_Thermal_Perfor "Generic 8-byte raw payload. Detail page: https://www.isobus.net/isobus/pGNAndSPN/9256?type=PGN. Signal-level enrichment via PR welcome  see CONTRIBUTING.md.";
CM_ SG_ 2147547663 Motor_Generator_6_Thermal_Perfor "Generic 8-byte raw payload. Detail page: https://www.isobus.net/isobus/pGNAndSPN/9258?type=PGN. Signal-level enrichment via PR welcome  see CONTRIBUTING.md.";
CM_ SG_ 2147547664 On_Board_Programming_Event_Time_ "Generic 8-byte raw payload. Detail page: https://www.isobus.net/isobus/pGNAndSPN/9266?type=PGN. Signal-level enrichment via PR welcome  see CONTRIBUTING.md.";
CM_ SG_ 2147547665 Aftertreatment_1_Light_Off_SCR_S "Generic 8-byte raw payload. Detail page: https://www.isobus.net/isobus/pGNAndSPN/9268?type=PGN. Signal-level enrichment via PR welcome  see CONTRIBUTING.md.";
CM_ SG_ 2147547666 Motor_Generator_Location_Extende "Generic 8-byte raw payload. Detail page: https://www.isobus.net/isobus/pGNAndSPN/9276?type=PGN. Signal-level enrichment via PR welcome  see CONTRIBUTING.md.";
CM_ SG_ 2147547667 Cold_Start_Emissions_Reduction_S "Generic 8-byte raw payload. Detail page: https://www.isobus.net/isobus/pGNAndSPN/9286?type=PGN. Signal-level enrichment via PR welcome  see CONTRIBUTING.md.";
CM_ SG_ 2147547668 Cold_Start_Emissions_Reduction_S "Generic 8-byte raw payload. Detail page: https://www.isobus.net/isobus/pGNAndSPN/9296?type=PGN. Signal-level enrichment via PR welcome  see CONTRIBUTING.md.";
CM_ SG_ 2147547669 Genset_Supporting_Functions_RawP "Generic 8-byte raw payload. Detail page: https://www.isobus.net/isobus/pGNAndSPN/9300?type=PGN. Signal-level enrichment via PR welcome  see CONTRIBUTING.md.";
CM_ SG_ 2147547670 High_Voltage_Energy_Storage_Syst "Generic 8-byte raw payload. Detail page: https://www.isobus.net/isobus/pGNAndSPN/9304?type=PGN. Signal-level enrichment via PR welcome  see CONTRIBUTING.md.";
CM_ SG_ 2147547671 High_Voltage_Energy_Storage_Syst "Generic 8-byte raw payload. Detail page: https://www.isobus.net/isobus/pGNAndSPN/9308?type=PGN. Signal-level enrichment via PR welcome  see CONTRIBUTING.md.";
CM_ SG_ 2147547672 High_Voltage_Energy_Storage_Syst "Generic 8-byte raw payload. Detail page: https://www.isobus.net/isobus/pGNAndSPN/9312?type=PGN. Signal-level enrichment via PR welcome  see CONTRIBUTING.md.";
CM_ SG_ 2147547673 High_Voltage_Energy_Storage_Syst "Generic 8-byte raw payload. Detail page: https://www.isobus.net/isobus/pGNAndSPN/9316?type=PGN. Signal-level enrichment via PR welcome  see CONTRIBUTING.md.";
CM_ SG_ 2147547674 Electronic_Engine_Controller_23_ "Generic 8-byte raw payload. Detail page: https://www.isobus.net/isobus/pGNAndSPN/9318?type=PGN. Signal-level enrichment via PR welcome  see CONTRIBUTING.md.";
CM_ SG_ 2147547675 Electronic_Engine_Controller_24_ "Generic 8-byte raw payload. Detail page: https://www.isobus.net/isobus/pGNAndSPN/9324?type=PGN. Signal-level enrichment via PR welcome  see CONTRIBUTING.md.";
CM_ SG_ 2147547676 Electronic_Engine_Controller_25_ "Generic 8-byte raw payload. Detail page: https://www.isobus.net/isobus/pGNAndSPN/9330?type=PGN. Signal-level enrichment via PR welcome  see CONTRIBUTING.md.";
CM_ SG_ 2147547677 High_Voltage_Bus_Connection_Comm "Generic 8-byte raw payload. Detail page: https://www.isobus.net/isobus/pGNAndSPN/9357?type=PGN. Signal-level enrichment via PR welcome  see CONTRIBUTING.md.";
CM_ SG_ 2147547678 High_Voltage_Bus_Contactor_Statu "Generic 8-byte raw payload. Detail page: https://www.isobus.net/isobus/pGNAndSPN/9384?type=PGN. Signal-level enrichment via PR welcome  see CONTRIBUTING.md.";
CM_ SG_ 2147547679 Aftertreatment_System_Informatio "Generic 8-byte raw payload. Detail page: https://www.isobus.net/isobus/pGNAndSPN/9385?type=PGN. Signal-level enrichment via PR welcome  see CONTRIBUTING.md.";
CM_ SG_ 2147547680 EV_Multi_Connection_DC_Charging_ "Generic 8-byte raw payload. Detail page: https://www.isobus.net/isobus/pGNAndSPN/9390?type=PGN. Signal-level enrichment via PR welcome  see CONTRIBUTING.md.";
CM_ SG_ 2147547681 EV_Multi_Connection_Charging_In_ "Generic 8-byte raw payload. Detail page: https://www.isobus.net/isobus/pGNAndSPN/9396?type=PGN. Signal-level enrichment via PR welcome  see CONTRIBUTING.md.";
CM_ SG_ 2147547682 Sensor_Supply_Voltage_RawPayload "Generic 8-byte raw payload. Detail page: https://www.isobus.net/isobus/pGNAndSPN/9403?type=PGN. Signal-level enrichment via PR welcome  see CONTRIBUTING.md.";
CM_ SG_ 2147547683 Motor_Generator_Location_obsolet "Generic 8-byte raw payload. Detail page: https://www.isobus.net/isobus/pGNAndSPN/9410?type=PGN. Signal-level enrichment via PR welcome  see CONTRIBUTING.md.";
CM_ SG_ 2147547684 High_Voltage_Energy_Storage_Syst "Generic 8-byte raw payload. Detail page: https://www.isobus.net/isobus/pGNAndSPN/9417?type=PGN. Signal-level enrichment via PR welcome  see CONTRIBUTING.md.";
CM_ SG_ 2147547685 High_Voltage_Energy_Storage_Syst "Generic 8-byte raw payload. Detail page: https://www.isobus.net/isobus/pGNAndSPN/9421?type=PGN. Signal-level enrichment via PR welcome  see CONTRIBUTING.md.";
CM_ SG_ 2147547686 High_Voltage_Energy_Storage_Syst "Generic 8-byte raw payload. Detail page: https://www.isobus.net/isobus/pGNAndSPN/9425?type=PGN. Signal-level enrichment via PR welcome  see CONTRIBUTING.md.";
CM_ SG_ 2147547687 High_Voltage_Energy_Storage_Pack "Generic 8-byte raw payload. Detail page: https://www.isobus.net/isobus/pGNAndSPN/9441?type=PGN. Signal-level enrichment via PR welcome  see CONTRIBUTING.md.";
CM_ SG_ 2147547688 High_Voltage_Energy_Storage_Pack "Generic 8-byte raw payload. Detail page: https://www.isobus.net/isobus/pGNAndSPN/9457?type=PGN. Signal-level enrichment via PR welcome  see CONTRIBUTING.md.";
CM_ SG_ 2147547689 High_Voltage_Energy_Storage_Pack "Generic 8-byte raw payload. Detail page: https://www.isobus.net/isobus/pGNAndSPN/9473?type=PGN. Signal-level enrichment via PR welcome  see CONTRIBUTING.md.";
CM_ SG_ 2147547690 High_Voltage_Energy_Storage_Pack "Generic 8-byte raw payload. Detail page: https://www.isobus.net/isobus/pGNAndSPN/9489?type=PGN. Signal-level enrichment via PR welcome  see CONTRIBUTING.md.";
CM_ SG_ 2147547691 High_Voltage_Energy_Storage_Pack "Generic 8-byte raw payload. Detail page: https://www.isobus.net/isobus/pGNAndSPN/9505?type=PGN. Signal-level enrichment via PR welcome  see CONTRIBUTING.md.";
CM_ SG_ 2147547692 High_Voltage_Energy_Storage_Pack "Generic 8-byte raw payload. Detail page: https://www.isobus.net/isobus/pGNAndSPN/9521?type=PGN. Signal-level enrichment via PR welcome  see CONTRIBUTING.md.";
CM_ SG_ 2147547693 High_Voltage_Energy_Storage_Pack "Generic 8-byte raw payload. Detail page: https://www.isobus.net/isobus/pGNAndSPN/9537?type=PGN. Signal-level enrichment via PR welcome  see CONTRIBUTING.md.";
CM_ SG_ 2147547694 High_Voltage_Energy_Storage_Pack "Generic 8-byte raw payload. Detail page: https://www.isobus.net/isobus/pGNAndSPN/9553?type=PGN. Signal-level enrichment via PR welcome  see CONTRIBUTING.md.";
CM_ SG_ 2147547695 High_Voltage_Energy_Storage_Pack "Generic 8-byte raw payload. Detail page: https://www.isobus.net/isobus/pGNAndSPN/9569?type=PGN. Signal-level enrichment via PR welcome  see CONTRIBUTING.md.";
CM_ SG_ 2147547696 High_Voltage_Energy_Storage_Pack "Generic 8-byte raw payload. Detail page: https://www.isobus.net/isobus/pGNAndSPN/9585?type=PGN. Signal-level enrichment via PR welcome  see CONTRIBUTING.md.";
CM_ SG_ 2147547697 High_Voltage_Energy_Storage_Pack "Generic 8-byte raw payload. Detail page: https://www.isobus.net/isobus/pGNAndSPN/9601?type=PGN. Signal-level enrichment via PR welcome  see CONTRIBUTING.md.";
CM_ SG_ 2147547698 High_Voltage_Energy_Storage_Pack "Generic 8-byte raw payload. Detail page: https://www.isobus.net/isobus/pGNAndSPN/9617?type=PGN. Signal-level enrichment via PR welcome  see CONTRIBUTING.md.";
CM_ SG_ 2147547699 Multi_Color_Indicator_Lamp_Comma "Generic 8-byte raw payload. Detail page: https://www.isobus.net/isobus/pGNAndSPN/9631?type=PGN. Signal-level enrichment via PR welcome  see CONTRIBUTING.md.";
CM_ SG_ 2147547700 Multi_Color_Indicator_Lamp_Statu "Generic 8-byte raw payload. Detail page: https://www.isobus.net/isobus/pGNAndSPN/9647?type=PGN. Signal-level enrichment via PR welcome  see CONTRIBUTING.md.";
CM_ SG_ 2147547701 Refuse_Truck_Body_Information_Ra "Generic 8-byte raw payload. Detail page: https://www.isobus.net/isobus/pGNAndSPN/9652?type=PGN. Signal-level enrichment via PR welcome  see CONTRIBUTING.md.";
CM_ SG_ 2147547702 Engine_Fluid_Level_Pressure_14_R "Generic 8-byte raw payload. Detail page: https://www.isobus.net/isobus/pGNAndSPN/9656?type=PGN. Signal-level enrichment via PR welcome  see CONTRIBUTING.md.";
CM_ SG_ 2147547703 Well_Stimulation_Transmission_Co "Generic 8-byte raw payload. Detail page: https://www.isobus.net/isobus/pGNAndSPN/9663?type=PGN. Signal-level enrichment via PR welcome  see CONTRIBUTING.md.";
CM_ SG_ 2147547704 Well_Stimulation_Pump_Protection "Generic 8-byte raw payload. Detail page: https://www.isobus.net/isobus/pGNAndSPN/9671?type=PGN. Signal-level enrichment via PR welcome  see CONTRIBUTING.md.";
CM_ SG_ 2147547705 Well_Stimulation_Pump_Protection "Generic 8-byte raw payload. Detail page: https://www.isobus.net/isobus/pGNAndSPN/9678?type=PGN. Signal-level enrichment via PR welcome  see CONTRIBUTING.md.";
CM_ SG_ 2147547706 Electric_PTO_Drive_Engagement_1_ "Generic 8-byte raw payload. Detail page: https://www.isobus.net/isobus/pGNAndSPN/9686?type=PGN. Signal-level enrichment via PR welcome  see CONTRIBUTING.md.";
CM_ SG_ 2147547707 Electric_PTO_1_Information_RawPa "Generic 8-byte raw payload. Detail page: https://www.isobus.net/isobus/pGNAndSPN/9689?type=PGN. Signal-level enrichment via PR welcome  see CONTRIBUTING.md.";
CM_ SG_ 2147547708 Engine_Exhaust_O2_Sensor_Informa "Generic 8-byte raw payload. Detail page: https://www.isobus.net/isobus/pGNAndSPN/9693?type=PGN. Signal-level enrichment via PR welcome  see CONTRIBUTING.md.";
CM_ SG_ 2147547709 Gaseous_Fuel_Supply_Pressure_3_R "Generic 8-byte raw payload. Detail page: https://www.isobus.net/isobus/pGNAndSPN/9698?type=PGN. Signal-level enrichment via PR welcome  see CONTRIBUTING.md.";
CM_ SG_ 2147547710 Traffic_Signage_RawPayload "Generic 8-byte raw payload. Detail page: https://www.isobus.net/isobus/pGNAndSPN/9699?type=PGN. Signal-level enrichment via PR welcome  see CONTRIBUTING.md.";
CM_ SG_ 2147547711 Engine_Configuration_4_RawPayloa "Generic 8-byte raw payload. Detail page: https://www.isobus.net/isobus/pGNAndSPN/9701?type=PGN. Signal-level enrichment via PR welcome  see CONTRIBUTING.md.";
CM_ SG_ 2147547712 Electronic_Transmission_Controll "Generic 8-byte raw payload. Detail page: https://www.isobus.net/isobus/pGNAndSPN/9706?type=PGN. Signal-level enrichment via PR welcome  see CONTRIBUTING.md.";
CM_ SG_ 2147547713 Automated_Driving_System_Network "Generic 8-byte raw payload. Detail page: https://www.isobus.net/isobus/pGNAndSPN/9714?type=PGN. Signal-level enrichment via PR welcome  see CONTRIBUTING.md.";
CM_ SG_ 2147547714 Automated_Driving_System_Network "Generic 8-byte raw payload. Detail page: https://www.isobus.net/isobus/pGNAndSPN/9722?type=PGN. Signal-level enrichment via PR welcome  see CONTRIBUTING.md.";
CM_ SG_ 2147547715 Hybrid_or_EV_System_Inputs_2_Raw "Generic 8-byte raw payload. Detail page: https://www.isobus.net/isobus/pGNAndSPN/9723?type=PGN. Signal-level enrichment via PR welcome  see CONTRIBUTING.md.";
CM_ SG_ 2147547716 Engine_Speed_Load_Factor_Informa "Generic 8-byte raw payload. Detail page: https://www.isobus.net/isobus/pGNAndSPN/9725?type=PGN. Signal-level enrichment via PR welcome  see CONTRIBUTING.md.";
CM_ SG_ 2147547717 Generator_Trip_Energy_2_RawPaylo "Generic 8-byte raw payload. Detail page: https://www.isobus.net/isobus/pGNAndSPN/9726?type=PGN. Signal-level enrichment via PR welcome  see CONTRIBUTING.md.";
CM_ SG_ 2147547718 Security_System_Machine_Operatio "Generic 8-byte raw payload. Detail page: https://www.isobus.net/isobus/pGNAndSPN/9731?type=PGN. Signal-level enrichment via PR welcome  see CONTRIBUTING.md.";
CM_ SG_ 2147547719 Engine_Fuel_Actuator_Service_Mod "Generic 8-byte raw payload. Detail page: https://www.isobus.net/isobus/pGNAndSPN/9733?type=PGN. Signal-level enrichment via PR welcome  see CONTRIBUTING.md.";
CM_ SG_ 2147547720 Steering_Wheel_Controls_RawPaylo "Generic 8-byte raw payload. Detail page: https://www.isobus.net/isobus/pGNAndSPN/9740?type=PGN. Signal-level enrichment via PR welcome  see CONTRIBUTING.md.";
CM_ SG_ 2147547721 Park_Assist_RawPayload "Generic 8-byte raw payload. Detail page: https://www.isobus.net/isobus/pGNAndSPN/9742?type=PGN. Signal-level enrichment via PR welcome  see CONTRIBUTING.md.";
CM_ SG_ 2147547722 Extended_DTC_information_RawPayl "Generic 8-byte raw payload. Detail page: https://www.isobus.net/isobus/pGNAndSPN/9743?type=PGN. Signal-level enrichment via PR welcome  see CONTRIBUTING.md.";
CM_ SG_ 2147547723 Aftertreatment_2_SCR_Dosing_Syst "Generic 8-byte raw payload. Detail page: https://www.isobus.net/isobus/pGNAndSPN/9745?type=PGN. Signal-level enrichment via PR welcome  see CONTRIBUTING.md.";
CM_ SG_ 2147547724 Aftertreatment_1_SCR_Dosing_Syst "Generic 8-byte raw payload. Detail page: https://www.isobus.net/isobus/pGNAndSPN/9747?type=PGN. Signal-level enrichment via PR welcome  see CONTRIBUTING.md.";
CM_ SG_ 2147547725 EV_Economy_Information_RawPayloa "Generic 8-byte raw payload. Detail page: https://www.isobus.net/isobus/pGNAndSPN/9749?type=PGN. Signal-level enrichment via PR welcome  see CONTRIBUTING.md.";
CM_ SG_ 2147547726 Automated_Driving_System_Status_ "Generic 8-byte raw payload. Detail page: https://www.isobus.net/isobus/pGNAndSPN/9761?type=PGN. Signal-level enrichment via PR welcome  see CONTRIBUTING.md.";
CM_ SG_ 2147547727 Automated_Driving_System_Control "Generic 8-byte raw payload. Detail page: https://www.isobus.net/isobus/pGNAndSPN/9765?type=PGN. Signal-level enrichment via PR welcome  see CONTRIBUTING.md.";
CM_ SG_ 2147547728 Aftercooler_Valve_RawPayload "Generic 8-byte raw payload. Detail page: https://www.isobus.net/isobus/pGNAndSPN/9770?type=PGN. Signal-level enrichment via PR welcome  see CONTRIBUTING.md.";
CM_ SG_ 2147547729 Engine_Radiator_1_RawPayload "Generic 8-byte raw payload. Detail page: https://www.isobus.net/isobus/pGNAndSPN/9781?type=PGN. Signal-level enrichment via PR welcome  see CONTRIBUTING.md.";
CM_ SG_ 2147547730 Engine_Radiator_2_RawPayload "Generic 8-byte raw payload. Detail page: https://www.isobus.net/isobus/pGNAndSPN/9791?type=PGN. Signal-level enrichment via PR welcome  see CONTRIBUTING.md.";
CM_ SG_ 2147547731 Genset_Enclosure_Ventilation_Raw "Generic 8-byte raw payload. Detail page: https://www.isobus.net/isobus/pGNAndSPN/9795?type=PGN. Signal-level enrichment via PR welcome  see CONTRIBUTING.md.";
CM_ SG_ 2147547732 Heat_Exchanger_1_RawPayload "Generic 8-byte raw payload. Detail page: https://www.isobus.net/isobus/pGNAndSPN/9799?type=PGN. Signal-level enrichment via PR welcome  see CONTRIBUTING.md.";
CM_ SG_ 2147547733 Heat_Exchanger_2_RawPayload "Generic 8-byte raw payload. Detail page: https://www.isobus.net/isobus/pGNAndSPN/9803?type=PGN. Signal-level enrichment via PR welcome  see CONTRIBUTING.md.";
CM_ SG_ 2147547734 Heat_Exchanger_3_RawPayload "Generic 8-byte raw payload. Detail page: https://www.isobus.net/isobus/pGNAndSPN/9807?type=PGN. Signal-level enrichment via PR welcome  see CONTRIBUTING.md.";
CM_ SG_ 2147547735 Heat_Exchanger_4_RawPayload "Generic 8-byte raw payload. Detail page: https://www.isobus.net/isobus/pGNAndSPN/9811?type=PGN. Signal-level enrichment via PR welcome  see CONTRIBUTING.md.";
CM_ SG_ 2147547736 Engine_Exhaust_Gas_Heat_Exchange "Generic 8-byte raw payload. Detail page: https://www.isobus.net/isobus/pGNAndSPN/9814?type=PGN. Signal-level enrichment via PR welcome  see CONTRIBUTING.md.";
CM_ SG_ 2147547737 Genset_Enclosure_Ventilation_Lou "Generic 8-byte raw payload. Detail page: https://www.isobus.net/isobus/pGNAndSPN/9820?type=PGN. Signal-level enrichment via PR welcome  see CONTRIBUTING.md.";
CM_ SG_ 2147547738 Genset_External_Coolant_System_R "Generic 8-byte raw payload. Detail page: https://www.isobus.net/isobus/pGNAndSPN/9826?type=PGN. Signal-level enrichment via PR welcome  see CONTRIBUTING.md.";
CM_ SG_ 2147547739 EV_DC_Status_1_RawPayload "Generic 8-byte raw payload. Detail page: https://www.isobus.net/isobus/pGNAndSPN/9829?type=PGN. Signal-level enrichment via PR welcome  see CONTRIBUTING.md.";
CM_ SG_ 2147547740 EVSE_DC_Charging_Limits_3_RawPay "Generic 8-byte raw payload. Detail page: https://www.isobus.net/isobus/pGNAndSPN/9830?type=PGN. Signal-level enrichment via PR welcome  see CONTRIBUTING.md.";
CM_ SG_ 2147547741 EVSE_Power_Max_Schedule_RawPaylo "Generic 8-byte raw payload. Detail page: https://www.isobus.net/isobus/pGNAndSPN/9837?type=PGN. Signal-level enrichment via PR welcome  see CONTRIBUTING.md.";
CM_ SG_ 2147547742 EV_Charge_Profile_RawPayload "Generic 8-byte raw payload. Detail page: https://www.isobus.net/isobus/pGNAndSPN/9840?type=PGN. Signal-level enrichment via PR welcome  see CONTRIBUTING.md.";
CM_ SG_ 2147547743 EV_DC_Charging_Limits_2_RawPaylo "Generic 8-byte raw payload. Detail page: https://www.isobus.net/isobus/pGNAndSPN/9844?type=PGN. Signal-level enrichment via PR welcome  see CONTRIBUTING.md.";
CM_ SG_ 2147547744 EV_DC_Charging_In_Progress_RawPa "Generic 8-byte raw payload. Detail page: https://www.isobus.net/isobus/pGNAndSPN/9849?type=PGN. Signal-level enrichment via PR welcome  see CONTRIBUTING.md.";
CM_ SG_ 2147547746 Lighting_Data_2_RawPayload "Generic 8-byte raw payload. Detail page: https://www.isobus.net/isobus/pGNAndSPN/9850?type=PGN. Signal-level enrichment via PR welcome  see CONTRIBUTING.md.";
CM_ SG_ 2147547747 Lighting_Command_2_RawPayload "Generic 8-byte raw payload. Detail page: https://www.isobus.net/isobus/pGNAndSPN/9852?type=PGN. Signal-level enrichment via PR welcome  see CONTRIBUTING.md.";
CM_ SG_ 2147547748 Aftertreatment_System_Informatio "Generic 8-byte raw payload. Detail page: https://www.isobus.net/isobus/pGNAndSPN/9854?type=PGN. Signal-level enrichment via PR welcome  see CONTRIBUTING.md.";
CM_ SG_ 2147547749 Aftertreatment_System_Informatio "Generic 8-byte raw payload. Detail page: https://www.isobus.net/isobus/pGNAndSPN/9856?type=PGN. Signal-level enrichment via PR welcome  see CONTRIBUTING.md.";
CM_ SG_ 2147547750 Aftertreatment_System_Informatio "Generic 8-byte raw payload. Detail page: https://www.isobus.net/isobus/pGNAndSPN/9858?type=PGN. Signal-level enrichment via PR welcome  see CONTRIBUTING.md.";
CM_ SG_ 2147547751 Fluid_Resistance_1_RawPayload "Generic 8-byte raw payload. Detail page: https://www.isobus.net/isobus/pGNAndSPN/9860?type=PGN. Signal-level enrichment via PR welcome  see CONTRIBUTING.md.";
CM_ SG_ 2147547752 Power_Converter_2_Isolation_Inte "Generic 8-byte raw payload. Detail page: https://www.isobus.net/isobus/pGNAndSPN/9864?type=PGN. Signal-level enrichment via PR welcome  see CONTRIBUTING.md.";
CM_ SG_ 2147547753 Power_Converter_1_Isolation_Inte "Generic 8-byte raw payload. Detail page: https://www.isobus.net/isobus/pGNAndSPN/9868?type=PGN. Signal-level enrichment via PR welcome  see CONTRIBUTING.md.";
CM_ SG_ 2147547754 Power_Converter_2_Limits_Request "Generic 8-byte raw payload. Detail page: https://www.isobus.net/isobus/pGNAndSPN/9874?type=PGN. Signal-level enrichment via PR welcome  see CONTRIBUTING.md.";
CM_ SG_ 2147547755 Power_Converter_2_Limits_Request "Generic 8-byte raw payload. Detail page: https://www.isobus.net/isobus/pGNAndSPN/9880?type=PGN. Signal-level enrichment via PR welcome  see CONTRIBUTING.md.";
CM_ SG_ 2147547756 Power_Converter_2_Limits_Request "Generic 8-byte raw payload. Detail page: https://www.isobus.net/isobus/pGNAndSPN/9886?type=PGN. Signal-level enrichment via PR welcome  see CONTRIBUTING.md.";
CM_ SG_ 2147547757 Power_Converter_1_Limits_Request "Generic 8-byte raw payload. Detail page: https://www.isobus.net/isobus/pGNAndSPN/9892?type=PGN. Signal-level enrichment via PR welcome  see CONTRIBUTING.md.";
CM_ SG_ 2147547758 Power_Converter_1_Limits_Request "Generic 8-byte raw payload. Detail page: https://www.isobus.net/isobus/pGNAndSPN/9898?type=PGN. Signal-level enrichment via PR welcome  see CONTRIBUTING.md.";
CM_ SG_ 2147547759 Power_Converter_1_Limits_Request "Generic 8-byte raw payload. Detail page: https://www.isobus.net/isobus/pGNAndSPN/9904?type=PGN. Signal-level enrichment via PR welcome  see CONTRIBUTING.md.";
CM_ SG_ 2147547760 Inverter_1_Lifetime_Data_RawPayl "Generic 8-byte raw payload. Detail page: https://www.isobus.net/isobus/pGNAndSPN/9908?type=PGN. Signal-level enrichment via PR welcome  see CONTRIBUTING.md.";
CM_ SG_ 2147547761 Inverter_2_Lifetime_Data_RawPayl "Generic 8-byte raw payload. Detail page: https://www.isobus.net/isobus/pGNAndSPN/9912?type=PGN. Signal-level enrichment via PR welcome  see CONTRIBUTING.md.";
CM_ SG_ 2147547762 Power_Converter_2_Active_Power_L "Generic 8-byte raw payload. Detail page: https://www.isobus.net/isobus/pGNAndSPN/9930?type=PGN. Signal-level enrichment via PR welcome  see CONTRIBUTING.md.";
CM_ SG_ 2147547763 Power_Converter_1_Active_Power_L "Generic 8-byte raw payload. Detail page: https://www.isobus.net/isobus/pGNAndSPN/9948?type=PGN. Signal-level enrichment via PR welcome  see CONTRIBUTING.md.";
CM_ SG_ 2147547764 Power_Converter_2_Reference_1_Ra "Generic 8-byte raw payload. Detail page: https://www.isobus.net/isobus/pGNAndSPN/9953?type=PGN. Signal-level enrichment via PR welcome  see CONTRIBUTING.md.";
CM_ SG_ 2147547765 Power_Converter_2_Reference_2_Ra "Generic 8-byte raw payload. Detail page: https://www.isobus.net/isobus/pGNAndSPN/9957?type=PGN. Signal-level enrichment via PR welcome  see CONTRIBUTING.md.";
CM_ SG_ 2147547766 Power_Converter_2_Temperature_Ra "Generic 8-byte raw payload. Detail page: https://www.isobus.net/isobus/pGNAndSPN/9961?type=PGN. Signal-level enrichment via PR welcome  see CONTRIBUTING.md.";
CM_ SG_ 2147547767 Power_Converter_1_Temperature_Ra "Generic 8-byte raw payload. Detail page: https://www.isobus.net/isobus/pGNAndSPN/9965?type=PGN. Signal-level enrichment via PR welcome  see CONTRIBUTING.md.";
CM_ SG_ 2147547768 Power_Converter_1_Reference_2_Ra "Generic 8-byte raw payload. Detail page: https://www.isobus.net/isobus/pGNAndSPN/9969?type=PGN. Signal-level enrichment via PR welcome  see CONTRIBUTING.md.";
CM_ SG_ 2147547769 Power_Converter_1_Reference_1_Ra "Generic 8-byte raw payload. Detail page: https://www.isobus.net/isobus/pGNAndSPN/9974?type=PGN. Signal-level enrichment via PR welcome  see CONTRIBUTING.md.";
CM_ SG_ 2147547770 Power_Converter_1_Phase_Current_ "Generic 8-byte raw payload. Detail page: https://www.isobus.net/isobus/pGNAndSPN/9977?type=PGN. Signal-level enrichment via PR welcome  see CONTRIBUTING.md.";
CM_ SG_ 2147547771 Power_Converter_2_Phase_Current_ "Generic 8-byte raw payload. Detail page: https://www.isobus.net/isobus/pGNAndSPN/9980?type=PGN. Signal-level enrichment via PR welcome  see CONTRIBUTING.md.";
CM_ SG_ 2147547772 Power_Converter_1_Phase_Voltage_ "Generic 8-byte raw payload. Detail page: https://www.isobus.net/isobus/pGNAndSPN/9983?type=PGN. Signal-level enrichment via PR welcome  see CONTRIBUTING.md.";
CM_ SG_ 2147547773 Power_Converter_2_Phase_Voltage_ "Generic 8-byte raw payload. Detail page: https://www.isobus.net/isobus/pGNAndSPN/9986?type=PGN. Signal-level enrichment via PR welcome  see CONTRIBUTING.md.";
CM_ SG_ 2147547774 Power_Converter_Power_Module_Swi "Generic 8-byte raw payload. Detail page: https://www.isobus.net/isobus/pGNAndSPN/9992?type=PGN. Signal-level enrichment via PR welcome  see CONTRIBUTING.md.";
CM_ SG_ 2147547775 Power_Converter_1_Power_Module_S "Generic 8-byte raw payload. Detail page: https://www.isobus.net/isobus/pGNAndSPN/9995?type=PGN. Signal-level enrichment via PR welcome  see CONTRIBUTING.md.";
CM_ SG_ 2147547776 Power_Converter_2_Power_Module_S "Generic 8-byte raw payload. Detail page: https://www.isobus.net/isobus/pGNAndSPN/9998?type=PGN. Signal-level enrichment via PR welcome  see CONTRIBUTING.md.";
CM_ SG_ 2147547777 Power_Converter_Totals_1_RawPayl "Generic 8-byte raw payload. Detail page: https://www.isobus.net/isobus/pGNAndSPN/10002?type=PGN. Signal-level enrichment via PR welcome  see CONTRIBUTING.md.";
CM_ SG_ 2147547778 Transformer_Temperatures_RawPayl "Generic 8-byte raw payload. Detail page: https://www.isobus.net/isobus/pGNAndSPN/10008?type=PGN. Signal-level enrichment via PR welcome  see CONTRIBUTING.md.";
CM_ SG_ 2147547779 Electrified_Accessory_Engine_Coo "Generic 8-byte raw payload. Detail page: https://www.isobus.net/isobus/pGNAndSPN/10016?type=PGN. Signal-level enrichment via PR welcome  see CONTRIBUTING.md.";
CM_ SG_ 2147547780 High_Voltage_Energy_Storage_Pack "Generic 8-byte raw payload. Detail page: https://www.isobus.net/isobus/pGNAndSPN/10022?type=PGN. Signal-level enrichment via PR welcome  see CONTRIBUTING.md.";
CM_ SG_ 2147547781 High_Voltage_Energy_Storage_Pack "Generic 8-byte raw payload. Detail page: https://www.isobus.net/isobus/pGNAndSPN/10032?type=PGN. Signal-level enrichment via PR welcome  see CONTRIBUTING.md.";
CM_ SG_ 2147547782 High_Voltage_Energy_Storage_Pack "Generic 8-byte raw payload. Detail page: https://www.isobus.net/isobus/pGNAndSPN/10038?type=PGN. Signal-level enrichment via PR welcome  see CONTRIBUTING.md.";
CM_ SG_ 2147547783 High_Voltage_Energy_Storage_Pack "Generic 8-byte raw payload. Detail page: https://www.isobus.net/isobus/pGNAndSPN/10048?type=PGN. Signal-level enrichment via PR welcome  see CONTRIBUTING.md.";
CM_ SG_ 2147547784 High_Voltage_Energy_Storage_Pack "Generic 8-byte raw payload. Detail page: https://www.isobus.net/isobus/pGNAndSPN/10054?type=PGN. Signal-level enrichment via PR welcome  see CONTRIBUTING.md.";
CM_ SG_ 2147547785 High_Voltage_Energy_Storage_Pack "Generic 8-byte raw payload. Detail page: https://www.isobus.net/isobus/pGNAndSPN/10064?type=PGN. Signal-level enrichment via PR welcome  see CONTRIBUTING.md.";
CM_ SG_ 2147547786 High_Voltage_Energy_Storage_Pack "Generic 8-byte raw payload. Detail page: https://www.isobus.net/isobus/pGNAndSPN/10070?type=PGN. Signal-level enrichment via PR welcome  see CONTRIBUTING.md.";
CM_ SG_ 2147547787 High_Voltage_Energy_Storage_Pack "Generic 8-byte raw payload. Detail page: https://www.isobus.net/isobus/pGNAndSPN/10080?type=PGN. Signal-level enrichment via PR welcome  see CONTRIBUTING.md.";
CM_ SG_ 2147547788 High_Voltage_Energy_Storage_Pack "Generic 8-byte raw payload. Detail page: https://www.isobus.net/isobus/pGNAndSPN/10086?type=PGN. Signal-level enrichment via PR welcome  see CONTRIBUTING.md.";
CM_ SG_ 2147547789 High_Voltage_Energy_Storage_Pack "Generic 8-byte raw payload. Detail page: https://www.isobus.net/isobus/pGNAndSPN/10096?type=PGN. Signal-level enrichment via PR welcome  see CONTRIBUTING.md.";
CM_ SG_ 2147547790 High_Voltage_Energy_Storage_Pack "Generic 8-byte raw payload. Detail page: https://www.isobus.net/isobus/pGNAndSPN/10102?type=PGN. Signal-level enrichment via PR welcome  see CONTRIBUTING.md.";
CM_ SG_ 2147547791 High_Voltage_Energy_Storage_Pack "Generic 8-byte raw payload. Detail page: https://www.isobus.net/isobus/pGNAndSPN/10112?type=PGN. Signal-level enrichment via PR welcome  see CONTRIBUTING.md.";
CM_ SG_ 2147547792 High_Voltage_Energy_Storage_Pack "Generic 8-byte raw payload. Detail page: https://www.isobus.net/isobus/pGNAndSPN/10118?type=PGN. Signal-level enrichment via PR welcome  see CONTRIBUTING.md.";
CM_ SG_ 2147547793 High_Voltage_Energy_Storage_Pack "Generic 8-byte raw payload. Detail page: https://www.isobus.net/isobus/pGNAndSPN/10128?type=PGN. Signal-level enrichment via PR welcome  see CONTRIBUTING.md.";
CM_ SG_ 2147547794 High_Voltage_Energy_Storage_Pack "Generic 8-byte raw payload. Detail page: https://www.isobus.net/isobus/pGNAndSPN/10134?type=PGN. Signal-level enrichment via PR welcome  see CONTRIBUTING.md.";
CM_ SG_ 2147547795 High_Voltage_Energy_Storage_Pack "Generic 8-byte raw payload. Detail page: https://www.isobus.net/isobus/pGNAndSPN/10144?type=PGN. Signal-level enrichment via PR welcome  see CONTRIBUTING.md.";
CM_ SG_ 2147547796 High_Voltage_Energy_Storage_Pack "Generic 8-byte raw payload. Detail page: https://www.isobus.net/isobus/pGNAndSPN/10150?type=PGN. Signal-level enrichment via PR welcome  see CONTRIBUTING.md.";
CM_ SG_ 2147547797 High_Voltage_Energy_Storage_Pack "Generic 8-byte raw payload. Detail page: https://www.isobus.net/isobus/pGNAndSPN/10160?type=PGN. Signal-level enrichment via PR welcome  see CONTRIBUTING.md.";
CM_ SG_ 2147547798 High_Voltage_Energy_Storage_Pack "Generic 8-byte raw payload. Detail page: https://www.isobus.net/isobus/pGNAndSPN/10166?type=PGN. Signal-level enrichment via PR welcome  see CONTRIBUTING.md.";
CM_ SG_ 2147547799 High_Voltage_Energy_Storage_Pack "Generic 8-byte raw payload. Detail page: https://www.isobus.net/isobus/pGNAndSPN/10176?type=PGN. Signal-level enrichment via PR welcome  see CONTRIBUTING.md.";
CM_ SG_ 2147547800 High_Voltage_Energy_Storage_Pack "Generic 8-byte raw payload. Detail page: https://www.isobus.net/isobus/pGNAndSPN/10182?type=PGN. Signal-level enrichment via PR welcome  see CONTRIBUTING.md.";
CM_ SG_ 2147547801 High_Voltage_Energy_Storage_Pack "Generic 8-byte raw payload. Detail page: https://www.isobus.net/isobus/pGNAndSPN/10192?type=PGN. Signal-level enrichment via PR welcome  see CONTRIBUTING.md.";
CM_ SG_ 2147547802 High_Voltage_Energy_Storage_Pack "Generic 8-byte raw payload. Detail page: https://www.isobus.net/isobus/pGNAndSPN/10198?type=PGN. Signal-level enrichment via PR welcome  see CONTRIBUTING.md.";
CM_ SG_ 2147547803 High_Voltage_Energy_Storage_Pack "Generic 8-byte raw payload. Detail page: https://www.isobus.net/isobus/pGNAndSPN/10208?type=PGN. Signal-level enrichment via PR welcome  see CONTRIBUTING.md.";
CM_ SG_ 2147547804 High_Voltage_Energy_Storage_Pack "Generic 8-byte raw payload. Detail page: https://www.isobus.net/isobus/pGNAndSPN/10214?type=PGN. Signal-level enrichment via PR welcome  see CONTRIBUTING.md.";
CM_ SG_ 2147547805 High_Voltage_Energy_Storage_Pack "Generic 8-byte raw payload. Detail page: https://www.isobus.net/isobus/pGNAndSPN/10224?type=PGN. Signal-level enrichment via PR welcome  see CONTRIBUTING.md.";
CM_ SG_ 2147547806 High_Voltage_Energy_Storage_Pack "Generic 8-byte raw payload. Detail page: https://www.isobus.net/isobus/pGNAndSPN/10230?type=PGN. Signal-level enrichment via PR welcome  see CONTRIBUTING.md.";
CM_ SG_ 2147547807 High_Voltage_Energy_Storage_Pack "Generic 8-byte raw payload. Detail page: https://www.isobus.net/isobus/pGNAndSPN/10240?type=PGN. Signal-level enrichment via PR welcome  see CONTRIBUTING.md.";
CM_ SG_ 2147547808 High_Voltage_Energy_Storage_Pack "Generic 8-byte raw payload. Detail page: https://www.isobus.net/isobus/pGNAndSPN/10246?type=PGN. Signal-level enrichment via PR welcome  see CONTRIBUTING.md.";
CM_ SG_ 2147547809 High_Voltage_Energy_Storage_Pack "Generic 8-byte raw payload. Detail page: https://www.isobus.net/isobus/pGNAndSPN/10256?type=PGN. Signal-level enrichment via PR welcome  see CONTRIBUTING.md.";
CM_ SG_ 2147547810 High_Voltage_Energy_Storage_Pack "Generic 8-byte raw payload. Detail page: https://www.isobus.net/isobus/pGNAndSPN/10262?type=PGN. Signal-level enrichment via PR welcome  see CONTRIBUTING.md.";
CM_ SG_ 2147547811 High_Voltage_Energy_Storage_Pack "Generic 8-byte raw payload. Detail page: https://www.isobus.net/isobus/pGNAndSPN/10272?type=PGN. Signal-level enrichment via PR welcome  see CONTRIBUTING.md.";
CM_ SG_ 2147547812 Automated_Driving_System_Control "Generic 8-byte raw payload. Detail page: https://www.isobus.net/isobus/pGNAndSPN/10277?type=PGN. Signal-level enrichment via PR welcome  see CONTRIBUTING.md.";
CM_ SG_ 2147547813 Dual_Fuel_Mode_3_RawPayload "Generic 8-byte raw payload. Detail page: https://www.isobus.net/isobus/pGNAndSPN/10280?type=PGN. Signal-level enrichment via PR welcome  see CONTRIBUTING.md.";
CM_ SG_ 2147547814 Dual_Fuel_Mode_2_RawPayload "Generic 8-byte raw payload. Detail page: https://www.isobus.net/isobus/pGNAndSPN/10282?type=PGN. Signal-level enrichment via PR welcome  see CONTRIBUTING.md.";
CM_ SG_ 2147547815 Dual_Fuel_Mode_1_RawPayload "Generic 8-byte raw payload. Detail page: https://www.isobus.net/isobus/pGNAndSPN/10287?type=PGN. Signal-level enrichment via PR welcome  see CONTRIBUTING.md.";
CM_ SG_ 2147547816 Transmission_1_History_RawPayloa "Generic 8-byte raw payload. Detail page: https://www.isobus.net/isobus/pGNAndSPN/10290?type=PGN. Signal-level enrichment via PR welcome  see CONTRIBUTING.md.";
CM_ SG_ 2147547817 Transmission_Shaft_Twist_Informa "Generic 8-byte raw payload. Detail page: https://www.isobus.net/isobus/pGNAndSPN/10293?type=PGN. Signal-level enrichment via PR welcome  see CONTRIBUTING.md.";
CM_ SG_ 2147547818 Electronic_Auxiliary_Transmissio "Generic 8-byte raw payload. Detail page: https://www.isobus.net/isobus/pGNAndSPN/10295?type=PGN. Signal-level enrichment via PR welcome  see CONTRIBUTING.md.";
CM_ SG_ 2147547819 High_Voltage_Energy_Storage_Pack "Generic 8-byte raw payload. Detail page: https://www.isobus.net/isobus/pGNAndSPN/10305?type=PGN. Signal-level enrichment via PR welcome  see CONTRIBUTING.md.";
CM_ SG_ 2147547820 High_Voltage_Energy_Storage_Pack "Generic 8-byte raw payload. Detail page: https://www.isobus.net/isobus/pGNAndSPN/10311?type=PGN. Signal-level enrichment via PR welcome  see CONTRIBUTING.md.";
CM_ SG_ 2147547821 High_Voltage_Energy_Storage_Pack "Generic 8-byte raw payload. Detail page: https://www.isobus.net/isobus/pGNAndSPN/10321?type=PGN. Signal-level enrichment via PR welcome  see CONTRIBUTING.md.";
CM_ SG_ 2147547822 High_Voltage_Energy_Storage_Pack "Generic 8-byte raw payload. Detail page: https://www.isobus.net/isobus/pGNAndSPN/10327?type=PGN. Signal-level enrichment via PR welcome  see CONTRIBUTING.md.";
CM_ SG_ 2147547823 High_Voltage_Energy_Storage_Pack "Generic 8-byte raw payload. Detail page: https://www.isobus.net/isobus/pGNAndSPN/10337?type=PGN. Signal-level enrichment via PR welcome  see CONTRIBUTING.md.";
CM_ SG_ 2147547824 High_Voltage_Energy_Storage_Pack "Generic 8-byte raw payload. Detail page: https://www.isobus.net/isobus/pGNAndSPN/10343?type=PGN. Signal-level enrichment via PR welcome  see CONTRIBUTING.md.";
CM_ SG_ 2147547825 High_Voltage_Energy_Storage_Pack "Generic 8-byte raw payload. Detail page: https://www.isobus.net/isobus/pGNAndSPN/10353?type=PGN. Signal-level enrichment via PR welcome  see CONTRIBUTING.md.";
CM_ SG_ 2147547826 High_Voltage_Energy_Storage_Pack "Generic 8-byte raw payload. Detail page: https://www.isobus.net/isobus/pGNAndSPN/10359?type=PGN. Signal-level enrichment via PR welcome  see CONTRIBUTING.md.";
CM_ SG_ 2147547827 AUTOSAR_Time_Synchronization_Raw "Generic 8-byte raw payload. Detail page: https://www.isobus.net/isobus/pGNAndSPN/10360?type=PGN. Signal-level enrichment via PR welcome  see CONTRIBUTING.md.";
CM_ SG_ 2147547828 EV_DC_Charging_Limits_1_RawPaylo "Generic 8-byte raw payload. Detail page: https://www.isobus.net/isobus/pGNAndSPN/10364?type=PGN. Signal-level enrichment via PR welcome  see CONTRIBUTING.md.";
CM_ SG_ 2147547829 EVSE_DC_Charging_Limits_1_RawPay "Generic 8-byte raw payload. Detail page: https://www.isobus.net/isobus/pGNAndSPN/10368?type=PGN. Signal-level enrichment via PR welcome  see CONTRIBUTING.md.";
CM_ SG_ 2147547830 EVSE_DC_Charging_Limits_2_RawPay "Generic 8-byte raw payload. Detail page: https://www.isobus.net/isobus/pGNAndSPN/10372?type=PGN. Signal-level enrichment via PR welcome  see CONTRIBUTING.md.";
CM_ SG_ 2147547831 EV_DC_Charging_Target_RawPayload "Generic 8-byte raw payload. Detail page: https://www.isobus.net/isobus/pGNAndSPN/10376?type=PGN. Signal-level enrichment via PR welcome  see CONTRIBUTING.md.";
CM_ SG_ 2147547832 EVSE_DC_Status_1_RawPayload "Generic 8-byte raw payload. Detail page: https://www.isobus.net/isobus/pGNAndSPN/10386?type=PGN. Signal-level enrichment via PR welcome  see CONTRIBUTING.md.";
CM_ SG_ 2147547833 EVSE_1_Contactor_Cmd_1_RawPayloa "Generic 8-byte raw payload. Detail page: https://www.isobus.net/isobus/pGNAndSPN/10387?type=PGN. Signal-level enrichment via PR welcome  see CONTRIBUTING.md.";
CM_ SG_ 2147547834 EVSE_1_Contactor_Status_1_RawPay "Generic 8-byte raw payload. Detail page: https://www.isobus.net/isobus/pGNAndSPN/10390?type=PGN. Signal-level enrichment via PR welcome  see CONTRIBUTING.md.";
CM_ SG_ 2147547835 Direct_Lamp_Control_Command_3_Ra "Generic 8-byte raw payload. Detail page: https://www.isobus.net/isobus/pGNAndSPN/10392?type=PGN. Signal-level enrichment via PR welcome  see CONTRIBUTING.md.";
CM_ SG_ 2147547836 Direct_Lamp_Control_Data_3_RawPa "Generic 8-byte raw payload. Detail page: https://www.isobus.net/isobus/pGNAndSPN/10394?type=PGN. Signal-level enrichment via PR welcome  see CONTRIBUTING.md.";
CM_ SG_ 2147547837 Motor_Generator_1_Lifetime_Data_ "Generic 8-byte raw payload. Detail page: https://www.isobus.net/isobus/pGNAndSPN/10398?type=PGN. Signal-level enrichment via PR welcome  see CONTRIBUTING.md.";
CM_ SG_ 2147547838 Motor_Generator_2_Lifetime_Data_ "Generic 8-byte raw payload. Detail page: https://www.isobus.net/isobus/pGNAndSPN/10402?type=PGN. Signal-level enrichment via PR welcome  see CONTRIBUTING.md.";
CM_ SG_ 2147547839 Motor_Generator_3_Lifetime_Data_ "Generic 8-byte raw payload. Detail page: https://www.isobus.net/isobus/pGNAndSPN/10406?type=PGN. Signal-level enrichment via PR welcome  see CONTRIBUTING.md.";
CM_ SG_ 2147547840 Motor_Generator_4_Lifetime_Data_ "Generic 8-byte raw payload. Detail page: https://www.isobus.net/isobus/pGNAndSPN/10410?type=PGN. Signal-level enrichment via PR welcome  see CONTRIBUTING.md.";
CM_ SG_ 2147547841 Motor_Generator_5_Lifetime_Data_ "Generic 8-byte raw payload. Detail page: https://www.isobus.net/isobus/pGNAndSPN/10414?type=PGN. Signal-level enrichment via PR welcome  see CONTRIBUTING.md.";
CM_ SG_ 2147547842 Motor_Generator_6_Lifetime_Data_ "Generic 8-byte raw payload. Detail page: https://www.isobus.net/isobus/pGNAndSPN/10418?type=PGN. Signal-level enrichment via PR welcome  see CONTRIBUTING.md.";
CM_ SG_ 2147547843 Air_Supply_Pressure_3_RawPayload "Generic 8-byte raw payload. Detail page: https://www.isobus.net/isobus/pGNAndSPN/10420?type=PGN. Signal-level enrichment via PR welcome  see CONTRIBUTING.md.";
CM_ SG_ 2147547844 EVSE_AC_Supply_Voltage_RawPayloa "Generic 8-byte raw payload. Detail page: https://www.isobus.net/isobus/pGNAndSPN/10423?type=PGN. Signal-level enrichment via PR welcome  see CONTRIBUTING.md.";
CM_ SG_ 2147547845 EVSE_AC_3_Phase_Load_RawPayload "Generic 8-byte raw payload. Detail page: https://www.isobus.net/isobus/pGNAndSPN/10427?type=PGN. Signal-level enrichment via PR welcome  see CONTRIBUTING.md.";
CM_ SG_ 2147547846 Electronic_Retarder_Controller_3 "Generic 8-byte raw payload. Detail page: https://www.isobus.net/isobus/pGNAndSPN/10429?type=PGN. Signal-level enrichment via PR welcome  see CONTRIBUTING.md.";
CM_ SG_ 2147547848 Electronic_Transmission_Controll "Generic 8-byte raw payload. Detail page: https://www.isobus.net/isobus/pGNAndSPN/10434?type=PGN. Signal-level enrichment via PR welcome  see CONTRIBUTING.md.";
CM_ SG_ 2147547851 Collision_Avoidance_System_4_Raw "Generic 8-byte raw payload. Detail page: https://www.isobus.net/isobus/pGNAndSPN/10435?type=PGN. Signal-level enrichment via PR welcome  see CONTRIBUTING.md.";
CM_ SG_ 2147547852 Collision_Avoidance_System_3_Raw "Generic 8-byte raw payload. Detail page: https://www.isobus.net/isobus/pGNAndSPN/10436?type=PGN. Signal-level enrichment via PR welcome  see CONTRIBUTING.md.";
CM_ SG_ 2147547853 Aftertreatment_1_SCR_Exhaust_Gas "Generic 8-byte raw payload. Detail page: https://www.isobus.net/isobus/pGNAndSPN/10438?type=PGN. Signal-level enrichment via PR welcome  see CONTRIBUTING.md.";
CM_ SG_ 2147547854 PTO_Information_2_RawPayload "Generic 8-byte raw payload. Detail page: https://www.isobus.net/isobus/pGNAndSPN/10440?type=PGN. Signal-level enrichment via PR welcome  see CONTRIBUTING.md.";
CM_ SG_ 2147547855 EVCC_Diagnostic_Data_1_RawPayloa "Generic 8-byte raw payload. Detail page: https://www.isobus.net/isobus/pGNAndSPN/10449?type=PGN. Signal-level enrichment via PR welcome  see CONTRIBUTING.md.";
CM_ SG_ 2147547856 Cab_Door_Control_2_RawPayload "Generic 8-byte raw payload. Detail page: https://www.isobus.net/isobus/pGNAndSPN/10452?type=PGN. Signal-level enrichment via PR welcome  see CONTRIBUTING.md.";
CM_ SG_ 2147547857 Engine_Average_Information_2_Raw "Generic 8-byte raw payload. Detail page: https://www.isobus.net/isobus/pGNAndSPN/10455?type=PGN. Signal-level enrichment via PR welcome  see CONTRIBUTING.md.";
CM_ SG_ 2147547858 Turbocharger_Information_9_RawPa "Generic 8-byte raw payload. Detail page: https://www.isobus.net/isobus/pGNAndSPN/10459?type=PGN. Signal-level enrichment via PR welcome  see CONTRIBUTING.md.";
CM_ SG_ 2147547859 Automated_Driving_System_Control "Generic 8-byte raw payload. Detail page: https://www.isobus.net/isobus/pGNAndSPN/10464?type=PGN. Signal-level enrichment via PR welcome  see CONTRIBUTING.md.";
CM_ SG_ 2147547860 EVSE_AC_Status_2_RawPayload "Generic 8-byte raw payload. Detail page: https://www.isobus.net/isobus/pGNAndSPN/10466?type=PGN. Signal-level enrichment via PR welcome  see CONTRIBUTING.md.";
CM_ SG_ 2147547861 EVSE_AC_Status_1_RawPayload "Generic 8-byte raw payload. Detail page: https://www.isobus.net/isobus/pGNAndSPN/10470?type=PGN. Signal-level enrichment via PR welcome  see CONTRIBUTING.md.";
CM_ SG_ 2147547862 EVSE_Status_1_RawPayload "Generic 8-byte raw payload. Detail page: https://www.isobus.net/isobus/pGNAndSPN/10478?type=PGN. Signal-level enrichment via PR welcome  see CONTRIBUTING.md.";
CM_ SG_ 2147547863 Object_Detection_Message_1_1_Raw "Generic 8-byte raw payload. Detail page: https://www.isobus.net/isobus/pGNAndSPN/10479?type=PGN. Signal-level enrichment via PR welcome  see CONTRIBUTING.md.";
CM_ SG_ 2147547864 Object_Detection_Message_2_1_Raw "Generic 8-byte raw payload. Detail page: https://www.isobus.net/isobus/pGNAndSPN/10480?type=PGN. Signal-level enrichment via PR welcome  see CONTRIBUTING.md.";
CM_ SG_ 2147547865 Object_Detection_Message_2_2_Raw "Generic 8-byte raw payload. Detail page: https://www.isobus.net/isobus/pGNAndSPN/10481?type=PGN. Signal-level enrichment via PR welcome  see CONTRIBUTING.md.";
CM_ SG_ 2147547866 Object_Detection_Message_2_3_Raw "Generic 8-byte raw payload. Detail page: https://www.isobus.net/isobus/pGNAndSPN/10482?type=PGN. Signal-level enrichment via PR welcome  see CONTRIBUTING.md.";
CM_ SG_ 2147547867 Object_Detection_Message_2_4_Raw "Generic 8-byte raw payload. Detail page: https://www.isobus.net/isobus/pGNAndSPN/10483?type=PGN. Signal-level enrichment via PR welcome  see CONTRIBUTING.md.";
CM_ SG_ 2147547868 Object_Detection_Message_2_5_Raw "Generic 8-byte raw payload. Detail page: https://www.isobus.net/isobus/pGNAndSPN/10484?type=PGN. Signal-level enrichment via PR welcome  see CONTRIBUTING.md.";
CM_ SG_ 2147547869 Object_Detection_Message_2_6_Raw "Generic 8-byte raw payload. Detail page: https://www.isobus.net/isobus/pGNAndSPN/10485?type=PGN. Signal-level enrichment via PR welcome  see CONTRIBUTING.md.";
CM_ SG_ 2147547870 Object_Detection_Message_2_7_Raw "Generic 8-byte raw payload. Detail page: https://www.isobus.net/isobus/pGNAndSPN/10486?type=PGN. Signal-level enrichment via PR welcome  see CONTRIBUTING.md.";
CM_ SG_ 2147547871 Object_Detection_Message_2_8_Raw "Generic 8-byte raw payload. Detail page: https://www.isobus.net/isobus/pGNAndSPN/10487?type=PGN. Signal-level enrichment via PR welcome  see CONTRIBUTING.md.";
CM_ SG_ 2147547872 Object_Detection_Message_2_9_Raw "Generic 8-byte raw payload. Detail page: https://www.isobus.net/isobus/pGNAndSPN/10488?type=PGN. Signal-level enrichment via PR welcome  see CONTRIBUTING.md.";
CM_ SG_ 2147547873 Object_Detection_Message_2_10_Ra "Generic 8-byte raw payload. Detail page: https://www.isobus.net/isobus/pGNAndSPN/10489?type=PGN. Signal-level enrichment via PR welcome  see CONTRIBUTING.md.";
CM_ SG_ 2147547874 Object_Detection_Message_2_11_Ra "Generic 8-byte raw payload. Detail page: https://www.isobus.net/isobus/pGNAndSPN/10490?type=PGN. Signal-level enrichment via PR welcome  see CONTRIBUTING.md.";
CM_ SG_ 2147547875 Object_Detection_Message_2_12_Ra "Generic 8-byte raw payload. Detail page: https://www.isobus.net/isobus/pGNAndSPN/10491?type=PGN. Signal-level enrichment via PR welcome  see CONTRIBUTING.md.";
CM_ SG_ 2147547876 Object_Detection_Message_2_13_Ra "Generic 8-byte raw payload. Detail page: https://www.isobus.net/isobus/pGNAndSPN/10492?type=PGN. Signal-level enrichment via PR welcome  see CONTRIBUTING.md.";
CM_ SG_ 2147547877 Object_Detection_Message_2_14_Ra "Generic 8-byte raw payload. Detail page: https://www.isobus.net/isobus/pGNAndSPN/10493?type=PGN. Signal-level enrichment via PR welcome  see CONTRIBUTING.md.";
CM_ SG_ 2147547878 Object_Detection_Message_2_15_Ra "Generic 8-byte raw payload. Detail page: https://www.isobus.net/isobus/pGNAndSPN/10494?type=PGN. Signal-level enrichment via PR welcome  see CONTRIBUTING.md.";
CM_ SG_ 2147547879 Object_Detection_Message_2_16_Ra "Generic 8-byte raw payload. Detail page: https://www.isobus.net/isobus/pGNAndSPN/10495?type=PGN. Signal-level enrichment via PR welcome  see CONTRIBUTING.md.";
CM_ SG_ 2147547880 Object_Detection_Message_2_17_Ra "Generic 8-byte raw payload. Detail page: https://www.isobus.net/isobus/pGNAndSPN/10496?type=PGN. Signal-level enrichment via PR welcome  see CONTRIBUTING.md.";
CM_ SG_ 2147547881 Object_Detection_Message_2_18_Ra "Generic 8-byte raw payload. Detail page: https://www.isobus.net/isobus/pGNAndSPN/10497?type=PGN. Signal-level enrichment via PR welcome  see CONTRIBUTING.md.";

BA_DEF_ BO_ "SystemMessageLongSymbol" STRING;
BA_DEF_ SG_ "SystemSignalLongSymbol" STRING;
BA_ "SystemMessageLongSymbol" BO_ 2147547578 "VDMA_F9BA_Route_Waypoint_GPS_Coordinates";
BA_ "SystemMessageLongSymbol" BO_ 2147547580 "VDMA_F9BC_Engine_Fluid_Level_Pressure_15";
BA_ "SystemMessageLongSymbol" BO_ 2147547581 "VDMA_F9BD_Fuel_Cell_System_Coolant_Informa";
BA_ "SystemMessageLongSymbol" BO_ 2147547582 "VDMA_F9BE_Transmission_Configuration_3";
BA_ "SystemMessageLongSymbol" BO_ 2147547584 "VDMA_F9C0_Fuel_Cell_System_Voltage_Limit_C";
BA_ "SystemMessageLongSymbol" BO_ 2147547586 "VDMA_F9C2_Hydrogen_System_Information";
BA_ "SystemMessageLongSymbol" BO_ 2147547587 "VDMA_F9C3_Auxiliary_Input_Output_Status_17";
BA_ "SystemMessageLongSymbol" BO_ 2147547588 "VDMA_F9C4_Auxiliary_Input_Output_Status_16";
BA_ "SystemMessageLongSymbol" BO_ 2147547589 "VDMA_F9C5_Auxiliary_Input_Output_Status_15";
BA_ "SystemMessageLongSymbol" BO_ 2147547590 "VDMA_F9C6_Auxiliary_Input_Output_Status_14";
BA_ "SystemMessageLongSymbol" BO_ 2147547591 "VDMA_F9C7_Auxiliary_Input_Output_Status_13";
BA_ "SystemMessageLongSymbol" BO_ 2147547592 "VDMA_F9C8_Auxiliary_Input_Output_Status_12";
BA_ "SystemMessageLongSymbol" BO_ 2147547593 "VDMA_F9C9_Auxiliary_Input_Output_Status_11";
BA_ "SystemMessageLongSymbol" BO_ 2147547594 "VDMA_F9CA_Auxiliary_Input_Output_Status_10";
BA_ "SystemMessageLongSymbol" BO_ 2147547595 "VDMA_F9CB_Auxiliary_Input_Output_Status_9";
BA_ "SystemMessageLongSymbol" BO_ 2147547596 "VDMA_F9CC_Auxiliary_Input_Output_Status_8";
BA_ "SystemMessageLongSymbol" BO_ 2147547597 "VDMA_F9CD_Aftertreatment_System_Informatio";
BA_ "SystemMessageLongSymbol" BO_ 2147547604 "VDMA_F9D4_Wheel_Brake_Lining_Remaining_Inf";
BA_ "SystemMessageLongSymbol" BO_ 2147547605 "VDMA_F9D5_Wheel_Brake_Lining_Remaining_Inf";
BA_ "SystemMessageLongSymbol" BO_ 2147547606 "VDMA_F9D6_High_Voltage_Bus_Contactor_Statu";
BA_ "SystemMessageLongSymbol" BO_ 2147547607 "VDMA_F9D7_High_Voltage_Bus_Contactor_Statu";
BA_ "SystemMessageLongSymbol" BO_ 2147547608 "VDMA_F9D8_High_Voltage_Bus_Connection_Comm";
BA_ "SystemMessageLongSymbol" BO_ 2147547610 "VDMA_F9DA_Service_Needed_DTC_Information";
BA_ "SystemMessageLongSymbol" BO_ 2147547612 "VDMA_F9DC_High_Voltage_Energy_Storage_Syst";
BA_ "SystemMessageLongSymbol" BO_ 2147547613 "VDMA_F9DD_High_Voltage_Energy_Storage_Syst";
BA_ "SystemMessageLongSymbol" BO_ 2147547614 "VDMA_F9DE_High_Voltage_Energy_Storage_Syst";
BA_ "SystemMessageLongSymbol" BO_ 2147547615 "VDMA_F9DF_HVESS_Coolant_Pump_1_Status_1";
BA_ "SystemMessageLongSymbol" BO_ 2147547616 "VDMA_F9E0_HVESS_Coolant_Pump_1_Command";
BA_ "SystemMessageLongSymbol" BO_ 2147547617 "VDMA_F9E1_HVESS_Coolant_Pump_2_Status_1";
BA_ "SystemMessageLongSymbol" BO_ 2147547618 "VDMA_F9E2_HVESS_Coolant_Pump_2_Command";
BA_ "SystemMessageLongSymbol" BO_ 2147547619 "VDMA_F9E3_Hydrogen_Sensor_Information";
BA_ "SystemMessageLongSymbol" BO_ 2147547620 "VDMA_F9E4_Operator_Inducement_Information_";
BA_ "SystemMessageLongSymbol" BO_ 2147547621 "VDMA_F9E5_Operator_Inducement_Vehicle_Spee";
BA_ "SystemMessageLongSymbol" BO_ 2147547622 "VDMA_F9E6_Operator_Inducement_Vehicle_Spee";
BA_ "SystemMessageLongSymbol" BO_ 2147547623 "VDMA_F9E7_Engine_Protection_Speed_Derate_I";
BA_ "SystemMessageLongSymbol" BO_ 2147547624 "VDMA_F9E8_Engine_Protection_Torque_Derate_";
BA_ "SystemMessageLongSymbol" BO_ 2147547625 "VDMA_F9E9_Aftertreatment_System_Informatio";
BA_ "SystemMessageLongSymbol" BO_ 2147547626 "VDMA_F9EA_SAE_J2012_3_Byte_DTC_Display";
BA_ "SystemMessageLongSymbol" BO_ 2147547627 "VDMA_F9EB_High_Voltage_Energy_Storage_Syst";
BA_ "SystemMessageLongSymbol" BO_ 2147547628 "VDMA_F9EC_High_Voltage_Energy_Storage_Syst";
BA_ "SystemMessageLongSymbol" BO_ 2147547629 "VDMA_F9ED_High_Voltage_Energy_Storage_Syst";
BA_ "SystemMessageLongSymbol" BO_ 2147547630 "VDMA_F9EE_Engine_Cylinder_Average_Ignition";
BA_ "SystemMessageLongSymbol" BO_ 2147547631 "VDMA_F9EF_Engine_Cylinder_Average_Ignition";
BA_ "SystemMessageLongSymbol" BO_ 2147547632 "VDMA_F9F0_Engine_Cylinder_Average_Ignition";
BA_ "SystemMessageLongSymbol" BO_ 2147547633 "VDMA_F9F1_Engine_Cylinder_Average_Ignition";
BA_ "SystemMessageLongSymbol" BO_ 2147547634 "VDMA_F9F2_Engine_Cylinder_Average_Ignition";
BA_ "SystemMessageLongSymbol" BO_ 2147547635 "VDMA_F9F3_Engine_Indicated_Mean_Effective_";
BA_ "SystemMessageLongSymbol" BO_ 2147547636 "VDMA_F9F4_Engine_Indicated_Mean_Effective_";
BA_ "SystemMessageLongSymbol" BO_ 2147547637 "VDMA_F9F5_Engine_Indicated_Mean_Effective_";
BA_ "SystemMessageLongSymbol" BO_ 2147547638 "VDMA_F9F6_Fuel_Cell_System_Coolant_Fan_1_C";
BA_ "SystemMessageLongSymbol" BO_ 2147547639 "VDMA_F9F7_Fuel_Cell_System_Coolant_Fan_1_S";
BA_ "SystemMessageLongSymbol" BO_ 2147547640 "VDMA_F9F8_Fuel_Cell_System_Coolant_Fan_2_C";
BA_ "SystemMessageLongSymbol" BO_ 2147547641 "VDMA_F9F9_Fuel_Cell_System_Coolant_Fan_2_S";
BA_ "SystemMessageLongSymbol" BO_ 2147547642 "VDMA_F9FA_Fuel_Cell_System_Coolant_Fan_3_C";
BA_ "SystemMessageLongSymbol" BO_ 2147547643 "VDMA_F9FB_Fuel_Cell_System_Coolant_Fan_3_S";
BA_ "SystemMessageLongSymbol" BO_ 2147547644 "VDMA_F9FC_Fuel_Cell_System_Coolant_Fan_4_C";
BA_ "SystemMessageLongSymbol" BO_ 2147547645 "VDMA_F9FD_Fuel_Cell_System_Coolant_Fan_4_S";
BA_ "SystemMessageLongSymbol" BO_ 2147547647 "VDMA_F9FF_Fuel_Cell_System_Configuration";
BA_ "SystemMessageLongSymbol" BO_ 2147547648 "VDMA_FA00_Fuel_Cell_System_Coolant_Informa";
BA_ "SystemMessageLongSymbol" BO_ 2147547649 "VDMA_FA01_Fuel_Cell_System_Coolant_Informa";
BA_ "SystemMessageLongSymbol" BO_ 2147547658 "VDMA_FA0A_Motor_Generator_1_Thermal_Perfor";
BA_ "SystemMessageLongSymbol" BO_ 2147547659 "VDMA_FA0B_Motor_Generator_2_Thermal_Perfor";
BA_ "SystemMessageLongSymbol" BO_ 2147547660 "VDMA_FA0C_Motor_Generator_3_Thermal_Perfor";
BA_ "SystemMessageLongSymbol" BO_ 2147547661 "VDMA_FA0D_Motor_Generator_4_Thermal_Perfor";
BA_ "SystemMessageLongSymbol" BO_ 2147547662 "VDMA_FA0E_Motor_Generator_5_Thermal_Perfor";
BA_ "SystemMessageLongSymbol" BO_ 2147547663 "VDMA_FA0F_Motor_Generator_6_Thermal_Perfor";
BA_ "SystemMessageLongSymbol" BO_ 2147547664 "VDMA_FA10_On_Board_Programming_Event_Time_";
BA_ "SystemMessageLongSymbol" BO_ 2147547665 "VDMA_FA11_Aftertreatment_1_Light_Off_SCR_S";
BA_ "SystemMessageLongSymbol" BO_ 2147547666 "VDMA_FA12_Motor_Generator_Location_Extende";
BA_ "SystemMessageLongSymbol" BO_ 2147547667 "VDMA_FA13_Cold_Start_Emissions_Reduction_S";
BA_ "SystemMessageLongSymbol" BO_ 2147547668 "VDMA_FA14_Cold_Start_Emissions_Reduction_S";
BA_ "SystemMessageLongSymbol" BO_ 2147547669 "VDMA_FA15_Genset_Supporting_Functions";
BA_ "SystemMessageLongSymbol" BO_ 2147547670 "VDMA_FA16_High_Voltage_Energy_Storage_Syst";
BA_ "SystemMessageLongSymbol" BO_ 2147547671 "VDMA_FA17_High_Voltage_Energy_Storage_Syst";
BA_ "SystemMessageLongSymbol" BO_ 2147547672 "VDMA_FA18_High_Voltage_Energy_Storage_Syst";
BA_ "SystemMessageLongSymbol" BO_ 2147547673 "VDMA_FA19_High_Voltage_Energy_Storage_Syst";
BA_ "SystemMessageLongSymbol" BO_ 2147547674 "VDMA_FA1A_Electronic_Engine_Controller_23";
BA_ "SystemMessageLongSymbol" BO_ 2147547675 "VDMA_FA1B_Electronic_Engine_Controller_24";
BA_ "SystemMessageLongSymbol" BO_ 2147547676 "VDMA_FA1C_Electronic_Engine_Controller_25";
BA_ "SystemMessageLongSymbol" BO_ 2147547677 "VDMA_FA1D_High_Voltage_Bus_Connection_Comm";
BA_ "SystemMessageLongSymbol" BO_ 2147547678 "VDMA_FA1E_High_Voltage_Bus_Contactor_Statu";
BA_ "SystemMessageLongSymbol" BO_ 2147547679 "VDMA_FA1F_Aftertreatment_System_Informatio";
BA_ "SystemMessageLongSymbol" BO_ 2147547680 "VDMA_FA20_EV_Multi_Connection_DC_Charging_";
BA_ "SystemMessageLongSymbol" BO_ 2147547681 "VDMA_FA21_EV_Multi_Connection_Charging_In_";
BA_ "SystemMessageLongSymbol" BO_ 2147547683 "VDMA_FA23_Motor_Generator_Location_obsolet";
BA_ "SystemMessageLongSymbol" BO_ 2147547684 "VDMA_FA24_High_Voltage_Energy_Storage_Syst";
BA_ "SystemMessageLongSymbol" BO_ 2147547685 "VDMA_FA25_High_Voltage_Energy_Storage_Syst";
BA_ "SystemMessageLongSymbol" BO_ 2147547686 "VDMA_FA26_High_Voltage_Energy_Storage_Syst";
BA_ "SystemMessageLongSymbol" BO_ 2147547687 "VDMA_FA27_High_Voltage_Energy_Storage_Pack";
BA_ "SystemMessageLongSymbol" BO_ 2147547688 "VDMA_FA28_High_Voltage_Energy_Storage_Pack";
BA_ "SystemMessageLongSymbol" BO_ 2147547689 "VDMA_FA29_High_Voltage_Energy_Storage_Pack";
BA_ "SystemMessageLongSymbol" BO_ 2147547690 "VDMA_FA2A_High_Voltage_Energy_Storage_Pack";
BA_ "SystemMessageLongSymbol" BO_ 2147547691 "VDMA_FA2B_High_Voltage_Energy_Storage_Pack";
BA_ "SystemMessageLongSymbol" BO_ 2147547692 "VDMA_FA2C_High_Voltage_Energy_Storage_Pack";
BA_ "SystemMessageLongSymbol" BO_ 2147547693 "VDMA_FA2D_High_Voltage_Energy_Storage_Pack";
BA_ "SystemMessageLongSymbol" BO_ 2147547694 "VDMA_FA2E_High_Voltage_Energy_Storage_Pack";
BA_ "SystemMessageLongSymbol" BO_ 2147547695 "VDMA_FA2F_High_Voltage_Energy_Storage_Pack";
BA_ "SystemMessageLongSymbol" BO_ 2147547696 "VDMA_FA30_High_Voltage_Energy_Storage_Pack";
BA_ "SystemMessageLongSymbol" BO_ 2147547697 "VDMA_FA31_High_Voltage_Energy_Storage_Pack";
BA_ "SystemMessageLongSymbol" BO_ 2147547698 "VDMA_FA32_High_Voltage_Energy_Storage_Pack";
BA_ "SystemMessageLongSymbol" BO_ 2147547699 "VDMA_FA33_Multi_Color_Indicator_Lamp_Comma";
BA_ "SystemMessageLongSymbol" BO_ 2147547700 "VDMA_FA34_Multi_Color_Indicator_Lamp_Statu";
BA_ "SystemMessageLongSymbol" BO_ 2147547701 "VDMA_FA35_Refuse_Truck_Body_Information";
BA_ "SystemMessageLongSymbol" BO_ 2147547702 "VDMA_FA36_Engine_Fluid_Level_Pressure_14";
BA_ "SystemMessageLongSymbol" BO_ 2147547703 "VDMA_FA37_Well_Stimulation_Transmission_Co";
BA_ "SystemMessageLongSymbol" BO_ 2147547704 "VDMA_FA38_Well_Stimulation_Pump_Protection";
BA_ "SystemMessageLongSymbol" BO_ 2147547705 "VDMA_FA39_Well_Stimulation_Pump_Protection";
BA_ "SystemMessageLongSymbol" BO_ 2147547706 "VDMA_FA3A_Electric_PTO_Drive_Engagement_1";
BA_ "SystemMessageLongSymbol" BO_ 2147547707 "VDMA_FA3B_Electric_PTO_1_Information";
BA_ "SystemMessageLongSymbol" BO_ 2147547708 "VDMA_FA3C_Engine_Exhaust_O2_Sensor_Informa";
BA_ "SystemMessageLongSymbol" BO_ 2147547709 "VDMA_FA3D_Gaseous_Fuel_Supply_Pressure_3";
BA_ "SystemMessageLongSymbol" BO_ 2147547712 "VDMA_FA40_Electronic_Transmission_Controll";
BA_ "SystemMessageLongSymbol" BO_ 2147547713 "VDMA_FA41_Automated_Driving_System_Network";
BA_ "SystemMessageLongSymbol" BO_ 2147547714 "VDMA_FA42_Automated_Driving_System_Network";
BA_ "SystemMessageLongSymbol" BO_ 2147547715 "VDMA_FA43_Hybrid_or_EV_System_Inputs_2";
BA_ "SystemMessageLongSymbol" BO_ 2147547716 "VDMA_FA44_Engine_Speed_Load_Factor_Informa";
BA_ "SystemMessageLongSymbol" BO_ 2147547717 "VDMA_FA45_Generator_Trip_Energy_2";
BA_ "SystemMessageLongSymbol" BO_ 2147547718 "VDMA_FA46_Security_System_Machine_Operatio";
BA_ "SystemMessageLongSymbol" BO_ 2147547719 "VDMA_FA47_Engine_Fuel_Actuator_Service_Mod";
BA_ "SystemMessageLongSymbol" BO_ 2147547720 "VDMA_FA48_Steering_Wheel_Controls";
BA_ "SystemMessageLongSymbol" BO_ 2147547722 "VDMA_FA4A_Extended_DTC_information";
BA_ "SystemMessageLongSymbol" BO_ 2147547723 "VDMA_FA4B_Aftertreatment_2_SCR_Dosing_Syst";
BA_ "SystemMessageLongSymbol" BO_ 2147547724 "VDMA_FA4C_Aftertreatment_1_SCR_Dosing_Syst";
BA_ "SystemMessageLongSymbol" BO_ 2147547726 "VDMA_FA4E_Automated_Driving_System_Status_";
BA_ "SystemMessageLongSymbol" BO_ 2147547727 "VDMA_FA4F_Automated_Driving_System_Control";
BA_ "SystemMessageLongSymbol" BO_ 2147547731 "VDMA_FA53_Genset_Enclosure_Ventilation";
BA_ "SystemMessageLongSymbol" BO_ 2147547736 "VDMA_FA58_Engine_Exhaust_Gas_Heat_Exchange";
BA_ "SystemMessageLongSymbol" BO_ 2147547737 "VDMA_FA59_Genset_Enclosure_Ventilation_Lou";
BA_ "SystemMessageLongSymbol" BO_ 2147547738 "VDMA_FA5A_Genset_External_Coolant_System";
BA_ "SystemMessageLongSymbol" BO_ 2147547740 "VDMA_FA5C_EVSE_DC_Charging_Limits_3";
BA_ "SystemMessageLongSymbol" BO_ 2147547741 "VDMA_FA5D_EVSE_Power_Max_Schedule";
BA_ "SystemMessageLongSymbol" BO_ 2147547743 "VDMA_FA5F_EV_DC_Charging_Limits_2";
BA_ "SystemMessageLongSymbol" BO_ 2147547744 "VDMA_FA60_EV_DC_Charging_In_Progress";
BA_ "SystemMessageLongSymbol" BO_ 2147547748 "VDMA_FA64_Aftertreatment_System_Informatio";
BA_ "SystemMessageLongSymbol" BO_ 2147547749 "VDMA_FA65_Aftertreatment_System_Informatio";
BA_ "SystemMessageLongSymbol" BO_ 2147547750 "VDMA_FA66_Aftertreatment_System_Informatio";
BA_ "SystemMessageLongSymbol" BO_ 2147547752 "VDMA_FA68_Power_Converter_2_Isolation_Inte";
BA_ "SystemMessageLongSymbol" BO_ 2147547753 "VDMA_FA69_Power_Converter_1_Isolation_Inte";
BA_ "SystemMessageLongSymbol" BO_ 2147547754 "VDMA_FA6A_Power_Converter_2_Limits_Request";
BA_ "SystemMessageLongSymbol" BO_ 2147547755 "VDMA_FA6B_Power_Converter_2_Limits_Request";
BA_ "SystemMessageLongSymbol" BO_ 2147547756 "VDMA_FA6C_Power_Converter_2_Limits_Request";
BA_ "SystemMessageLongSymbol" BO_ 2147547757 "VDMA_FA6D_Power_Converter_1_Limits_Request";
BA_ "SystemMessageLongSymbol" BO_ 2147547758 "VDMA_FA6E_Power_Converter_1_Limits_Request";
BA_ "SystemMessageLongSymbol" BO_ 2147547759 "VDMA_FA6F_Power_Converter_1_Limits_Request";
BA_ "SystemMessageLongSymbol" BO_ 2147547760 "VDMA_FA70_Inverter_1_Lifetime_Data";
BA_ "SystemMessageLongSymbol" BO_ 2147547761 "VDMA_FA71_Inverter_2_Lifetime_Data";
BA_ "SystemMessageLongSymbol" BO_ 2147547762 "VDMA_FA72_Power_Converter_2_Active_Power_L";
BA_ "SystemMessageLongSymbol" BO_ 2147547763 "VDMA_FA73_Power_Converter_1_Active_Power_L";
BA_ "SystemMessageLongSymbol" BO_ 2147547764 "VDMA_FA74_Power_Converter_2_Reference_1";
BA_ "SystemMessageLongSymbol" BO_ 2147547765 "VDMA_FA75_Power_Converter_2_Reference_2";
BA_ "SystemMessageLongSymbol" BO_ 2147547766 "VDMA_FA76_Power_Converter_2_Temperature";
BA_ "SystemMessageLongSymbol" BO_ 2147547767 "VDMA_FA77_Power_Converter_1_Temperature";
BA_ "SystemMessageLongSymbol" BO_ 2147547768 "VDMA_FA78_Power_Converter_1_Reference_2";
BA_ "SystemMessageLongSymbol" BO_ 2147547769 "VDMA_FA79_Power_Converter_1_Reference_1";
BA_ "SystemMessageLongSymbol" BO_ 2147547770 "VDMA_FA7A_Power_Converter_1_Phase_Current";
BA_ "SystemMessageLongSymbol" BO_ 2147547771 "VDMA_FA7B_Power_Converter_2_Phase_Current";
BA_ "SystemMessageLongSymbol" BO_ 2147547772 "VDMA_FA7C_Power_Converter_1_Phase_Voltage";
BA_ "SystemMessageLongSymbol" BO_ 2147547773 "VDMA_FA7D_Power_Converter_2_Phase_Voltage";
BA_ "SystemMessageLongSymbol" BO_ 2147547774 "VDMA_FA7E_Power_Converter_Power_Module_Swi";
BA_ "SystemMessageLongSymbol" BO_ 2147547775 "VDMA_FA7F_Power_Converter_1_Power_Module_S";
BA_ "SystemMessageLongSymbol" BO_ 2147547776 "VDMA_FA80_Power_Converter_2_Power_Module_S";
BA_ "SystemMessageLongSymbol" BO_ 2147547777 "VDMA_FA81_Power_Converter_Totals_1";
BA_ "SystemMessageLongSymbol" BO_ 2147547778 "VDMA_FA82_Transformer_Temperatures";
BA_ "SystemMessageLongSymbol" BO_ 2147547779 "VDMA_FA83_Electrified_Accessory_Engine_Coo";
BA_ "SystemMessageLongSymbol" BO_ 2147547780 "VDMA_FA84_High_Voltage_Energy_Storage_Pack";
BA_ "SystemMessageLongSymbol" BO_ 2147547781 "VDMA_FA85_High_Voltage_Energy_Storage_Pack";
BA_ "SystemMessageLongSymbol" BO_ 2147547782 "VDMA_FA86_High_Voltage_Energy_Storage_Pack";
BA_ "SystemMessageLongSymbol" BO_ 2147547783 "VDMA_FA87_High_Voltage_Energy_Storage_Pack";
BA_ "SystemMessageLongSymbol" BO_ 2147547784 "VDMA_FA88_High_Voltage_Energy_Storage_Pack";
BA_ "SystemMessageLongSymbol" BO_ 2147547785 "VDMA_FA89_High_Voltage_Energy_Storage_Pack";
BA_ "SystemMessageLongSymbol" BO_ 2147547786 "VDMA_FA8A_High_Voltage_Energy_Storage_Pack";
BA_ "SystemMessageLongSymbol" BO_ 2147547787 "VDMA_FA8B_High_Voltage_Energy_Storage_Pack";
BA_ "SystemMessageLongSymbol" BO_ 2147547788 "VDMA_FA8C_High_Voltage_Energy_Storage_Pack";
BA_ "SystemMessageLongSymbol" BO_ 2147547789 "VDMA_FA8D_High_Voltage_Energy_Storage_Pack";
BA_ "SystemMessageLongSymbol" BO_ 2147547790 "VDMA_FA8E_High_Voltage_Energy_Storage_Pack";
BA_ "SystemMessageLongSymbol" BO_ 2147547791 "VDMA_FA8F_High_Voltage_Energy_Storage_Pack";
BA_ "SystemMessageLongSymbol" BO_ 2147547792 "VDMA_FA90_High_Voltage_Energy_Storage_Pack";
BA_ "SystemMessageLongSymbol" BO_ 2147547793 "VDMA_FA91_High_Voltage_Energy_Storage_Pack";
BA_ "SystemMessageLongSymbol" BO_ 2147547794 "VDMA_FA92_High_Voltage_Energy_Storage_Pack";
BA_ "SystemMessageLongSymbol" BO_ 2147547795 "VDMA_FA93_High_Voltage_Energy_Storage_Pack";
BA_ "SystemMessageLongSymbol" BO_ 2147547796 "VDMA_FA94_High_Voltage_Energy_Storage_Pack";
BA_ "SystemMessageLongSymbol" BO_ 2147547797 "VDMA_FA95_High_Voltage_Energy_Storage_Pack";
BA_ "SystemMessageLongSymbol" BO_ 2147547798 "VDMA_FA96_High_Voltage_Energy_Storage_Pack";
BA_ "SystemMessageLongSymbol" BO_ 2147547799 "VDMA_FA97_High_Voltage_Energy_Storage_Pack";
BA_ "SystemMessageLongSymbol" BO_ 2147547800 "VDMA_FA98_High_Voltage_Energy_Storage_Pack";
BA_ "SystemMessageLongSymbol" BO_ 2147547801 "VDMA_FA99_High_Voltage_Energy_Storage_Pack";
BA_ "SystemMessageLongSymbol" BO_ 2147547802 "VDMA_FA9A_High_Voltage_Energy_Storage_Pack";
BA_ "SystemMessageLongSymbol" BO_ 2147547803 "VDMA_FA9B_High_Voltage_Energy_Storage_Pack";
BA_ "SystemMessageLongSymbol" BO_ 2147547804 "VDMA_FA9C_High_Voltage_Energy_Storage_Pack";
BA_ "SystemMessageLongSymbol" BO_ 2147547805 "VDMA_FA9D_High_Voltage_Energy_Storage_Pack";
BA_ "SystemMessageLongSymbol" BO_ 2147547806 "VDMA_FA9E_High_Voltage_Energy_Storage_Pack";
BA_ "SystemMessageLongSymbol" BO_ 2147547807 "VDMA_FA9F_High_Voltage_Energy_Storage_Pack";
BA_ "SystemMessageLongSymbol" BO_ 2147547808 "VDMA_FAA0_High_Voltage_Energy_Storage_Pack";
BA_ "SystemMessageLongSymbol" BO_ 2147547809 "VDMA_FAA1_High_Voltage_Energy_Storage_Pack";
BA_ "SystemMessageLongSymbol" BO_ 2147547810 "VDMA_FAA2_High_Voltage_Energy_Storage_Pack";
BA_ "SystemMessageLongSymbol" BO_ 2147547811 "VDMA_FAA3_High_Voltage_Energy_Storage_Pack";
BA_ "SystemMessageLongSymbol" BO_ 2147547812 "VDMA_FAA4_Automated_Driving_System_Control";
BA_ "SystemMessageLongSymbol" BO_ 2147547817 "VDMA_FAA9_Transmission_Shaft_Twist_Informa";
BA_ "SystemMessageLongSymbol" BO_ 2147547818 "VDMA_FAAA_Electronic_Auxiliary_Transmissio";
BA_ "SystemMessageLongSymbol" BO_ 2147547819 "VDMA_FAAB_High_Voltage_Energy_Storage_Pack";
BA_ "SystemMessageLongSymbol" BO_ 2147547820 "VDMA_FAAC_High_Voltage_Energy_Storage_Pack";
BA_ "SystemMessageLongSymbol" BO_ 2147547821 "VDMA_FAAD_High_Voltage_Energy_Storage_Pack";
BA_ "SystemMessageLongSymbol" BO_ 2147547822 "VDMA_FAAE_High_Voltage_Energy_Storage_Pack";
BA_ "SystemMessageLongSymbol" BO_ 2147547823 "VDMA_FAAF_High_Voltage_Energy_Storage_Pack";
BA_ "SystemMessageLongSymbol" BO_ 2147547824 "VDMA_FAB0_High_Voltage_Energy_Storage_Pack";
BA_ "SystemMessageLongSymbol" BO_ 2147547825 "VDMA_FAB1_High_Voltage_Energy_Storage_Pack";
BA_ "SystemMessageLongSymbol" BO_ 2147547826 "VDMA_FAB2_High_Voltage_Energy_Storage_Pack";
BA_ "SystemMessageLongSymbol" BO_ 2147547827 "VDMA_FAB3_AUTOSAR_Time_Synchronization";
BA_ "SystemMessageLongSymbol" BO_ 2147547828 "VDMA_FAB4_EV_DC_Charging_Limits_1";
BA_ "SystemMessageLongSymbol" BO_ 2147547829 "VDMA_FAB5_EVSE_DC_Charging_Limits_1";
BA_ "SystemMessageLongSymbol" BO_ 2147547830 "VDMA_FAB6_EVSE_DC_Charging_Limits_2";
BA_ "SystemMessageLongSymbol" BO_ 2147547834 "VDMA_FABA_EVSE_1_Contactor_Status_1";
BA_ "SystemMessageLongSymbol" BO_ 2147547835 "VDMA_FABB_Direct_Lamp_Control_Command_3";
BA_ "SystemMessageLongSymbol" BO_ 2147547836 "VDMA_FABC_Direct_Lamp_Control_Data_3";
BA_ "SystemMessageLongSymbol" BO_ 2147547837 "VDMA_FABD_Motor_Generator_1_Lifetime_Data";
BA_ "SystemMessageLongSymbol" BO_ 2147547838 "VDMA_FABE_Motor_Generator_2_Lifetime_Data";
BA_ "SystemMessageLongSymbol" BO_ 2147547839 "VDMA_FABF_Motor_Generator_3_Lifetime_Data";
BA_ "SystemMessageLongSymbol" BO_ 2147547840 "VDMA_FAC0_Motor_Generator_4_Lifetime_Data";
BA_ "SystemMessageLongSymbol" BO_ 2147547841 "VDMA_FAC1_Motor_Generator_5_Lifetime_Data";
BA_ "SystemMessageLongSymbol" BO_ 2147547842 "VDMA_FAC2_Motor_Generator_6_Lifetime_Data";
BA_ "SystemMessageLongSymbol" BO_ 2147547846 "VDMA_FAC6_Electronic_Retarder_Controller_3";
BA_ "SystemMessageLongSymbol" BO_ 2147547848 "VDMA_FAC8_Electronic_Transmission_Controll";
BA_ "SystemMessageLongSymbol" BO_ 2147547851 "VDMA_FACB_Collision_Avoidance_System_4";
BA_ "SystemMessageLongSymbol" BO_ 2147547852 "VDMA_FACC_Collision_Avoidance_System_3";
BA_ "SystemMessageLongSymbol" BO_ 2147547853 "VDMA_FACD_Aftertreatment_1_SCR_Exhaust_Gas";
BA_ "SystemMessageLongSymbol" BO_ 2147547857 "VDMA_FAD1_Engine_Average_Information_2";
BA_ "SystemMessageLongSymbol" BO_ 2147547858 "VDMA_FAD2_Turbocharger_Information_9";
BA_ "SystemMessageLongSymbol" BO_ 2147547859 "VDMA_FAD3_Automated_Driving_System_Control";
BA_ "SystemMessageLongSymbol" BO_ 2147547863 "VDMA_FAD7_Object_Detection_Message_1_1";
BA_ "SystemMessageLongSymbol" BO_ 2147547864 "VDMA_FAD8_Object_Detection_Message_2_1";
BA_ "SystemMessageLongSymbol" BO_ 2147547865 "VDMA_FAD9_Object_Detection_Message_2_2";
BA_ "SystemMessageLongSymbol" BO_ 2147547866 "VDMA_FADA_Object_Detection_Message_2_3";
BA_ "SystemMessageLongSymbol" BO_ 2147547867 "VDMA_FADB_Object_Detection_Message_2_4";
BA_ "SystemMessageLongSymbol" BO_ 2147547868 "VDMA_FADC_Object_Detection_Message_2_5";
BA_ "SystemMessageLongSymbol" BO_ 2147547869 "VDMA_FADD_Object_Detection_Message_2_6";
BA_ "SystemMessageLongSymbol" BO_ 2147547870 "VDMA_FADE_Object_Detection_Message_2_7";
BA_ "SystemMessageLongSymbol" BO_ 2147547871 "VDMA_FADF_Object_Detection_Message_2_8";
BA_ "SystemMessageLongSymbol" BO_ 2147547872 "VDMA_FAE0_Object_Detection_Message_2_9";
BA_ "SystemMessageLongSymbol" BO_ 2147547873 "VDMA_FAE1_Object_Detection_Message_2_10";
BA_ "SystemMessageLongSymbol" BO_ 2147547874 "VDMA_FAE2_Object_Detection_Message_2_11";
BA_ "SystemMessageLongSymbol" BO_ 2147547875 "VDMA_FAE3_Object_Detection_Message_2_12";
BA_ "SystemMessageLongSymbol" BO_ 2147547876 "VDMA_FAE4_Object_Detection_Message_2_13";
BA_ "SystemMessageLongSymbol" BO_ 2147547877 "VDMA_FAE5_Object_Detection_Message_2_14";
BA_ "SystemMessageLongSymbol" BO_ 2147547878 "VDMA_FAE6_Object_Detection_Message_2_15";
BA_ "SystemMessageLongSymbol" BO_ 2147547879 "VDMA_FAE7_Object_Detection_Message_2_16";
BA_ "SystemMessageLongSymbol" BO_ 2147547880 "VDMA_FAE8_Object_Detection_Message_2_17";
BA_ "SystemMessageLongSymbol" BO_ 2147547881 "VDMA_FAE9_Object_Detection_Message_2_18";
BA_ "SystemSignalLongSymbol" SG_ 2147547577 Hydrogen_System_Status_RawPayloa "Hydrogen_System_Status_RawPayload";
BA_ "SystemSignalLongSymbol" SG_ 2147547578 Route_Waypoint_GPS_Coordinates_R "Route_Waypoint_GPS_Coordinates_RawPayload";
BA_ "SystemSignalLongSymbol" SG_ 2147547580 Engine_Fluid_Level_Pressure_15_R "Engine_Fluid_Level_Pressure_15_RawPayload";
BA_ "SystemSignalLongSymbol" SG_ 2147547581 Fuel_Cell_System_Coolant_Informa "Fuel_Cell_System_Coolant_Informa_RawPayload";
BA_ "SystemSignalLongSymbol" SG_ 2147547582 Transmission_Configuration_3_Raw "Transmission_Configuration_3_RawPayload";
BA_ "SystemSignalLongSymbol" SG_ 2147547583 Enrichment_Information_RawPayloa "Enrichment_Information_RawPayload";
BA_ "SystemSignalLongSymbol" SG_ 2147547584 Fuel_Cell_System_Voltage_Limit_C "Fuel_Cell_System_Voltage_Limit_C_RawPayload";
BA_ "SystemSignalLongSymbol" SG_ 2147547586 Hydrogen_System_Information_RawP "Hydrogen_System_Information_RawPayload";
BA_ "SystemSignalLongSymbol" SG_ 2147547587 Auxiliary_Input_Output_Status_17 "Auxiliary_Input_Output_Status_17_RawPayload";
BA_ "SystemSignalLongSymbol" SG_ 2147547588 Auxiliary_Input_Output_Status_16 "Auxiliary_Input_Output_Status_16_RawPayload";
BA_ "SystemSignalLongSymbol" SG_ 2147547589 Auxiliary_Input_Output_Status_15 "Auxiliary_Input_Output_Status_15_RawPayload";
BA_ "SystemSignalLongSymbol" SG_ 2147547590 Auxiliary_Input_Output_Status_14 "Auxiliary_Input_Output_Status_14_RawPayload";
BA_ "SystemSignalLongSymbol" SG_ 2147547591 Auxiliary_Input_Output_Status_13 "Auxiliary_Input_Output_Status_13_RawPayload";
BA_ "SystemSignalLongSymbol" SG_ 2147547592 Auxiliary_Input_Output_Status_12 "Auxiliary_Input_Output_Status_12_RawPayload";
BA_ "SystemSignalLongSymbol" SG_ 2147547593 Auxiliary_Input_Output_Status_11 "Auxiliary_Input_Output_Status_11_RawPayload";
BA_ "SystemSignalLongSymbol" SG_ 2147547594 Auxiliary_Input_Output_Status_10 "Auxiliary_Input_Output_Status_10_RawPayload";
BA_ "SystemSignalLongSymbol" SG_ 2147547595 Auxiliary_Input_Output_Status_9_ "Auxiliary_Input_Output_Status_9_RawPayload";
BA_ "SystemSignalLongSymbol" SG_ 2147547596 Auxiliary_Input_Output_Status_8_ "Auxiliary_Input_Output_Status_8_RawPayload";
BA_ "SystemSignalLongSymbol" SG_ 2147547597 Aftertreatment_System_Informatio "Aftertreatment_System_Informatio_RawPayload";
BA_ "SystemSignalLongSymbol" SG_ 2147547604 Wheel_Brake_Lining_Remaining_Inf "Wheel_Brake_Lining_Remaining_Inf_RawPayload";
BA_ "SystemSignalLongSymbol" SG_ 2147547605 Wheel_Brake_Lining_Remaining_Inf "Wheel_Brake_Lining_Remaining_Inf_RawPayload";
BA_ "SystemSignalLongSymbol" SG_ 2147547606 High_Voltage_Bus_Contactor_Statu "High_Voltage_Bus_Contactor_Statu_RawPayload";
BA_ "SystemSignalLongSymbol" SG_ 2147547607 High_Voltage_Bus_Contactor_Statu "High_Voltage_Bus_Contactor_Statu_RawPayload";
BA_ "SystemSignalLongSymbol" SG_ 2147547608 High_Voltage_Bus_Connection_Comm "High_Voltage_Bus_Connection_Comm_RawPayload";
BA_ "SystemSignalLongSymbol" SG_ 2147547610 Service_Needed_DTC_Information_R "Service_Needed_DTC_Information_RawPayload";
BA_ "SystemSignalLongSymbol" SG_ 2147547612 High_Voltage_Energy_Storage_Syst "High_Voltage_Energy_Storage_Syst_RawPayload";
BA_ "SystemSignalLongSymbol" SG_ 2147547613 High_Voltage_Energy_Storage_Syst "High_Voltage_Energy_Storage_Syst_RawPayload";
BA_ "SystemSignalLongSymbol" SG_ 2147547614 High_Voltage_Energy_Storage_Syst "High_Voltage_Energy_Storage_Syst_RawPayload";
BA_ "SystemSignalLongSymbol" SG_ 2147547615 HVESS_Coolant_Pump_1_Status_1_Ra "HVESS_Coolant_Pump_1_Status_1_RawPayload";
BA_ "SystemSignalLongSymbol" SG_ 2147547616 HVESS_Coolant_Pump_1_Command_Raw "HVESS_Coolant_Pump_1_Command_RawPayload";
BA_ "SystemSignalLongSymbol" SG_ 2147547617 HVESS_Coolant_Pump_2_Status_1_Ra "HVESS_Coolant_Pump_2_Status_1_RawPayload";
BA_ "SystemSignalLongSymbol" SG_ 2147547618 HVESS_Coolant_Pump_2_Command_Raw "HVESS_Coolant_Pump_2_Command_RawPayload";
BA_ "SystemSignalLongSymbol" SG_ 2147547619 Hydrogen_Sensor_Information_RawP "Hydrogen_Sensor_Information_RawPayload";
BA_ "SystemSignalLongSymbol" SG_ 2147547620 Operator_Inducement_Information_ "Operator_Inducement_Information__RawPayload";
BA_ "SystemSignalLongSymbol" SG_ 2147547621 Operator_Inducement_Vehicle_Spee "Operator_Inducement_Vehicle_Spee_RawPayload";
BA_ "SystemSignalLongSymbol" SG_ 2147547622 Operator_Inducement_Vehicle_Spee "Operator_Inducement_Vehicle_Spee_RawPayload";
BA_ "SystemSignalLongSymbol" SG_ 2147547623 Engine_Protection_Speed_Derate_I "Engine_Protection_Speed_Derate_I_RawPayload";
BA_ "SystemSignalLongSymbol" SG_ 2147547624 Engine_Protection_Torque_Derate_ "Engine_Protection_Torque_Derate__RawPayload";
BA_ "SystemSignalLongSymbol" SG_ 2147547625 Aftertreatment_System_Informatio "Aftertreatment_System_Informatio_RawPayload";
BA_ "SystemSignalLongSymbol" SG_ 2147547626 SAE_J2012_3_Byte_DTC_Display_Raw "SAE_J2012_3_Byte_DTC_Display_RawPayload";
BA_ "SystemSignalLongSymbol" SG_ 2147547627 High_Voltage_Energy_Storage_Syst "High_Voltage_Energy_Storage_Syst_RawPayload";
BA_ "SystemSignalLongSymbol" SG_ 2147547628 High_Voltage_Energy_Storage_Syst "High_Voltage_Energy_Storage_Syst_RawPayload";
BA_ "SystemSignalLongSymbol" SG_ 2147547629 High_Voltage_Energy_Storage_Syst "High_Voltage_Energy_Storage_Syst_RawPayload";
BA_ "SystemSignalLongSymbol" SG_ 2147547630 Engine_Cylinder_Average_Ignition "Engine_Cylinder_Average_Ignition_RawPayload";
BA_ "SystemSignalLongSymbol" SG_ 2147547631 Engine_Cylinder_Average_Ignition "Engine_Cylinder_Average_Ignition_RawPayload";
BA_ "SystemSignalLongSymbol" SG_ 2147547632 Engine_Cylinder_Average_Ignition "Engine_Cylinder_Average_Ignition_RawPayload";
BA_ "SystemSignalLongSymbol" SG_ 2147547633 Engine_Cylinder_Average_Ignition "Engine_Cylinder_Average_Ignition_RawPayload";
BA_ "SystemSignalLongSymbol" SG_ 2147547634 Engine_Cylinder_Average_Ignition "Engine_Cylinder_Average_Ignition_RawPayload";
BA_ "SystemSignalLongSymbol" SG_ 2147547635 Engine_Indicated_Mean_Effective_ "Engine_Indicated_Mean_Effective__RawPayload";
BA_ "SystemSignalLongSymbol" SG_ 2147547636 Engine_Indicated_Mean_Effective_ "Engine_Indicated_Mean_Effective__RawPayload";
BA_ "SystemSignalLongSymbol" SG_ 2147547637 Engine_Indicated_Mean_Effective_ "Engine_Indicated_Mean_Effective__RawPayload";
BA_ "SystemSignalLongSymbol" SG_ 2147547638 Fuel_Cell_System_Coolant_Fan_1_C "Fuel_Cell_System_Coolant_Fan_1_C_RawPayload";
BA_ "SystemSignalLongSymbol" SG_ 2147547639 Fuel_Cell_System_Coolant_Fan_1_S "Fuel_Cell_System_Coolant_Fan_1_S_RawPayload";
BA_ "SystemSignalLongSymbol" SG_ 2147547640 Fuel_Cell_System_Coolant_Fan_2_C "Fuel_Cell_System_Coolant_Fan_2_C_RawPayload";
BA_ "SystemSignalLongSymbol" SG_ 2147547641 Fuel_Cell_System_Coolant_Fan_2_S "Fuel_Cell_System_Coolant_Fan_2_S_RawPayload";
BA_ "SystemSignalLongSymbol" SG_ 2147547642 Fuel_Cell_System_Coolant_Fan_3_C "Fuel_Cell_System_Coolant_Fan_3_C_RawPayload";
BA_ "SystemSignalLongSymbol" SG_ 2147547643 Fuel_Cell_System_Coolant_Fan_3_S "Fuel_Cell_System_Coolant_Fan_3_S_RawPayload";
BA_ "SystemSignalLongSymbol" SG_ 2147547644 Fuel_Cell_System_Coolant_Fan_4_C "Fuel_Cell_System_Coolant_Fan_4_C_RawPayload";
BA_ "SystemSignalLongSymbol" SG_ 2147547645 Fuel_Cell_System_Coolant_Fan_4_S "Fuel_Cell_System_Coolant_Fan_4_S_RawPayload";
BA_ "SystemSignalLongSymbol" SG_ 2147547647 Fuel_Cell_System_Configuration_R "Fuel_Cell_System_Configuration_RawPayload";
BA_ "SystemSignalLongSymbol" SG_ 2147547648 Fuel_Cell_System_Coolant_Informa "Fuel_Cell_System_Coolant_Informa_RawPayload";
BA_ "SystemSignalLongSymbol" SG_ 2147547649 Fuel_Cell_System_Coolant_Informa "Fuel_Cell_System_Coolant_Informa_RawPayload";
BA_ "SystemSignalLongSymbol" SG_ 2147547658 Motor_Generator_1_Thermal_Perfor "Motor_Generator_1_Thermal_Perfor_RawPayload";
BA_ "SystemSignalLongSymbol" SG_ 2147547659 Motor_Generator_2_Thermal_Perfor "Motor_Generator_2_Thermal_Perfor_RawPayload";
BA_ "SystemSignalLongSymbol" SG_ 2147547660 Motor_Generator_3_Thermal_Perfor "Motor_Generator_3_Thermal_Perfor_RawPayload";
BA_ "SystemSignalLongSymbol" SG_ 2147547661 Motor_Generator_4_Thermal_Perfor "Motor_Generator_4_Thermal_Perfor_RawPayload";
BA_ "SystemSignalLongSymbol" SG_ 2147547662 Motor_Generator_5_Thermal_Perfor "Motor_Generator_5_Thermal_Perfor_RawPayload";
BA_ "SystemSignalLongSymbol" SG_ 2147547663 Motor_Generator_6_Thermal_Perfor "Motor_Generator_6_Thermal_Perfor_RawPayload";
BA_ "SystemSignalLongSymbol" SG_ 2147547664 On_Board_Programming_Event_Time_ "On_Board_Programming_Event_Time__RawPayload";
BA_ "SystemSignalLongSymbol" SG_ 2147547665 Aftertreatment_1_Light_Off_SCR_S "Aftertreatment_1_Light_Off_SCR_S_RawPayload";
BA_ "SystemSignalLongSymbol" SG_ 2147547666 Motor_Generator_Location_Extende "Motor_Generator_Location_Extende_RawPayload";
BA_ "SystemSignalLongSymbol" SG_ 2147547667 Cold_Start_Emissions_Reduction_S "Cold_Start_Emissions_Reduction_S_RawPayload";
BA_ "SystemSignalLongSymbol" SG_ 2147547668 Cold_Start_Emissions_Reduction_S "Cold_Start_Emissions_Reduction_S_RawPayload";
BA_ "SystemSignalLongSymbol" SG_ 2147547669 Genset_Supporting_Functions_RawP "Genset_Supporting_Functions_RawPayload";
BA_ "SystemSignalLongSymbol" SG_ 2147547670 High_Voltage_Energy_Storage_Syst "High_Voltage_Energy_Storage_Syst_RawPayload";
BA_ "SystemSignalLongSymbol" SG_ 2147547671 High_Voltage_Energy_Storage_Syst "High_Voltage_Energy_Storage_Syst_RawPayload";
BA_ "SystemSignalLongSymbol" SG_ 2147547672 High_Voltage_Energy_Storage_Syst "High_Voltage_Energy_Storage_Syst_RawPayload";
BA_ "SystemSignalLongSymbol" SG_ 2147547673 High_Voltage_Energy_Storage_Syst "High_Voltage_Energy_Storage_Syst_RawPayload";
BA_ "SystemSignalLongSymbol" SG_ 2147547674 Electronic_Engine_Controller_23_ "Electronic_Engine_Controller_23_RawPayload";
BA_ "SystemSignalLongSymbol" SG_ 2147547675 Electronic_Engine_Controller_24_ "Electronic_Engine_Controller_24_RawPayload";
BA_ "SystemSignalLongSymbol" SG_ 2147547676 Electronic_Engine_Controller_25_ "Electronic_Engine_Controller_25_RawPayload";
BA_ "SystemSignalLongSymbol" SG_ 2147547677 High_Voltage_Bus_Connection_Comm "High_Voltage_Bus_Connection_Comm_RawPayload";
BA_ "SystemSignalLongSymbol" SG_ 2147547678 High_Voltage_Bus_Contactor_Statu "High_Voltage_Bus_Contactor_Statu_RawPayload";
BA_ "SystemSignalLongSymbol" SG_ 2147547679 Aftertreatment_System_Informatio "Aftertreatment_System_Informatio_RawPayload";
BA_ "SystemSignalLongSymbol" SG_ 2147547680 EV_Multi_Connection_DC_Charging_ "EV_Multi_Connection_DC_Charging__RawPayload";
BA_ "SystemSignalLongSymbol" SG_ 2147547681 EV_Multi_Connection_Charging_In_ "EV_Multi_Connection_Charging_In__RawPayload";
BA_ "SystemSignalLongSymbol" SG_ 2147547683 Motor_Generator_Location_obsolet "Motor_Generator_Location_obsolet_RawPayload";
BA_ "SystemSignalLongSymbol" SG_ 2147547684 High_Voltage_Energy_Storage_Syst "High_Voltage_Energy_Storage_Syst_RawPayload";
BA_ "SystemSignalLongSymbol" SG_ 2147547685 High_Voltage_Energy_Storage_Syst "High_Voltage_Energy_Storage_Syst_RawPayload";
BA_ "SystemSignalLongSymbol" SG_ 2147547686 High_Voltage_Energy_Storage_Syst "High_Voltage_Energy_Storage_Syst_RawPayload";
BA_ "SystemSignalLongSymbol" SG_ 2147547687 High_Voltage_Energy_Storage_Pack "High_Voltage_Energy_Storage_Pack_RawPayload";
BA_ "SystemSignalLongSymbol" SG_ 2147547688 High_Voltage_Energy_Storage_Pack "High_Voltage_Energy_Storage_Pack_RawPayload";
BA_ "SystemSignalLongSymbol" SG_ 2147547689 High_Voltage_Energy_Storage_Pack "High_Voltage_Energy_Storage_Pack_RawPayload";
BA_ "SystemSignalLongSymbol" SG_ 2147547690 High_Voltage_Energy_Storage_Pack "High_Voltage_Energy_Storage_Pack_RawPayload";
BA_ "SystemSignalLongSymbol" SG_ 2147547691 High_Voltage_Energy_Storage_Pack "High_Voltage_Energy_Storage_Pack_RawPayload";
BA_ "SystemSignalLongSymbol" SG_ 2147547692 High_Voltage_Energy_Storage_Pack "High_Voltage_Energy_Storage_Pack_RawPayload";
BA_ "SystemSignalLongSymbol" SG_ 2147547693 High_Voltage_Energy_Storage_Pack "High_Voltage_Energy_Storage_Pack_RawPayload";
BA_ "SystemSignalLongSymbol" SG_ 2147547694 High_Voltage_Energy_Storage_Pack "High_Voltage_Energy_Storage_Pack_RawPayload";
BA_ "SystemSignalLongSymbol" SG_ 2147547695 High_Voltage_Energy_Storage_Pack "High_Voltage_Energy_Storage_Pack_RawPayload";
BA_ "SystemSignalLongSymbol" SG_ 2147547696 High_Voltage_Energy_Storage_Pack "High_Voltage_Energy_Storage_Pack_RawPayload";
BA_ "SystemSignalLongSymbol" SG_ 2147547697 High_Voltage_Energy_Storage_Pack "High_Voltage_Energy_Storage_Pack_RawPayload";
BA_ "SystemSignalLongSymbol" SG_ 2147547698 High_Voltage_Energy_Storage_Pack "High_Voltage_Energy_Storage_Pack_RawPayload";
BA_ "SystemSignalLongSymbol" SG_ 2147547699 Multi_Color_Indicator_Lamp_Comma "Multi_Color_Indicator_Lamp_Comma_RawPayload";
BA_ "SystemSignalLongSymbol" SG_ 2147547700 Multi_Color_Indicator_Lamp_Statu "Multi_Color_Indicator_Lamp_Statu_RawPayload";
BA_ "SystemSignalLongSymbol" SG_ 2147547701 Refuse_Truck_Body_Information_Ra "Refuse_Truck_Body_Information_RawPayload";
BA_ "SystemSignalLongSymbol" SG_ 2147547702 Engine_Fluid_Level_Pressure_14_R "Engine_Fluid_Level_Pressure_14_RawPayload";
BA_ "SystemSignalLongSymbol" SG_ 2147547703 Well_Stimulation_Transmission_Co "Well_Stimulation_Transmission_Co_RawPayload";
BA_ "SystemSignalLongSymbol" SG_ 2147547704 Well_Stimulation_Pump_Protection "Well_Stimulation_Pump_Protection_RawPayload";
BA_ "SystemSignalLongSymbol" SG_ 2147547705 Well_Stimulation_Pump_Protection "Well_Stimulation_Pump_Protection_RawPayload";
BA_ "SystemSignalLongSymbol" SG_ 2147547706 Electric_PTO_Drive_Engagement_1_ "Electric_PTO_Drive_Engagement_1_RawPayload";
BA_ "SystemSignalLongSymbol" SG_ 2147547707 Electric_PTO_1_Information_RawPa "Electric_PTO_1_Information_RawPayload";
BA_ "SystemSignalLongSymbol" SG_ 2147547708 Engine_Exhaust_O2_Sensor_Informa "Engine_Exhaust_O2_Sensor_Informa_RawPayload";
BA_ "SystemSignalLongSymbol" SG_ 2147547709 Gaseous_Fuel_Supply_Pressure_3_R "Gaseous_Fuel_Supply_Pressure_3_RawPayload";
BA_ "SystemSignalLongSymbol" SG_ 2147547711 Engine_Configuration_4_RawPayloa "Engine_Configuration_4_RawPayload";
BA_ "SystemSignalLongSymbol" SG_ 2147547712 Electronic_Transmission_Controll "Electronic_Transmission_Controll_RawPayload";
BA_ "SystemSignalLongSymbol" SG_ 2147547713 Automated_Driving_System_Network "Automated_Driving_System_Network_RawPayload";
BA_ "SystemSignalLongSymbol" SG_ 2147547714 Automated_Driving_System_Network "Automated_Driving_System_Network_RawPayload";
BA_ "SystemSignalLongSymbol" SG_ 2147547715 Hybrid_or_EV_System_Inputs_2_Raw "Hybrid_or_EV_System_Inputs_2_RawPayload";
BA_ "SystemSignalLongSymbol" SG_ 2147547716 Engine_Speed_Load_Factor_Informa "Engine_Speed_Load_Factor_Informa_RawPayload";
BA_ "SystemSignalLongSymbol" SG_ 2147547717 Generator_Trip_Energy_2_RawPaylo "Generator_Trip_Energy_2_RawPayload";
BA_ "SystemSignalLongSymbol" SG_ 2147547718 Security_System_Machine_Operatio "Security_System_Machine_Operatio_RawPayload";
BA_ "SystemSignalLongSymbol" SG_ 2147547719 Engine_Fuel_Actuator_Service_Mod "Engine_Fuel_Actuator_Service_Mod_RawPayload";
BA_ "SystemSignalLongSymbol" SG_ 2147547720 Steering_Wheel_Controls_RawPaylo "Steering_Wheel_Controls_RawPayload";
BA_ "SystemSignalLongSymbol" SG_ 2147547722 Extended_DTC_information_RawPayl "Extended_DTC_information_RawPayload";
BA_ "SystemSignalLongSymbol" SG_ 2147547723 Aftertreatment_2_SCR_Dosing_Syst "Aftertreatment_2_SCR_Dosing_Syst_RawPayload";
BA_ "SystemSignalLongSymbol" SG_ 2147547724 Aftertreatment_1_SCR_Dosing_Syst "Aftertreatment_1_SCR_Dosing_Syst_RawPayload";
BA_ "SystemSignalLongSymbol" SG_ 2147547725 EV_Economy_Information_RawPayloa "EV_Economy_Information_RawPayload";
BA_ "SystemSignalLongSymbol" SG_ 2147547726 Automated_Driving_System_Status_ "Automated_Driving_System_Status__RawPayload";
BA_ "SystemSignalLongSymbol" SG_ 2147547727 Automated_Driving_System_Control "Automated_Driving_System_Control_RawPayload";
BA_ "SystemSignalLongSymbol" SG_ 2147547731 Genset_Enclosure_Ventilation_Raw "Genset_Enclosure_Ventilation_RawPayload";
BA_ "SystemSignalLongSymbol" SG_ 2147547736 Engine_Exhaust_Gas_Heat_Exchange "Engine_Exhaust_Gas_Heat_Exchange_RawPayload";
BA_ "SystemSignalLongSymbol" SG_ 2147547737 Genset_Enclosure_Ventilation_Lou "Genset_Enclosure_Ventilation_Lou_RawPayload";
BA_ "SystemSignalLongSymbol" SG_ 2147547738 Genset_External_Coolant_System_R "Genset_External_Coolant_System_RawPayload";
BA_ "SystemSignalLongSymbol" SG_ 2147547740 EVSE_DC_Charging_Limits_3_RawPay "EVSE_DC_Charging_Limits_3_RawPayload";
BA_ "SystemSignalLongSymbol" SG_ 2147547741 EVSE_Power_Max_Schedule_RawPaylo "EVSE_Power_Max_Schedule_RawPayload";
BA_ "SystemSignalLongSymbol" SG_ 2147547743 EV_DC_Charging_Limits_2_RawPaylo "EV_DC_Charging_Limits_2_RawPayload";
BA_ "SystemSignalLongSymbol" SG_ 2147547744 EV_DC_Charging_In_Progress_RawPa "EV_DC_Charging_In_Progress_RawPayload";
BA_ "SystemSignalLongSymbol" SG_ 2147547748 Aftertreatment_System_Informatio "Aftertreatment_System_Informatio_RawPayload";
BA_ "SystemSignalLongSymbol" SG_ 2147547749 Aftertreatment_System_Informatio "Aftertreatment_System_Informatio_RawPayload";
BA_ "SystemSignalLongSymbol" SG_ 2147547750 Aftertreatment_System_Informatio "Aftertreatment_System_Informatio_RawPayload";
BA_ "SystemSignalLongSymbol" SG_ 2147547752 Power_Converter_2_Isolation_Inte "Power_Converter_2_Isolation_Inte_RawPayload";
BA_ "SystemSignalLongSymbol" SG_ 2147547753 Power_Converter_1_Isolation_Inte "Power_Converter_1_Isolation_Inte_RawPayload";
BA_ "SystemSignalLongSymbol" SG_ 2147547754 Power_Converter_2_Limits_Request "Power_Converter_2_Limits_Request_RawPayload";
BA_ "SystemSignalLongSymbol" SG_ 2147547755 Power_Converter_2_Limits_Request "Power_Converter_2_Limits_Request_RawPayload";
BA_ "SystemSignalLongSymbol" SG_ 2147547756 Power_Converter_2_Limits_Request "Power_Converter_2_Limits_Request_RawPayload";
BA_ "SystemSignalLongSymbol" SG_ 2147547757 Power_Converter_1_Limits_Request "Power_Converter_1_Limits_Request_RawPayload";
BA_ "SystemSignalLongSymbol" SG_ 2147547758 Power_Converter_1_Limits_Request "Power_Converter_1_Limits_Request_RawPayload";
BA_ "SystemSignalLongSymbol" SG_ 2147547759 Power_Converter_1_Limits_Request "Power_Converter_1_Limits_Request_RawPayload";
BA_ "SystemSignalLongSymbol" SG_ 2147547760 Inverter_1_Lifetime_Data_RawPayl "Inverter_1_Lifetime_Data_RawPayload";
BA_ "SystemSignalLongSymbol" SG_ 2147547761 Inverter_2_Lifetime_Data_RawPayl "Inverter_2_Lifetime_Data_RawPayload";
BA_ "SystemSignalLongSymbol" SG_ 2147547762 Power_Converter_2_Active_Power_L "Power_Converter_2_Active_Power_L_RawPayload";
BA_ "SystemSignalLongSymbol" SG_ 2147547763 Power_Converter_1_Active_Power_L "Power_Converter_1_Active_Power_L_RawPayload";
BA_ "SystemSignalLongSymbol" SG_ 2147547764 Power_Converter_2_Reference_1_Ra "Power_Converter_2_Reference_1_RawPayload";
BA_ "SystemSignalLongSymbol" SG_ 2147547765 Power_Converter_2_Reference_2_Ra "Power_Converter_2_Reference_2_RawPayload";
BA_ "SystemSignalLongSymbol" SG_ 2147547766 Power_Converter_2_Temperature_Ra "Power_Converter_2_Temperature_RawPayload";
BA_ "SystemSignalLongSymbol" SG_ 2147547767 Power_Converter_1_Temperature_Ra "Power_Converter_1_Temperature_RawPayload";
BA_ "SystemSignalLongSymbol" SG_ 2147547768 Power_Converter_1_Reference_2_Ra "Power_Converter_1_Reference_2_RawPayload";
BA_ "SystemSignalLongSymbol" SG_ 2147547769 Power_Converter_1_Reference_1_Ra "Power_Converter_1_Reference_1_RawPayload";
BA_ "SystemSignalLongSymbol" SG_ 2147547770 Power_Converter_1_Phase_Current_ "Power_Converter_1_Phase_Current_RawPayload";
BA_ "SystemSignalLongSymbol" SG_ 2147547771 Power_Converter_2_Phase_Current_ "Power_Converter_2_Phase_Current_RawPayload";
BA_ "SystemSignalLongSymbol" SG_ 2147547772 Power_Converter_1_Phase_Voltage_ "Power_Converter_1_Phase_Voltage_RawPayload";
BA_ "SystemSignalLongSymbol" SG_ 2147547773 Power_Converter_2_Phase_Voltage_ "Power_Converter_2_Phase_Voltage_RawPayload";
BA_ "SystemSignalLongSymbol" SG_ 2147547774 Power_Converter_Power_Module_Swi "Power_Converter_Power_Module_Swi_RawPayload";
BA_ "SystemSignalLongSymbol" SG_ 2147547775 Power_Converter_1_Power_Module_S "Power_Converter_1_Power_Module_S_RawPayload";
BA_ "SystemSignalLongSymbol" SG_ 2147547776 Power_Converter_2_Power_Module_S "Power_Converter_2_Power_Module_S_RawPayload";
BA_ "SystemSignalLongSymbol" SG_ 2147547777 Power_Converter_Totals_1_RawPayl "Power_Converter_Totals_1_RawPayload";
BA_ "SystemSignalLongSymbol" SG_ 2147547778 Transformer_Temperatures_RawPayl "Transformer_Temperatures_RawPayload";
BA_ "SystemSignalLongSymbol" SG_ 2147547779 Electrified_Accessory_Engine_Coo "Electrified_Accessory_Engine_Coo_RawPayload";
BA_ "SystemSignalLongSymbol" SG_ 2147547780 High_Voltage_Energy_Storage_Pack "High_Voltage_Energy_Storage_Pack_RawPayload";
BA_ "SystemSignalLongSymbol" SG_ 2147547781 High_Voltage_Energy_Storage_Pack "High_Voltage_Energy_Storage_Pack_RawPayload";
BA_ "SystemSignalLongSymbol" SG_ 2147547782 High_Voltage_Energy_Storage_Pack "High_Voltage_Energy_Storage_Pack_RawPayload";
BA_ "SystemSignalLongSymbol" SG_ 2147547783 High_Voltage_Energy_Storage_Pack "High_Voltage_Energy_Storage_Pack_RawPayload";
BA_ "SystemSignalLongSymbol" SG_ 2147547784 High_Voltage_Energy_Storage_Pack "High_Voltage_Energy_Storage_Pack_RawPayload";
BA_ "SystemSignalLongSymbol" SG_ 2147547785 High_Voltage_Energy_Storage_Pack "High_Voltage_Energy_Storage_Pack_RawPayload";
BA_ "SystemSignalLongSymbol" SG_ 2147547786 High_Voltage_Energy_Storage_Pack "High_Voltage_Energy_Storage_Pack_RawPayload";
BA_ "SystemSignalLongSymbol" SG_ 2147547787 High_Voltage_Energy_Storage_Pack "High_Voltage_Energy_Storage_Pack_RawPayload";
BA_ "SystemSignalLongSymbol" SG_ 2147547788 High_Voltage_Energy_Storage_Pack "High_Voltage_Energy_Storage_Pack_RawPayload";
BA_ "SystemSignalLongSymbol" SG_ 2147547789 High_Voltage_Energy_Storage_Pack "High_Voltage_Energy_Storage_Pack_RawPayload";
BA_ "SystemSignalLongSymbol" SG_ 2147547790 High_Voltage_Energy_Storage_Pack "High_Voltage_Energy_Storage_Pack_RawPayload";
BA_ "SystemSignalLongSymbol" SG_ 2147547791 High_Voltage_Energy_Storage_Pack "High_Voltage_Energy_Storage_Pack_RawPayload";
BA_ "SystemSignalLongSymbol" SG_ 2147547792 High_Voltage_Energy_Storage_Pack "High_Voltage_Energy_Storage_Pack_RawPayload";
BA_ "SystemSignalLongSymbol" SG_ 2147547793 High_Voltage_Energy_Storage_Pack "High_Voltage_Energy_Storage_Pack_RawPayload";
BA_ "SystemSignalLongSymbol" SG_ 2147547794 High_Voltage_Energy_Storage_Pack "High_Voltage_Energy_Storage_Pack_RawPayload";
BA_ "SystemSignalLongSymbol" SG_ 2147547795 High_Voltage_Energy_Storage_Pack "High_Voltage_Energy_Storage_Pack_RawPayload";
BA_ "SystemSignalLongSymbol" SG_ 2147547796 High_Voltage_Energy_Storage_Pack "High_Voltage_Energy_Storage_Pack_RawPayload";
BA_ "SystemSignalLongSymbol" SG_ 2147547797 High_Voltage_Energy_Storage_Pack "High_Voltage_Energy_Storage_Pack_RawPayload";
BA_ "SystemSignalLongSymbol" SG_ 2147547798 High_Voltage_Energy_Storage_Pack "High_Voltage_Energy_Storage_Pack_RawPayload";
BA_ "SystemSignalLongSymbol" SG_ 2147547799 High_Voltage_Energy_Storage_Pack "High_Voltage_Energy_Storage_Pack_RawPayload";
BA_ "SystemSignalLongSymbol" SG_ 2147547800 High_Voltage_Energy_Storage_Pack "High_Voltage_Energy_Storage_Pack_RawPayload";
BA_ "SystemSignalLongSymbol" SG_ 2147547801 High_Voltage_Energy_Storage_Pack "High_Voltage_Energy_Storage_Pack_RawPayload";
BA_ "SystemSignalLongSymbol" SG_ 2147547802 High_Voltage_Energy_Storage_Pack "High_Voltage_Energy_Storage_Pack_RawPayload";
BA_ "SystemSignalLongSymbol" SG_ 2147547803 High_Voltage_Energy_Storage_Pack "High_Voltage_Energy_Storage_Pack_RawPayload";
BA_ "SystemSignalLongSymbol" SG_ 2147547804 High_Voltage_Energy_Storage_Pack "High_Voltage_Energy_Storage_Pack_RawPayload";
BA_ "SystemSignalLongSymbol" SG_ 2147547805 High_Voltage_Energy_Storage_Pack "High_Voltage_Energy_Storage_Pack_RawPayload";
BA_ "SystemSignalLongSymbol" SG_ 2147547806 High_Voltage_Energy_Storage_Pack "High_Voltage_Energy_Storage_Pack_RawPayload";
BA_ "SystemSignalLongSymbol" SG_ 2147547807 High_Voltage_Energy_Storage_Pack "High_Voltage_Energy_Storage_Pack_RawPayload";
BA_ "SystemSignalLongSymbol" SG_ 2147547808 High_Voltage_Energy_Storage_Pack "High_Voltage_Energy_Storage_Pack_RawPayload";
BA_ "SystemSignalLongSymbol" SG_ 2147547809 High_Voltage_Energy_Storage_Pack "High_Voltage_Energy_Storage_Pack_RawPayload";
BA_ "SystemSignalLongSymbol" SG_ 2147547810 High_Voltage_Energy_Storage_Pack "High_Voltage_Energy_Storage_Pack_RawPayload";
BA_ "SystemSignalLongSymbol" SG_ 2147547811 High_Voltage_Energy_Storage_Pack "High_Voltage_Energy_Storage_Pack_RawPayload";
BA_ "SystemSignalLongSymbol" SG_ 2147547812 Automated_Driving_System_Control "Automated_Driving_System_Control_RawPayload";
BA_ "SystemSignalLongSymbol" SG_ 2147547816 Transmission_1_History_RawPayloa "Transmission_1_History_RawPayload";
BA_ "SystemSignalLongSymbol" SG_ 2147547817 Transmission_Shaft_Twist_Informa "Transmission_Shaft_Twist_Informa_RawPayload";
BA_ "SystemSignalLongSymbol" SG_ 2147547818 Electronic_Auxiliary_Transmissio "Electronic_Auxiliary_Transmissio_RawPayload";
BA_ "SystemSignalLongSymbol" SG_ 2147547819 High_Voltage_Energy_Storage_Pack "High_Voltage_Energy_Storage_Pack_RawPayload";
BA_ "SystemSignalLongSymbol" SG_ 2147547820 High_Voltage_Energy_Storage_Pack "High_Voltage_Energy_Storage_Pack_RawPayload";
BA_ "SystemSignalLongSymbol" SG_ 2147547821 High_Voltage_Energy_Storage_Pack "High_Voltage_Energy_Storage_Pack_RawPayload";
BA_ "SystemSignalLongSymbol" SG_ 2147547822 High_Voltage_Energy_Storage_Pack "High_Voltage_Energy_Storage_Pack_RawPayload";
BA_ "SystemSignalLongSymbol" SG_ 2147547823 High_Voltage_Energy_Storage_Pack "High_Voltage_Energy_Storage_Pack_RawPayload";
BA_ "SystemSignalLongSymbol" SG_ 2147547824 High_Voltage_Energy_Storage_Pack "High_Voltage_Energy_Storage_Pack_RawPayload";
BA_ "SystemSignalLongSymbol" SG_ 2147547825 High_Voltage_Energy_Storage_Pack "High_Voltage_Energy_Storage_Pack_RawPayload";
BA_ "SystemSignalLongSymbol" SG_ 2147547826 High_Voltage_Energy_Storage_Pack "High_Voltage_Energy_Storage_Pack_RawPayload";
BA_ "SystemSignalLongSymbol" SG_ 2147547827 AUTOSAR_Time_Synchronization_Raw "AUTOSAR_Time_Synchronization_RawPayload";
BA_ "SystemSignalLongSymbol" SG_ 2147547828 EV_DC_Charging_Limits_1_RawPaylo "EV_DC_Charging_Limits_1_RawPayload";
BA_ "SystemSignalLongSymbol" SG_ 2147547829 EVSE_DC_Charging_Limits_1_RawPay "EVSE_DC_Charging_Limits_1_RawPayload";
BA_ "SystemSignalLongSymbol" SG_ 2147547830 EVSE_DC_Charging_Limits_2_RawPay "EVSE_DC_Charging_Limits_2_RawPayload";
BA_ "SystemSignalLongSymbol" SG_ 2147547833 EVSE_1_Contactor_Cmd_1_RawPayloa "EVSE_1_Contactor_Cmd_1_RawPayload";
BA_ "SystemSignalLongSymbol" SG_ 2147547834 EVSE_1_Contactor_Status_1_RawPay "EVSE_1_Contactor_Status_1_RawPayload";
BA_ "SystemSignalLongSymbol" SG_ 2147547835 Direct_Lamp_Control_Command_3_Ra "Direct_Lamp_Control_Command_3_RawPayload";
BA_ "SystemSignalLongSymbol" SG_ 2147547836 Direct_Lamp_Control_Data_3_RawPa "Direct_Lamp_Control_Data_3_RawPayload";
BA_ "SystemSignalLongSymbol" SG_ 2147547837 Motor_Generator_1_Lifetime_Data_ "Motor_Generator_1_Lifetime_Data_RawPayload";
BA_ "SystemSignalLongSymbol" SG_ 2147547838 Motor_Generator_2_Lifetime_Data_ "Motor_Generator_2_Lifetime_Data_RawPayload";
BA_ "SystemSignalLongSymbol" SG_ 2147547839 Motor_Generator_3_Lifetime_Data_ "Motor_Generator_3_Lifetime_Data_RawPayload";
BA_ "SystemSignalLongSymbol" SG_ 2147547840 Motor_Generator_4_Lifetime_Data_ "Motor_Generator_4_Lifetime_Data_RawPayload";
BA_ "SystemSignalLongSymbol" SG_ 2147547841 Motor_Generator_5_Lifetime_Data_ "Motor_Generator_5_Lifetime_Data_RawPayload";
BA_ "SystemSignalLongSymbol" SG_ 2147547842 Motor_Generator_6_Lifetime_Data_ "Motor_Generator_6_Lifetime_Data_RawPayload";
BA_ "SystemSignalLongSymbol" SG_ 2147547844 EVSE_AC_Supply_Voltage_RawPayloa "EVSE_AC_Supply_Voltage_RawPayload";
BA_ "SystemSignalLongSymbol" SG_ 2147547846 Electronic_Retarder_Controller_3 "Electronic_Retarder_Controller_3_RawPayload";
BA_ "SystemSignalLongSymbol" SG_ 2147547848 Electronic_Transmission_Controll "Electronic_Transmission_Controll_RawPayload";
BA_ "SystemSignalLongSymbol" SG_ 2147547851 Collision_Avoidance_System_4_Raw "Collision_Avoidance_System_4_RawPayload";
BA_ "SystemSignalLongSymbol" SG_ 2147547852 Collision_Avoidance_System_3_Raw "Collision_Avoidance_System_3_RawPayload";
BA_ "SystemSignalLongSymbol" SG_ 2147547853 Aftertreatment_1_SCR_Exhaust_Gas "Aftertreatment_1_SCR_Exhaust_Gas_RawPayload";
BA_ "SystemSignalLongSymbol" SG_ 2147547855 EVCC_Diagnostic_Data_1_RawPayloa "EVCC_Diagnostic_Data_1_RawPayload";
BA_ "SystemSignalLongSymbol" SG_ 2147547857 Engine_Average_Information_2_Raw "Engine_Average_Information_2_RawPayload";
BA_ "SystemSignalLongSymbol" SG_ 2147547858 Turbocharger_Information_9_RawPa "Turbocharger_Information_9_RawPayload";
BA_ "SystemSignalLongSymbol" SG_ 2147547859 Automated_Driving_System_Control "Automated_Driving_System_Control_RawPayload";
BA_ "SystemSignalLongSymbol" SG_ 2147547863 Object_Detection_Message_1_1_Raw "Object_Detection_Message_1_1_RawPayload";
BA_ "SystemSignalLongSymbol" SG_ 2147547864 Object_Detection_Message_2_1_Raw "Object_Detection_Message_2_1_RawPayload";
BA_ "SystemSignalLongSymbol" SG_ 2147547865 Object_Detection_Message_2_2_Raw "Object_Detection_Message_2_2_RawPayload";
BA_ "SystemSignalLongSymbol" SG_ 2147547866 Object_Detection_Message_2_3_Raw "Object_Detection_Message_2_3_RawPayload";
BA_ "SystemSignalLongSymbol" SG_ 2147547867 Object_Detection_Message_2_4_Raw "Object_Detection_Message_2_4_RawPayload";
BA_ "SystemSignalLongSymbol" SG_ 2147547868 Object_Detection_Message_2_5_Raw "Object_Detection_Message_2_5_RawPayload";
BA_ "SystemSignalLongSymbol" SG_ 2147547869 Object_Detection_Message_2_6_Raw "Object_Detection_Message_2_6_RawPayload";
BA_ "SystemSignalLongSymbol" SG_ 2147547870 Object_Detection_Message_2_7_Raw "Object_Detection_Message_2_7_RawPayload";
BA_ "SystemSignalLongSymbol" SG_ 2147547871 Object_Detection_Message_2_8_Raw "Object_Detection_Message_2_8_RawPayload";
BA_ "SystemSignalLongSymbol" SG_ 2147547872 Object_Detection_Message_2_9_Raw "Object_Detection_Message_2_9_RawPayload";
BA_ "SystemSignalLongSymbol" SG_ 2147547873 Object_Detection_Message_2_10_Ra "Object_Detection_Message_2_10_RawPayload";
BA_ "SystemSignalLongSymbol" SG_ 2147547874 Object_Detection_Message_2_11_Ra "Object_Detection_Message_2_11_RawPayload";
BA_ "SystemSignalLongSymbol" SG_ 2147547875 Object_Detection_Message_2_12_Ra "Object_Detection_Message_2_12_RawPayload";
BA_ "SystemSignalLongSymbol" SG_ 2147547876 Object_Detection_Message_2_13_Ra "Object_Detection_Message_2_13_RawPayload";
BA_ "SystemSignalLongSymbol" SG_ 2147547877 Object_Detection_Message_2_14_Ra "Object_Detection_Message_2_14_RawPayload";
BA_ "SystemSignalLongSymbol" SG_ 2147547878 Object_Detection_Message_2_15_Ra "Object_Detection_Message_2_15_RawPayload";
BA_ "SystemSignalLongSymbol" SG_ 2147547879 Object_Detection_Message_2_16_Ra "Object_Detection_Message_2_16_RawPayload";
BA_ "SystemSignalLongSymbol" SG_ 2147547880 Object_Detection_Message_2_17_Ra "Object_Detection_Message_2_17_RawPayload";
BA_ "SystemSignalLongSymbol" SG_ 2147547881 Object_Detection_Message_2_18_Ra "Object_Detection_Message_2_18_RawPayload";
