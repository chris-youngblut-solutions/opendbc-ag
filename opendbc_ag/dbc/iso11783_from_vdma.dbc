VERSION "created by canmatrix"

NS_ :

BS_:

BU_:

BO_ 2147548683 VDMA_FE0B_Tractor_control_mode_c: 8 Vector__XXX
 SG_ Tractor_control_mode_command_Raw : 0|64@1+ (1,0) [0|18446744073709551615] "" Vector__XXX

BO_ 2147548684 VDMA_FE0C_Working_Set_Member: 8 Vector__XXX
 SG_ Working_Set_Member_RawPayload : 0|64@1+ (1,0) [0|18446744073709551615] "" Vector__XXX

BO_ 2147548686 VDMA_FE0E_Response_for_Repetitio: 8 Vector__XXX
 SG_ Response_for_Repetition_Rate_Raw : 0|64@1+ (1,0) [0|18446744073709551615] "" Vector__XXX

BO_ 2147548688 VDMA_FE10_Auxiliary_valve_0_esti: 8 Vector__XXX
 SG_ Auxiliary_valve_0_estimated_flow : 0|64@1+ (1,0) [0|18446744073709551615] "" Vector__XXX

BO_ 2147548689 VDMA_FE11_Auxiliary_valve_1_esti: 8 Vector__XXX
 SG_ Auxiliary_valve_1_estimated_flow : 0|64@1+ (1,0) [0|18446744073709551615] "" Vector__XXX

BO_ 2147548690 VDMA_FE12_Auxiliary_valve_2_esti: 8 Vector__XXX
 SG_ Auxiliary_valve_2_estimated_flow : 0|64@1+ (1,0) [0|18446744073709551615] "" Vector__XXX

BO_ 2147548691 VDMA_FE13_Auxiliary_valve_3_esti: 8 Vector__XXX
 SG_ Auxiliary_valve_3_estimated_flow : 0|64@1+ (1,0) [0|18446744073709551615] "" Vector__XXX

BO_ 2147548692 VDMA_FE14_Auxiliary_valve_4_esti: 8 Vector__XXX
 SG_ Auxiliary_valve_4_estimated_flow : 0|64@1+ (1,0) [0|18446744073709551615] "" Vector__XXX

BO_ 2147548693 VDMA_FE15_Auxiliary_valve_5_esti: 8 Vector__XXX
 SG_ Auxiliary_valve_5_estimated_flow : 0|64@1+ (1,0) [0|18446744073709551615] "" Vector__XXX

BO_ 2147548694 VDMA_FE16_Auxiliary_valve_6_esti: 8 Vector__XXX
 SG_ Auxiliary_valve_6_estimated_flow : 0|64@1+ (1,0) [0|18446744073709551615] "" Vector__XXX

BO_ 2147548695 VDMA_FE17_Auxiliary_valve_7_esti: 8 Vector__XXX
 SG_ Auxiliary_valve_7_estimated_flow : 0|64@1+ (1,0) [0|18446744073709551615] "" Vector__XXX

BO_ 2147548696 VDMA_FE18_Auxiliary_valve_8_esti: 8 Vector__XXX
 SG_ Auxiliary_valve_8_estimated_flow : 0|64@1+ (1,0) [0|18446744073709551615] "" Vector__XXX

BO_ 2147548697 VDMA_FE19_Auxiliary_valve_9_esti: 8 Vector__XXX
 SG_ Auxiliary_valve_9_estimated_flow : 0|64@1+ (1,0) [0|18446744073709551615] "" Vector__XXX

BO_ 2147548698 VDMA_FE1A_Auxiliary_valve_10_est: 8 Vector__XXX
 SG_ Auxiliary_valve_10_estimated_flo : 0|64@1+ (1,0) [0|18446744073709551615] "" Vector__XXX

BO_ 2147548699 VDMA_FE1B_Auxiliary_valve_11_est: 8 Vector__XXX
 SG_ Auxiliary_valve_11_estimated_flo : 0|64@1+ (1,0) [0|18446744073709551615] "" Vector__XXX

BO_ 2147548700 VDMA_FE1C_Auxiliary_valve_12_est: 8 Vector__XXX
 SG_ Auxiliary_valve_12_estimated_flo : 0|64@1+ (1,0) [0|18446744073709551615] "" Vector__XXX

BO_ 2147548701 VDMA_FE1D_Auxiliary_valve_13_est: 8 Vector__XXX
 SG_ Auxiliary_valve_13_estimated_flo : 0|64@1+ (1,0) [0|18446744073709551615] "" Vector__XXX

BO_ 2147548702 VDMA_FE1E_Auxiliary_valve_14_est: 8 Vector__XXX
 SG_ Auxiliary_valve_14_estimated_flo : 0|64@1+ (1,0) [0|18446744073709551615] "" Vector__XXX

BO_ 2147548703 VDMA_FE1F_Auxiliary_valve_15_est: 8 Vector__XXX
 SG_ Auxiliary_valve_15_estimated_flo : 0|64@1+ (1,0) [0|18446744073709551615] "" Vector__XXX

BO_ 2147548704 VDMA_FE20_Auxiliary_valve_0_meas: 8 Vector__XXX
 SG_ Auxiliary_valve_0_measured_flow_ : 0|64@1+ (1,0) [0|18446744073709551615] "" Vector__XXX

BO_ 2147548705 VDMA_FE21_Auxiliary_valve_1_meas: 8 Vector__XXX
 SG_ Auxiliary_valve_1_measured_flow_ : 0|64@1+ (1,0) [0|18446744073709551615] "" Vector__XXX

BO_ 2147548706 VDMA_FE22_Auxiliary_valve_2_meas: 8 Vector__XXX
 SG_ Auxiliary_valve_2_measured_flow_ : 0|64@1+ (1,0) [0|18446744073709551615] "" Vector__XXX

BO_ 2147548707 VDMA_FE23_Auxiliary_valve_3_meas: 8 Vector__XXX
 SG_ Auxiliary_valve_3_measured_flow_ : 0|64@1+ (1,0) [0|18446744073709551615] "" Vector__XXX

BO_ 2147548708 VDMA_FE24_Auxiliary_valve_4_meas: 8 Vector__XXX
 SG_ Auxiliary_valve_4_measured_flow_ : 0|64@1+ (1,0) [0|18446744073709551615] "" Vector__XXX

BO_ 2147548709 VDMA_FE25_Auxiliary_valve_5_meas: 8 Vector__XXX
 SG_ Auxiliary_valve_5_measured_flow_ : 0|64@1+ (1,0) [0|18446744073709551615] "" Vector__XXX

BO_ 2147548710 VDMA_FE26_Auxiliary_valve_6_meas: 8 Vector__XXX
 SG_ Auxiliary_valve_6_measured_flow_ : 0|64@1+ (1,0) [0|18446744073709551615] "" Vector__XXX

BO_ 2147548711 VDMA_FE27_Auxiliary_valve_7_meas: 8 Vector__XXX
 SG_ Auxiliary_valve_7_measured_flow_ : 0|64@1+ (1,0) [0|18446744073709551615] "" Vector__XXX

BO_ 2147548712 VDMA_FE28_Auxiliary_valve_8_meas: 8 Vector__XXX
 SG_ Auxiliary_valve_8_measured_flow_ : 0|64@1+ (1,0) [0|18446744073709551615] "" Vector__XXX

BO_ 2147548713 VDMA_FE29_Auxiliary_valve_9_meas: 8 Vector__XXX
 SG_ Auxiliary_valve_9_measured_flow_ : 0|64@1+ (1,0) [0|18446744073709551615] "" Vector__XXX

BO_ 2147548714 VDMA_FE2A_Auxiliary_valve_10_mea: 8 Vector__XXX
 SG_ Auxiliary_valve_10_measured_flow : 0|64@1+ (1,0) [0|18446744073709551615] "" Vector__XXX

BO_ 2147548715 VDMA_FE2B_Auxiliary_valve_11_mea: 8 Vector__XXX
 SG_ Auxiliary_valve_11_measured_flow : 0|64@1+ (1,0) [0|18446744073709551615] "" Vector__XXX

BO_ 2147548716 VDMA_FE2C_Auxiliary_valve_12_mea: 8 Vector__XXX
 SG_ Auxiliary_valve_12_measured_flow : 0|64@1+ (1,0) [0|18446744073709551615] "" Vector__XXX

BO_ 2147548717 VDMA_FE2D_Auxiliary_valve_13_mea: 8 Vector__XXX
 SG_ Auxiliary_valve_13_measured_flow : 0|64@1+ (1,0) [0|18446744073709551615] "" Vector__XXX

BO_ 2147548718 VDMA_FE2E_Auxiliary_valve_14_mea: 8 Vector__XXX
 SG_ Auxiliary_valve_14_measured_flow : 0|64@1+ (1,0) [0|18446744073709551615] "" Vector__XXX

BO_ 2147548719 VDMA_FE2F_Auxiliary_valve_15_mea: 8 Vector__XXX
 SG_ Auxiliary_valve_15_measured_flow : 0|64@1+ (1,0) [0|18446744073709551615] "" Vector__XXX

BO_ 2147548720 VDMA_FE30_Auxiliary_valve_0_comm: 8 Vector__XXX
 SG_ Auxiliary_valve_0_command_RawPay : 0|64@1+ (1,0) [0|18446744073709551615] "" Vector__XXX

BO_ 2147548721 VDMA_FE31_Auxiliary_valve_1_comm: 8 Vector__XXX
 SG_ Auxiliary_valve_1_command_RawPay : 0|64@1+ (1,0) [0|18446744073709551615] "" Vector__XXX

BO_ 2147548722 VDMA_FE32_Auxiliary_valve_2_comm: 8 Vector__XXX
 SG_ Auxiliary_valve_2_command_RawPay : 0|64@1+ (1,0) [0|18446744073709551615] "" Vector__XXX

BO_ 2147548723 VDMA_FE33_Auxiliary_valve_3_comm: 8 Vector__XXX
 SG_ Auxiliary_valve_3_command_RawPay : 0|64@1+ (1,0) [0|18446744073709551615] "" Vector__XXX

BO_ 2147548724 VDMA_FE34_Auxiliary_valve_4_comm: 8 Vector__XXX
 SG_ Auxiliary_valve_4_command_RawPay : 0|64@1+ (1,0) [0|18446744073709551615] "" Vector__XXX

BO_ 2147548725 VDMA_FE35_Auxiliary_valve_5_comm: 8 Vector__XXX
 SG_ Auxiliary_valve_5_command_RawPay : 0|64@1+ (1,0) [0|18446744073709551615] "" Vector__XXX

BO_ 2147548726 VDMA_FE36_Auxiliary_valve_6_comm: 8 Vector__XXX
 SG_ Auxiliary_valve_6_command_RawPay : 0|64@1+ (1,0) [0|18446744073709551615] "" Vector__XXX

BO_ 2147548727 VDMA_FE37_Auxiliary_valve_7_comm: 8 Vector__XXX
 SG_ Auxiliary_valve_7_command_RawPay : 0|64@1+ (1,0) [0|18446744073709551615] "" Vector__XXX

BO_ 2147548728 VDMA_FE38_Auxiliary_valve_8_comm: 8 Vector__XXX
 SG_ Auxiliary_valve_8_command_RawPay : 0|64@1+ (1,0) [0|18446744073709551615] "" Vector__XXX

BO_ 2147548729 VDMA_FE39_Auxiliary_valve_9_comm: 8 Vector__XXX
 SG_ Auxiliary_valve_9_command_RawPay : 0|64@1+ (1,0) [0|18446744073709551615] "" Vector__XXX

BO_ 2147548730 VDMA_FE3A_Auxiliary_valve_10_com: 8 Vector__XXX
 SG_ Auxiliary_valve_10_command_RawPa : 0|64@1+ (1,0) [0|18446744073709551615] "" Vector__XXX

BO_ 2147548731 VDMA_FE3B_Auxiliary_valve_11_com: 8 Vector__XXX
 SG_ Auxiliary_valve_11_command_RawPa : 0|64@1+ (1,0) [0|18446744073709551615] "" Vector__XXX

BO_ 2147548732 VDMA_FE3C_Auxiliary_valve_12_com: 8 Vector__XXX
 SG_ Auxiliary_valve_12_command_RawPa : 0|64@1+ (1,0) [0|18446744073709551615] "" Vector__XXX

BO_ 2147548733 VDMA_FE3D_Auxiliary_valve_13_com: 8 Vector__XXX
 SG_ Auxiliary_valve_13_command_RawPa : 0|64@1+ (1,0) [0|18446744073709551615] "" Vector__XXX

BO_ 2147548734 VDMA_FE3E_Auxiliary_valve_14_com: 8 Vector__XXX
 SG_ Auxiliary_valve_14_command_RawPa : 0|64@1+ (1,0) [0|18446744073709551615] "" Vector__XXX

BO_ 2147548735 VDMA_FE3F_Auxiliary_valve_15_com: 8 Vector__XXX
 SG_ Auxiliary_valve_15_command_RawPa : 0|64@1+ (1,0) [0|18446744073709551615] "" Vector__XXX

BO_ 2147548736 VDMA_FE40_Lighting_Data: 8 Vector__XXX
 SG_ Lighting_Data_RawPayload : 0|64@1+ (1,0) [0|18446744073709551615] "" Vector__XXX

BO_ 2147548737 VDMA_FE41_Lighting_command: 8 Vector__XXX
 SG_ Lighting_command_RawPayload : 0|64@1+ (1,0) [0|18446744073709551615] "" Vector__XXX

BO_ 2147548738 VDMA_FE42_Hitch_and_PTO_commands: 8 Vector__XXX
 SG_ Hitch_and_PTO_commands_RawPayloa : 0|64@1+ (1,0) [0|18446744073709551615] "" Vector__XXX

BO_ 2147548739 VDMA_FE43_Primary_or_Rear_Power_: 8 Vector__XXX
 SG_ Primary_or_Rear_Power_Take_off_O : 0|64@1+ (1,0) [0|18446744073709551615] "" Vector__XXX

BO_ 2147548740 VDMA_FE44_Secondary_or_Front_Pow: 8 Vector__XXX
 SG_ Secondary_or_Front_Power_Take_of : 0|64@1+ (1,0) [0|18446744073709551615] "" Vector__XXX

BO_ 2147548741 VDMA_FE45_Primary_or_Rear_Hitch_: 8 Vector__XXX
 SG_ Primary_or_Rear_Hitch_Status_Raw : 0|64@1+ (1,0) [0|18446744073709551615] "" Vector__XXX

BO_ 2147548742 VDMA_FE46_Secondary_or_Front_Hit: 8 Vector__XXX
 SG_ Secondary_or_Front_Hitch_Status_ : 0|64@1+ (1,0) [0|18446744073709551615] "" Vector__XXX

BO_ 2147548746 VDMA_FE4A_Electronic_Transmissio: 8 Vector__XXX
 SG_ Electronic_Transmission_Controll : 0|64@1+ (1,0) [0|18446744073709551615] "" Vector__XXX

BO_ 2147548747 VDMA_FE4B_Transmission_Configura: 8 Vector__XXX
 SG_ Transmission_Configuration_2_Raw : 0|64@1+ (1,0) [0|18446744073709551615] "" Vector__XXX

BO_ 2147548748 VDMA_FE4C_Military_Lighting_Comm: 8 Vector__XXX
 SG_ Military_Lighting_Command_RawPay : 0|64@1+ (1,0) [0|18446744073709551615] "" Vector__XXX

BO_ 2147548749 VDMA_FE4D_Total_Averaged_Informa: 8 Vector__XXX
 SG_ Total_Averaged_Information_RawPa : 0|64@1+ (1,0) [0|18446744073709551615] "" Vector__XXX

BO_ 2147548750 VDMA_FE4E_Door_Control_1: 8 Vector__XXX
 SG_ Door_Control_1_RawPayload : 0|64@1+ (1,0) [0|18446744073709551615] "" Vector__XXX

BO_ 2147548751 VDMA_FE4F_Vehicle_Dynamic_Stabil: 8 Vector__XXX
 SG_ Vehicle_Dynamic_Stability_Contro : 0|64@1+ (1,0) [0|18446744073709551615] "" Vector__XXX

BO_ 2147548752 VDMA_FE50_Battery_Temperature: 8 Vector__XXX
 SG_ Battery_Temperature_RawPayload : 0|64@1+ (1,0) [0|18446744073709551615] "" Vector__XXX

BO_ 2147548753 VDMA_FE51_Adaptive_Cruise_Contro: 8 Vector__XXX
 SG_ Adaptive_Cruise_Control_Operator : 0|64@1+ (1,0) [0|18446744073709551615] "" Vector__XXX

BO_ 2147548754 VDMA_FE52_Vehicle_Electrical_Pow: 8 Vector__XXX
 SG_ Vehicle_Electrical_Power_3_RawPa : 0|64@1+ (1,0) [0|18446744073709551615] "" Vector__XXX

BO_ 2147548755 VDMA_FE53_Retarder_Continuous_To: 8 Vector__XXX
 SG_ Retarder_Continuous_Torque_Speed : 0|64@1+ (1,0) [0|18446744073709551615] "" Vector__XXX

BO_ 2147548756 VDMA_FE54_Engine_Continuous_Torq: 8 Vector__XXX
 SG_ Engine_Continuous_Torque_Speed_L : 0|64@1+ (1,0) [0|18446744073709551615] "" Vector__XXX

BO_ 2147548757 VDMA_FE55_Gaseous_Fuel_Propertie: 8 Vector__XXX
 SG_ Gaseous_Fuel_Properties_RawPaylo : 0|64@1+ (1,0) [0|18446744073709551615] "" Vector__XXX

BO_ 2147548758 VDMA_FE56_Aftertreatment_1_Diese: 8 Vector__XXX
 SG_ Aftertreatment_1_Diesel_Exhaust_ : 0|64@1+ (1,0) [0|18446744073709551615] "" Vector__XXX

BO_ 2147548759 VDMA_FE57_Air_Suspension_Control: 8 Vector__XXX
 SG_ Air_Suspension_Control_5_RawPayl : 0|64@1+ (1,0) [0|18446744073709551615] "" Vector__XXX

BO_ 2147548760 VDMA_FE58_Air_Suspension_Control: 8 Vector__XXX
 SG_ Air_Suspension_Control_4_RawPayl : 0|64@1+ (1,0) [0|18446744073709551615] "" Vector__XXX

BO_ 2147548761 VDMA_FE59_Air_Suspension_Control: 8 Vector__XXX
 SG_ Air_Suspension_Control_3_RawPayl : 0|64@1+ (1,0) [0|18446744073709551615] "" Vector__XXX

BO_ 2147548762 VDMA_FE5A_Air_Suspension_Control: 8 Vector__XXX
 SG_ Air_Suspension_Control_1_RawPayl : 0|64@1+ (1,0) [0|18446744073709551615] "" Vector__XXX

BO_ 2147548763 VDMA_FE5B_Forward_Lane_Image_2: 8 Vector__XXX
 SG_ Forward_Lane_Image_2_RawPayload : 0|64@1+ (1,0) [0|18446744073709551615] "" Vector__XXX

BO_ 2147548764 VDMA_FE5C_Running_Gear_Equipment: 8 Vector__XXX
 SG_ Running_Gear_Equipment_2_2_RawPa : 0|64@1+ (1,0) [0|18446744073709551615] "" Vector__XXX

BO_ 2147548765 VDMA_FE5D_General_Purpose_Messag: 8 Vector__XXX
 SG_ General_Purpose_Message_1_2_RawP : 0|64@1+ (1,0) [0|18446744073709551615] "" Vector__XXX

BO_ 2147548766 VDMA_FE5E_Running_Gear_Equipment: 8 Vector__XXX
 SG_ Running_Gear_Equipment_2_3_RawPa : 0|64@1+ (1,0) [0|18446744073709551615] "" Vector__XXX

BO_ 2147548767 VDMA_FE5F_General_Purpose_Messag: 8 Vector__XXX
 SG_ General_Purpose_Message_1_3_RawP : 0|64@1+ (1,0) [0|18446744073709551615] "" Vector__XXX

BO_ 2147548768 VDMA_FE60_General_Purpose_Messag: 8 Vector__XXX
 SG_ General_Purpose_Message_2_3_RawP : 0|64@1+ (1,0) [0|18446744073709551615] "" Vector__XXX

BO_ 2147548769 VDMA_FE61_General_Purpose_Messag: 8 Vector__XXX
 SG_ General_Purpose_Message_1_4_RawP : 0|64@1+ (1,0) [0|18446744073709551615] "" Vector__XXX

BO_ 2147548770 VDMA_FE62_General_Purpose_Messag: 8 Vector__XXX
 SG_ General_Purpose_Message_2_4_RawP : 0|64@1+ (1,0) [0|18446744073709551615] "" Vector__XXX

BO_ 2147548771 VDMA_FE63_General_Purpose_Messag: 8 Vector__XXX
 SG_ General_Purpose_Message_1_5_RawP : 0|64@1+ (1,0) [0|18446744073709551615] "" Vector__XXX

BO_ 2147548772 VDMA_FE64_General_Purpose_Messag: 8 Vector__XXX
 SG_ General_Purpose_Message_2_5_RawP : 0|64@1+ (1,0) [0|18446744073709551615] "" Vector__XXX

BO_ 2147548773 VDMA_FE65_General_Purpose_Messag: 8 Vector__XXX
 SG_ General_Purpose_Message_1_6_RawP : 0|64@1+ (1,0) [0|18446744073709551615] "" Vector__XXX

BO_ 2147548774 VDMA_FE66_Battery_Main_Switch_In: 8 Vector__XXX
 SG_ Battery_Main_Switch_Information_ : 0|64@1+ (1,0) [0|18446744073709551615] "" Vector__XXX

BO_ 2147548775 VDMA_FE67_Climate_Control_Config: 8 Vector__XXX
 SG_ Climate_Control_Configuration_Ra : 0|64@1+ (1,0) [0|18446744073709551615] "" Vector__XXX

BO_ 2147548776 VDMA_FE68_Vehicle_Fluids: 8 Vector__XXX
 SG_ Vehicle_Fluids_RawPayload : 0|64@1+ (1,0) [0|18446744073709551615] "" Vector__XXX

BO_ 2147548777 VDMA_FE69_Engine_Temperature_3: 8 Vector__XXX
 SG_ Engine_Temperature_3_RawPayload : 0|64@1+ (1,0) [0|18446744073709551615] "" Vector__XXX

BO_ 2147548778 VDMA_FE6A_Engine_Fuel_Lube_Syste: 8 Vector__XXX
 SG_ Engine_Fuel_Lube_Systems_RawPayl : 0|64@1+ (1,0) [0|18446744073709551615] "" Vector__XXX

BO_ 2147548779 VDMA_FE6B_Driver_s_Identificatio: 8 Vector__XXX
 SG_ Driver_s_Identification_RawPaylo : 0|64@1+ (1,0) [0|18446744073709551615] "" Vector__XXX

BO_ 2147548780 VDMA_FE6C_Tachograph: 8 Vector__XXX
 SG_ Tachograph_RawPayload : 0|64@1+ (1,0) [0|18446744073709551615] "" Vector__XXX

BO_ 2147548781 VDMA_FE6D_Heater_Information: 8 Vector__XXX
 SG_ Heater_Information_RawPayload : 0|64@1+ (1,0) [0|18446744073709551615] "" Vector__XXX

BO_ 2147548782 VDMA_FE6E_High_Resolution_Wheel_: 8 Vector__XXX
 SG_ High_Resolution_Wheel_Speed_RawP : 0|64@1+ (1,0) [0|18446744073709551615] "" Vector__XXX

BO_ 2147548783 VDMA_FE6F_Adaptive_Cruise_Contro: 8 Vector__XXX
 SG_ Adaptive_Cruise_Control_1_RawPay : 0|64@1+ (1,0) [0|18446744073709551615] "" Vector__XXX

BO_ 2147548784 VDMA_FE70_Combination_Vehicle_We: 8 Vector__XXX
 SG_ Combination_Vehicle_Weight_RawPa : 0|64@1+ (1,0) [0|18446744073709551615] "" Vector__XXX

BO_ 2147548785 VDMA_FE71_Laser_Tracer_Position: 8 Vector__XXX
 SG_ Laser_Tracer_Position_RawPayload : 0|64@1+ (1,0) [0|18446744073709551615] "" Vector__XXX

BO_ 2147548786 VDMA_FE72_Laser_Leveling_System_: 8 Vector__XXX
 SG_ Laser_Leveling_System_Blade_Cont : 0|64@1+ (1,0) [0|18446744073709551615] "" Vector__XXX

BO_ 2147548787 VDMA_FE73_Laser_Receiver_Mast_Po: 8 Vector__XXX
 SG_ Laser_Receiver_Mast_Position_Raw : 0|64@1+ (1,0) [0|18446744073709551615] "" Vector__XXX

BO_ 2147548788 VDMA_FE74_Modify_Leveling_System: 8 Vector__XXX
 SG_ Modify_Leveling_System_Control_S : 0|64@1+ (1,0) [0|18446744073709551615] "" Vector__XXX

BO_ 2147548789 VDMA_FE75_Laser_Leveling_System_: 8 Vector__XXX
 SG_ Laser_Leveling_System_Vertical_D : 0|64@1+ (1,0) [0|18446744073709551615] "" Vector__XXX

BO_ 2147548790 VDMA_FE76_Laser_Leveling_System_: 8 Vector__XXX
 SG_ Laser_Leveling_System_Vertical_P : 0|64@1+ (1,0) [0|18446744073709551615] "" Vector__XXX

BO_ 2147548791 VDMA_FE77_Auxiliary_Pressures: 8 Vector__XXX
 SG_ Auxiliary_Pressures_RawPayload : 0|64@1+ (1,0) [0|18446744073709551615] "" Vector__XXX

BO_ 2147548792 VDMA_FE78_Tire_Pressure_Control_: 8 Vector__XXX
 SG_ Tire_Pressure_Control_Unit_Mode_ : 0|64@1+ (1,0) [0|18446744073709551615] "" Vector__XXX

BO_ 2147548793 VDMA_FE79_Tire_Pressure_Control_: 8 Vector__XXX
 SG_ Tire_Pressure_Control_Unit_Targe : 0|64@1+ (1,0) [0|18446744073709551615] "" Vector__XXX

BO_ 2147548794 VDMA_FE7A_Tire_Pressure_Control_: 8 Vector__XXX
 SG_ Tire_Pressure_Control_Unit_Curre : 0|64@1+ (1,0) [0|18446744073709551615] "" Vector__XXX

BO_ 2147548795 VDMA_FE7B_Combustion_Time_1: 8 Vector__XXX
 SG_ Combustion_Time_1_RawPayload : 0|64@1+ (1,0) [0|18446744073709551615] "" Vector__XXX

BO_ 2147548796 VDMA_FE7C_Combustion_Time_2: 8 Vector__XXX
 SG_ Combustion_Time_2_RawPayload : 0|64@1+ (1,0) [0|18446744073709551615] "" Vector__XXX

BO_ 2147548797 VDMA_FE7D_Combustion_Time_3: 8 Vector__XXX
 SG_ Combustion_Time_3_RawPayload : 0|64@1+ (1,0) [0|18446744073709551615] "" Vector__XXX

BO_ 2147548798 VDMA_FE7E_Combustion_Time_4: 8 Vector__XXX
 SG_ Combustion_Time_4_RawPayload : 0|64@1+ (1,0) [0|18446744073709551615] "" Vector__XXX

BO_ 2147548799 VDMA_FE7F_Combustion_Time_5: 8 Vector__XXX
 SG_ Combustion_Time_5_RawPayload : 0|64@1+ (1,0) [0|18446744073709551615] "" Vector__XXX

BO_ 2147548800 VDMA_FE80_Combustion_Time_6: 8 Vector__XXX
 SG_ Combustion_Time_6_RawPayload : 0|64@1+ (1,0) [0|18446744073709551615] "" Vector__XXX

BO_ 2147548801 VDMA_FE81_Fuel_Information_2_Gas: 8 Vector__XXX
 SG_ Fuel_Information_2_Gaseous_RawPa : 0|64@1+ (1,0) [0|18446744073709551615] "" Vector__XXX

BO_ 2147548802 VDMA_FE82_Ignition_Timing_1: 8 Vector__XXX
 SG_ Ignition_Timing_1_RawPayload : 0|64@1+ (1,0) [0|18446744073709551615] "" Vector__XXX

BO_ 2147548803 VDMA_FE83_Ignition_Timing_2: 8 Vector__XXX
 SG_ Ignition_Timing_2_RawPayload : 0|64@1+ (1,0) [0|18446744073709551615] "" Vector__XXX

BO_ 2147548804 VDMA_FE84_Ignition_Timing_3: 8 Vector__XXX
 SG_ Ignition_Timing_3_RawPayload : 0|64@1+ (1,0) [0|18446744073709551615] "" Vector__XXX

BO_ 2147548805 VDMA_FE85_Ignition_Timing_4: 8 Vector__XXX
 SG_ Ignition_Timing_4_RawPayload : 0|64@1+ (1,0) [0|18446744073709551615] "" Vector__XXX

BO_ 2147548806 VDMA_FE86_Ignition_Timing_5: 8 Vector__XXX
 SG_ Ignition_Timing_5_RawPayload : 0|64@1+ (1,0) [0|18446744073709551615] "" Vector__XXX

BO_ 2147548807 VDMA_FE87_Ignition_Timing_6: 8 Vector__XXX
 SG_ Ignition_Timing_6_RawPayload : 0|64@1+ (1,0) [0|18446744073709551615] "" Vector__XXX

BO_ 2147548808 VDMA_FE88_Ignition_Transformer_S: 8 Vector__XXX
 SG_ Ignition_Transformer_Secondary_O : 0|64@1+ (1,0) [0|18446744073709551615] "" Vector__XXX

BO_ 2147548809 VDMA_FE89_Ignition_Transformer_S: 8 Vector__XXX
 SG_ Ignition_Transformer_Secondary_O : 0|64@1+ (1,0) [0|18446744073709551615] "" Vector__XXX

BO_ 2147548810 VDMA_FE8A_Ignition_Transformer_S: 8 Vector__XXX
 SG_ Ignition_Transformer_Secondary_O : 0|64@1+ (1,0) [0|18446744073709551615] "" Vector__XXX

BO_ 2147548811 VDMA_FE8B_Gaseous_Fuel_Pressure_: 8 Vector__XXX
 SG_ Gaseous_Fuel_Pressure_1_RawPaylo : 0|64@1+ (1,0) [0|18446744073709551615] "" Vector__XXX

BO_ 2147548812 VDMA_FE8C_Auxiliary_Analog_Infor: 8 Vector__XXX
 SG_ Auxiliary_Analog_Information_Raw : 0|64@1+ (1,0) [0|18446744073709551615] "" Vector__XXX

BO_ 2147548813 VDMA_FE8D_Vehicle_Electrical_Pow: 8 Vector__XXX
 SG_ Vehicle_Electrical_Power_2_RawPa : 0|64@1+ (1,0) [0|18446744073709551615] "" Vector__XXX

BO_ 2147548814 VDMA_FE8E_Service_2: 8 Vector__XXX
 SG_ Service_2_RawPayload : 0|64@1+ (1,0) [0|18446744073709551615] "" Vector__XXX

BO_ 2147548815 VDMA_FE8F_Supply_Pressure_2: 8 Vector__XXX
 SG_ Supply_Pressure_2_RawPayload : 0|64@1+ (1,0) [0|18446744073709551615] "" Vector__XXX

BO_ 2147548816 VDMA_FE90_Engine_Torque_History: 8 Vector__XXX
 SG_ Engine_Torque_History_RawPayload : 0|64@1+ (1,0) [0|18446744073709551615] "" Vector__XXX

BO_ 2147548817 VDMA_FE91_Fuel_Leakage: 8 Vector__XXX
 SG_ Fuel_Leakage_RawPayload : 0|64@1+ (1,0) [0|18446744073709551615] "" Vector__XXX

BO_ 2147548818 VDMA_FE92_Engine_Information_1: 8 Vector__XXX
 SG_ Engine_Information_1_RawPayload : 0|64@1+ (1,0) [0|18446744073709551615] "" Vector__XXX

BO_ 2147548819 VDMA_FE93_Engine_Electrical_Syst: 8 Vector__XXX
 SG_ Engine_Electrical_System_Module_ : 0|64@1+ (1,0) [0|18446744073709551615] "" Vector__XXX

BO_ 2147548820 VDMA_FE94_Engine_Auxiliary_Coola: 8 Vector__XXX
 SG_ Engine_Auxiliary_Coolant_RawPayl : 0|64@1+ (1,0) [0|18446744073709551615] "" Vector__XXX

BO_ 2147548821 VDMA_FE95_Rebuild_Information: 8 Vector__XXX
 SG_ Rebuild_Information_RawPayload : 0|64@1+ (1,0) [0|18446744073709551615] "" Vector__XXX

BO_ 2147548822 VDMA_FE96_Turbocharger_Wastegate: 8 Vector__XXX
 SG_ Turbocharger_Wastegate_RawPayloa : 0|64@1+ (1,0) [0|18446744073709551615] "" Vector__XXX

BO_ 2147548823 VDMA_FE97_Turbocharger_Informati: 8 Vector__XXX
 SG_ Turbocharger_Information_5_RawPa : 0|64@1+ (1,0) [0|18446744073709551615] "" Vector__XXX

BO_ 2147548824 VDMA_FE98_Turbocharger_Informati: 8 Vector__XXX
 SG_ Turbocharger_Information_4_RawPa : 0|64@1+ (1,0) [0|18446744073709551615] "" Vector__XXX

BO_ 2147548825 VDMA_FE99_Turbocharger_Informati: 8 Vector__XXX
 SG_ Turbocharger_Information_3_RawPa : 0|64@1+ (1,0) [0|18446744073709551615] "" Vector__XXX

BO_ 2147548826 VDMA_FE9A_Turbocharger_Informati: 8 Vector__XXX
 SG_ Turbocharger_Information_2_RawPa : 0|64@1+ (1,0) [0|18446744073709551615] "" Vector__XXX

BO_ 2147548827 VDMA_FE9B_Turbocharger_Informati: 8 Vector__XXX
 SG_ Turbocharger_Information_1_RawPa : 0|64@1+ (1,0) [0|18446744073709551615] "" Vector__XXX

BO_ 2147548828 VDMA_FE9C_Main_Bearing_Temperatu: 8 Vector__XXX
 SG_ Main_Bearing_Temperature_3_RawPa : 0|64@1+ (1,0) [0|18446744073709551615] "" Vector__XXX

BO_ 2147548829 VDMA_FE9D_Main_Bearing_Temperatu: 8 Vector__XXX
 SG_ Main_Bearing_Temperature_2_RawPa : 0|64@1+ (1,0) [0|18446744073709551615] "" Vector__XXX

BO_ 2147548830 VDMA_FE9E_Main_Bearing_Temperatu: 8 Vector__XXX
 SG_ Main_Bearing_Temperature_1_RawPa : 0|64@1+ (1,0) [0|18446744073709551615] "" Vector__XXX

BO_ 2147548831 VDMA_FE9F_Exhaust_Port_Temperatu: 8 Vector__XXX
 SG_ Exhaust_Port_Temperature_5_RawPa : 0|64@1+ (1,0) [0|18446744073709551615] "" Vector__XXX

BO_ 2147548832 VDMA_FEA0_Exhaust_Port_Temperatu: 8 Vector__XXX
 SG_ Exhaust_Port_Temperature_4_RawPa : 0|64@1+ (1,0) [0|18446744073709551615] "" Vector__XXX

BO_ 2147548833 VDMA_FEA1_Exhaust_Port_Temperatu: 8 Vector__XXX
 SG_ Exhaust_Port_Temperature_3_RawPa : 0|64@1+ (1,0) [0|18446744073709551615] "" Vector__XXX

BO_ 2147548834 VDMA_FEA2_Exhaust_Port_Temperatu: 8 Vector__XXX
 SG_ Exhaust_Port_Temperature_2_RawPa : 0|64@1+ (1,0) [0|18446744073709551615] "" Vector__XXX

BO_ 2147548835 VDMA_FEA3_Exhaust_Port_Temperatu: 8 Vector__XXX
 SG_ Exhaust_Port_Temperature_1_RawPa : 0|64@1+ (1,0) [0|18446744073709551615] "" Vector__XXX

BO_ 2147548836 VDMA_FEA4_Engine_Temperature_2: 8 Vector__XXX
 SG_ Engine_Temperature_2_RawPayload : 0|64@1+ (1,0) [0|18446744073709551615] "" Vector__XXX

BO_ 2147548837 VDMA_FEA5_Intake_Manifold_Inform: 8 Vector__XXX
 SG_ Intake_Manifold_Information_2_Ra : 0|64@1+ (1,0) [0|18446744073709551615] "" Vector__XXX

BO_ 2147548838 VDMA_FEA6_Intake_Manifold_Inform: 8 Vector__XXX
 SG_ Intake_Manifold_Information_1_Ra : 0|64@1+ (1,0) [0|18446744073709551615] "" Vector__XXX

BO_ 2147548839 VDMA_FEA7_Alternator_Temperature: 8 Vector__XXX
 SG_ Alternator_Temperature_1_RawPayl : 0|64@1+ (1,0) [0|18446744073709551615] "" Vector__XXX

BO_ 2147548840 VDMA_FEA8_Articulation_Control: 8 Vector__XXX
 SG_ Articulation_Control_RawPayload : 0|64@1+ (1,0) [0|18446744073709551615] "" Vector__XXX

BO_ 2147548841 VDMA_FEA9_Exhaust_Oxygen_1: 8 Vector__XXX
 SG_ Exhaust_Oxygen_1_RawPayload : 0|64@1+ (1,0) [0|18446744073709551615] "" Vector__XXX

BO_ 2147548842 VDMA_FEAA_Alternate_Fuel_2: 8 Vector__XXX
 SG_ Alternate_Fuel_2_RawPayload : 0|64@1+ (1,0) [0|18446744073709551615] "" Vector__XXX

BO_ 2147548843 VDMA_FEAB_Electronic_Transmissio: 8 Vector__XXX
 SG_ Electronic_Transmission_Controll : 0|64@1+ (1,0) [0|18446744073709551615] "" Vector__XXX

BO_ 2147548844 VDMA_FEAC_Wheel_Brake_Lining_Rem: 8 Vector__XXX
 SG_ Wheel_Brake_Lining_Remaining_Inf : 0|64@1+ (1,0) [0|18446744073709551615] "" Vector__XXX

BO_ 2147548845 VDMA_FEAD_Wheel_Application_Pres: 8 Vector__XXX
 SG_ Wheel_Application_Pressure_High_ : 0|64@1+ (1,0) [0|18446744073709551615] "" Vector__XXX

BO_ 2147548846 VDMA_FEAE_Air_Supply_Pressure: 8 Vector__XXX
 SG_ Air_Supply_Pressure_RawPayload : 0|64@1+ (1,0) [0|18446744073709551615] "" Vector__XXX

BO_ 2147548847 VDMA_FEAF_Fuel_Consumption_Gaseo: 8 Vector__XXX
 SG_ Fuel_Consumption_Gaseous_RawPayl : 0|64@1+ (1,0) [0|18446744073709551615] "" Vector__XXX

BO_ 2147548848 VDMA_FEB0_Trip_Time_Information_: 8 Vector__XXX
 SG_ Trip_Time_Information_2_RawPaylo : 0|64@1+ (1,0) [0|18446744073709551615] "" Vector__XXX

BO_ 2147548849 VDMA_FEB1_ECU_History: 8 Vector__XXX
 SG_ ECU_History_RawPayload : 0|64@1+ (1,0) [0|18446744073709551615] "" Vector__XXX

BO_ 2147548850 VDMA_FEB2_Fuel_Information_1_Gas: 8 Vector__XXX
 SG_ Fuel_Information_1_Gaseous_RawPa : 0|64@1+ (1,0) [0|18446744073709551615] "" Vector__XXX

BO_ 2147548851 VDMA_FEB3_Fuel_Information_1_Liq: 8 Vector__XXX
 SG_ Fuel_Information_1_Liquid_RawPay : 0|64@1+ (1,0) [0|18446744073709551615] "" Vector__XXX

BO_ 2147548852 VDMA_FEB4_Trip_Time_Information_: 8 Vector__XXX
 SG_ Trip_Time_Information_1_RawPaylo : 0|64@1+ (1,0) [0|18446744073709551615] "" Vector__XXX

BO_ 2147548853 VDMA_FEB5_Trip_Shutdown_Informat: 8 Vector__XXX
 SG_ Trip_Shutdown_Information_RawPay : 0|64@1+ (1,0) [0|18446744073709551615] "" Vector__XXX

BO_ 2147548854 VDMA_FEB6_Trip_Vehicle_Speed_Cru: 8 Vector__XXX
 SG_ Trip_Vehicle_Speed_Cruise_Distan : 0|64@1+ (1,0) [0|18446744073709551615] "" Vector__XXX

BO_ 2147548855 VDMA_FEB7_Engine_Speed_Load_Fact: 8 Vector__XXX
 SG_ Engine_Speed_Load_Factor_Informa : 0|64@1+ (1,0) [0|18446744073709551615] "" Vector__XXX

BO_ 2147548856 VDMA_FEB8_Trip_Fuel_Information_: 8 Vector__XXX
 SG_ Trip_Fuel_Information_Gaseous_Ra : 0|64@1+ (1,0) [0|18446744073709551615] "" Vector__XXX

BO_ 2147548857 VDMA_FEB9_Trip_Fuel_Information_: 8 Vector__XXX
 SG_ Trip_Fuel_Information_Liquid_Raw : 0|64@1+ (1,0) [0|18446744073709551615] "" Vector__XXX

BO_ 2147548858 VDMA_FEBA_Trip_Distance_Informat: 8 Vector__XXX
 SG_ Trip_Distance_Information_RawPay : 0|64@1+ (1,0) [0|18446744073709551615] "" Vector__XXX

BO_ 2147548859 VDMA_FEBB_Trip_Fan_Information: 8 Vector__XXX
 SG_ Trip_Fan_Information_RawPayload : 0|64@1+ (1,0) [0|18446744073709551615] "" Vector__XXX

BO_ 2147548860 VDMA_FEBC_Compression_Service_Br: 8 Vector__XXX
 SG_ Compression_Service_Brake_Inform : 0|64@1+ (1,0) [0|18446744073709551615] "" Vector__XXX

BO_ 2147548861 VDMA_FEBD_Fan_Drive_1: 8 Vector__XXX
 SG_ Fan_Drive_1_RawPayload : 0|64@1+ (1,0) [0|18446744073709551615] "" Vector__XXX

BO_ 2147548862 VDMA_FEBE_Electronic_Engine_Cont: 8 Vector__XXX
 SG_ Electronic_Engine_Controller_4_R : 0|64@1+ (1,0) [0|18446744073709551615] "" Vector__XXX

BO_ 2147548863 VDMA_FEBF_Wheel_Speed_Informatio: 8 Vector__XXX
 SG_ Wheel_Speed_Information_RawPaylo : 0|64@1+ (1,0) [0|18446744073709551615] "" Vector__XXX

BO_ 2147548864 VDMA_FEC0_Service_Information: 8 Vector__XXX
 SG_ Service_Information_RawPayload : 0|64@1+ (1,0) [0|18446744073709551615] "" Vector__XXX

BO_ 2147548865 VDMA_FEC1_High_Resolution_Vehicl: 8 Vector__XXX
 SG_ High_Resolution_Vehicle_Distance : 0|64@1+ (1,0) [0|18446744073709551615] "" Vector__XXX

BO_ 2147548866 VDMA_FEC2_Electronic_Retarder_Co: 8 Vector__XXX
 SG_ Electronic_Retarder_Controller_2 : 0|64@1+ (1,0) [0|18446744073709551615] "" Vector__XXX

BO_ 2147548867 VDMA_FEC3_Electronic_Transmissio: 8 Vector__XXX
 SG_ Electronic_Transmission_Controll : 0|64@1+ (1,0) [0|18446744073709551615] "" Vector__XXX

BO_ 2147548868 VDMA_FEC4_Electronic_Brake_Syste: 8 Vector__XXX
 SG_ Electronic_Brake_System_2_2_RawP : 0|64@1+ (1,0) [0|18446744073709551615] "" Vector__XXX

BO_ 2147548869 VDMA_FEC5_Electronic_Transmissio: 8 Vector__XXX
 SG_ Electronic_Transmission_Controll : 0|64@1+ (1,0) [0|18446744073709551615] "" Vector__XXX

BO_ 2147548870 VDMA_FEC6_Electronic_Brake_Syste: 8 Vector__XXX
 SG_ Electronic_Brake_System_2_3_RawP : 0|64@1+ (1,0) [0|18446744073709551615] "" Vector__XXX

BO_ 2147548871 VDMA_FEC7_Electronic_Transmissio: 8 Vector__XXX
 SG_ Electronic_Transmission_Controll : 0|64@1+ (1,0) [0|18446744073709551615] "" Vector__XXX

BO_ 2147548872 VDMA_FEC8_General_Purpose_Messag: 8 Vector__XXX
 SG_ General_Purpose_Message_2_2_RawP : 0|64@1+ (1,0) [0|18446744073709551615] "" Vector__XXX

BO_ 2147548873 VDMA_FEC9_Electronic_Brake_Syste: 8 Vector__XXX
 SG_ Electronic_Brake_System_1_2_RawP : 0|64@1+ (1,0) [0|18446744073709551615] "" Vector__XXX

BO_ 2147548877 VDMA_FECD_Freeze_Frame_Parameter: 8 Vector__XXX
 SG_ Freeze_Frame_Parameters_RawPaylo : 0|64@1+ (1,0) [0|18446744073709551615] "" Vector__XXX

BO_ 2147548878 VDMA_FECE_Diagnostic_Readiness_1: 8 Vector__XXX
 SG_ Diagnostic_Readiness_1_RawPayloa : 0|64@1+ (1,0) [0|18446744073709551615] "" Vector__XXX

BO_ 2147548879 VDMA_FECF_Emission_Related_Pendi: 8 Vector__XXX
 SG_ Emission_Related_Pending_Diagnos : 0|64@1+ (1,0) [0|18446744073709551615] "" Vector__XXX

BO_ 2147548880 VDMA_FED0_Test_Results_for_Non_c: 8 Vector__XXX
 SG_ Test_Results_for_Non_continuousl : 0|64@1+ (1,0) [0|18446744073709551615] "" Vector__XXX

BO_ 2147548881 VDMA_FED1_Oxygen_Sensor_Test_Res: 8 Vector__XXX
 SG_ Oxygen_Sensor_Test_Results_RawPa : 0|64@1+ (1,0) [0|18446744073709551615] "" Vector__XXX

BO_ 2147548882 VDMA_FED2_Non_Continuously_Monit: 8 Vector__XXX
 SG_ Non_Continuously_Monitored_Syste : 0|64@1+ (1,0) [0|18446744073709551615] "" Vector__XXX

BO_ 2147548884 VDMA_FED4_Emission_Related_MIL_O: 8 Vector__XXX
 SG_ Emission_Related_MIL_On_Diagnost : 0|64@1+ (1,0) [0|18446744073709551615] "" Vector__XXX

BO_ 2147548885 VDMA_FED5_Alternator_Information: 8 Vector__XXX
 SG_ Alternator_Information_1_RawPayl : 0|64@1+ (1,0) [0|18446744073709551615] "" Vector__XXX

BO_ 2147548886 VDMA_FED6_Hybrid_or_EV_System_In: 8 Vector__XXX
 SG_ Hybrid_or_EV_System_Inputs_1_Raw : 0|64@1+ (1,0) [0|18446744073709551615] "" Vector__XXX

BO_ 2147548889 VDMA_FED9_Auxiliary_Input_Output: 8 Vector__XXX
 SG_ Auxiliary_Input_Output_Status_1_ : 0|64@1+ (1,0) [0|18446744073709551615] "" Vector__XXX

BO_ 2147548891 VDMA_FEDB_Engine_Fluid_Level_Pre: 8 Vector__XXX
 SG_ Engine_Fluid_Level_Pressure_2_Ra : 0|64@1+ (1,0) [0|18446744073709551615] "" Vector__XXX

BO_ 2147548892 VDMA_FEDC_Idle_Operation: 8 Vector__XXX
 SG_ Idle_Operation_RawPayload : 0|64@1+ (1,0) [0|18446744073709551615] "" Vector__XXX

BO_ 2147548893 VDMA_FEDD_Turbocharger: 8 Vector__XXX
 SG_ Turbocharger_RawPayload : 0|64@1+ (1,0) [0|18446744073709551615] "" Vector__XXX

BO_ 2147548894 VDMA_FEDE_Engine_Air_Start_Press: 8 Vector__XXX
 SG_ Engine_Air_Start_Pressure_RawPay : 0|64@1+ (1,0) [0|18446744073709551615] "" Vector__XXX

BO_ 2147548895 VDMA_FEDF_Electronic_Engine_Cont: 8 Vector__XXX
 SG_ Electronic_Engine_Controller_3_R : 0|64@1+ (1,0) [0|18446744073709551615] "" Vector__XXX

BO_ 2147548896 VDMA_FEE0_Vehicle_Distance: 8 Vector__XXX
 SG_ Vehicle_Distance_RawPayload : 0|64@1+ (1,0) [0|18446744073709551615] "" Vector__XXX

BO_ 2147548897 VDMA_FEE1_Retarder_Configuration: 8 Vector__XXX
 SG_ Retarder_Configuration_RawPayloa : 0|64@1+ (1,0) [0|18446744073709551615] "" Vector__XXX

BO_ 2147548898 VDMA_FEE2_Transmission_Configura: 8 Vector__XXX
 SG_ Transmission_Configuration_RawPa : 0|64@1+ (1,0) [0|18446744073709551615] "" Vector__XXX

BO_ 2147548899 VDMA_FEE3_Engine_Configuration_1: 8 Vector__XXX
 SG_ Engine_Configuration_1_RawPayloa : 0|64@1+ (1,0) [0|18446744073709551615] "" Vector__XXX

BO_ 2147548900 VDMA_FEE4_Shutdown: 8 Vector__XXX
 SG_ Shutdown_RawPayload : 0|64@1+ (1,0) [0|18446744073709551615] "" Vector__XXX

BO_ 2147548901 VDMA_FEE5_Engine_Hours_Revolutio: 8 Vector__XXX
 SG_ Engine_Hours_Revolutions_RawPayl : 0|64@1+ (1,0) [0|18446744073709551615] "" Vector__XXX

BO_ 2147548903 VDMA_FEE7_Vehicle_Hours: 8 Vector__XXX
 SG_ Vehicle_Hours_RawPayload : 0|64@1+ (1,0) [0|18446744073709551615] "" Vector__XXX

BO_ 2147548904 VDMA_FEE8_Vehicle_Direction_Spee: 8 Vector__XXX
 SG_ Vehicle_Direction_Speed_RawPaylo : 0|64@1+ (1,0) [0|18446744073709551615] "" Vector__XXX

BO_ 2147548905 VDMA_FEE9_Fuel_Consumption_Liqui: 8 Vector__XXX
 SG_ Fuel_Consumption_Liquid_1_RawPay : 0|64@1+ (1,0) [0|18446744073709551615] "" Vector__XXX

BO_ 2147548906 VDMA_FEEA_Vehicle_Weight: 8 Vector__XXX
 SG_ Vehicle_Weight_RawPayload : 0|64@1+ (1,0) [0|18446744073709551615] "" Vector__XXX

BO_ 2147548908 VDMA_FEEC_Vehicle_Identification: 8 Vector__XXX
 SG_ Vehicle_Identification_RawPayloa : 0|64@1+ (1,0) [0|18446744073709551615] "" Vector__XXX

BO_ 2147548909 VDMA_FEED_Cruise_Control_Vehicle: 8 Vector__XXX
 SG_ Cruise_Control_Vehicle_Speed_Set : 0|64@1+ (1,0) [0|18446744073709551615] "" Vector__XXX

BO_ 2147548910 VDMA_FEEE_Engine_Temperature_1: 8 Vector__XXX
 SG_ Engine_Temperature_1_RawPayload : 0|64@1+ (1,0) [0|18446744073709551615] "" Vector__XXX

BO_ 2147548911 VDMA_FEEF_Engine_Fluid_Level_Pre: 8 Vector__XXX
 SG_ Engine_Fluid_Level_Pressure_1_Ra : 0|64@1+ (1,0) [0|18446744073709551615] "" Vector__XXX

BO_ 2147548912 VDMA_FEF0_Power_Takeoff_Informat: 8 Vector__XXX
 SG_ Power_Takeoff_Information_1_RawP : 0|64@1+ (1,0) [0|18446744073709551615] "" Vector__XXX

BO_ 2147548913 VDMA_FEF1_Cruise_Control_Vehicle: 8 Vector__XXX
 SG_ Cruise_Control_Vehicle_Speed_1_R : 0|64@1+ (1,0) [0|18446744073709551615] "" Vector__XXX

BO_ 2147548914 VDMA_FEF2_Fuel_Economy_Liquid: 8 Vector__XXX
 SG_ Fuel_Economy_Liquid_RawPayload : 0|64@1+ (1,0) [0|18446744073709551615] "" Vector__XXX

BO_ 2147548915 VDMA_FEF3_Vehicle_Position_1: 8 Vector__XXX
 SG_ Vehicle_Position_1_RawPayload : 0|64@1+ (1,0) [0|18446744073709551615] "" Vector__XXX

BO_ 2147548916 VDMA_FEF4_Tire_Condition_Message: 8 Vector__XXX
 SG_ Tire_Condition_Message_1_RawPayl : 0|64@1+ (1,0) [0|18446744073709551615] "" Vector__XXX

BO_ 2147548917 VDMA_FEF5_Ambient_Conditions: 8 Vector__XXX
 SG_ Ambient_Conditions_RawPayload : 0|64@1+ (1,0) [0|18446744073709551615] "" Vector__XXX

BO_ 2147548918 VDMA_FEF6_Intake_Exhaust_Conditi: 8 Vector__XXX
 SG_ Intake_Exhaust_Conditions_1_RawP : 0|64@1+ (1,0) [0|18446744073709551615] "" Vector__XXX

BO_ 2147548919 VDMA_FEF7_Vehicle_Electrical_Pow: 8 Vector__XXX
 SG_ Vehicle_Electrical_Power_1_RawPa : 0|64@1+ (1,0) [0|18446744073709551615] "" Vector__XXX

BO_ 2147548920 VDMA_FEF8_Transmission_Fluids_1: 8 Vector__XXX
 SG_ Transmission_Fluids_1_RawPayload : 0|64@1+ (1,0) [0|18446744073709551615] "" Vector__XXX

BO_ 2147548921 VDMA_FEF9_Axle_Information: 8 Vector__XXX
 SG_ Axle_Information_RawPayload : 0|64@1+ (1,0) [0|18446744073709551615] "" Vector__XXX

BO_ 2147548922 VDMA_FEFA_Brakes_1: 8 Vector__XXX
 SG_ Brakes_1_RawPayload : 0|64@1+ (1,0) [0|18446744073709551615] "" Vector__XXX

BO_ 2147548923 VDMA_FEFB_Retarder_fluids: 8 Vector__XXX
 SG_ Retarder_fluids_RawPayload : 0|64@1+ (1,0) [0|18446744073709551615] "" Vector__XXX

BO_ 2147548924 VDMA_FEFC_Dash_Display_1: 8 Vector__XXX
 SG_ Dash_Display_1_RawPayload : 0|64@1+ (1,0) [0|18446744073709551615] "" Vector__XXX

BO_ 2147548925 VDMA_FEFD_Alternate_Fuel_1: 8 Vector__XXX
 SG_ Alternate_Fuel_1_RawPayload : 0|64@1+ (1,0) [0|18446744073709551615] "" Vector__XXX

BO_ 2147548926 VDMA_FEFE_Auxiliary_Water_Pump_P: 8 Vector__XXX
 SG_ Auxiliary_Water_Pump_Pressure_Ra : 0|64@1+ (1,0) [0|18446744073709551615] "" Vector__XXX

BO_ 2147548927 VDMA_FEFF_Operator_indicators: 8 Vector__XXX
 SG_ Operator_indicators_RawPayload : 0|64@1+ (1,0) [0|18446744073709551615] "" Vector__XXX

BO_ 2147609856 VDMA_1ED00_NMEA_Request_Command_: 8 Vector__XXX
 SG_ NMEA_Request_Command_Acknowledge : 0|64@1+ (1,0) [0|18446744073709551615] "" Vector__XXX

BO_ 2147610112 VDMA_1EE00_PGN_List_Transmit_Rec: 8 Vector__XXX
 SG_ PGN_List_Transmit_Receive_PGN_s_ : 0|64@1+ (1,0) [0|18446744073709551615] "" Vector__XXX

BO_ 2147610368 VDMA_1EF00_Proprietary_A2: 8 Vector__XXX
 SG_ Proprietary_A2_RawPayload : 0|64@1+ (1,0) [0|18446744073709551615] "" Vector__XXX

BO_ 2147610631 VDMA_1F007_Alert: 8 Vector__XXX
 SG_ Alert_RawPayload : 0|64@1+ (1,0) [0|18446744073709551615] "" Vector__XXX

BO_ 2147610632 VDMA_1F008_Alert_Response: 8 Vector__XXX
 SG_ Alert_Response_RawPayload : 0|64@1+ (1,0) [0|18446744073709551615] "" Vector__XXX

BO_ 2147610633 VDMA_1F009_Alert_Text: 8 Vector__XXX
 SG_ Alert_Text_RawPayload : 0|64@1+ (1,0) [0|18446744073709551615] "" Vector__XXX

BO_ 2147610634 VDMA_1F00A_Alert_Configuration: 8 Vector__XXX
 SG_ Alert_Configuration_RawPayload : 0|64@1+ (1,0) [0|18446744073709551615] "" Vector__XXX

BO_ 2147610635 VDMA_1F00B_Alert_Threshold: 8 Vector__XXX
 SG_ Alert_Threshold_RawPayload : 0|64@1+ (1,0) [0|18446744073709551615] "" Vector__XXX

BO_ 2147610636 VDMA_1F00C_Alert_Value: 8 Vector__XXX
 SG_ Alert_Value_RawPayload : 0|64@1+ (1,0) [0|18446744073709551615] "" Vector__XXX

BO_ 2147610640 VDMA_1F010_System_Time: 8 Vector__XXX
 SG_ System_Time_RawPayload : 0|64@1+ (1,0) [0|18446744073709551615] "" Vector__XXX

BO_ 2147610641 VDMA_1F011_Heartbeat: 8 Vector__XXX
 SG_ Heartbeat_RawPayload : 0|64@1+ (1,0) [0|18446744073709551615] "" Vector__XXX

BO_ 2147610644 VDMA_1F014_Product_Information: 8 Vector__XXX
 SG_ Product_Information_RawPayload : 0|64@1+ (1,0) [0|18446744073709551615] "" Vector__XXX

BO_ 2147610646 VDMA_1F016_Configuration_Informa: 8 Vector__XXX
 SG_ Configuration_Information_RawPay : 0|64@1+ (1,0) [0|18446744073709551615] "" Vector__XXX

BO_ 2147610649 VDMA_1F019_Cyclic_Alert_List_IEC: 8 Vector__XXX
 SG_ Cyclic_Alert_List_IEC_61924_2_Ra : 0|64@1+ (1,0) [0|18446744073709551615] "" Vector__XXX

BO_ 2147610650 VDMA_1F01A_Responsibility_Transf: 8 Vector__XXX
 SG_ Responsibility_Transfer_Function : 0|64@1+ (1,0) [0|18446744073709551615] "" Vector__XXX

BO_ 2147610881 VDMA_1F101_Man_Overboard_Notific: 8 Vector__XXX
 SG_ Man_Overboard_Notification_MOB_R : 0|64@1+ (1,0) [0|18446744073709551615] "" Vector__XXX

BO_ 2147610885 VDMA_1F105_Heading_Track_Control: 8 Vector__XXX
 SG_ Heading_Track_Control_RawPayload : 0|64@1+ (1,0) [0|18446744073709551615] "" Vector__XXX

BO_ 2147610893 VDMA_1F10D_Rudder: 8 Vector__XXX
 SG_ Rudder_RawPayload : 0|64@1+ (1,0) [0|18446744073709551615] "" Vector__XXX

BO_ 2147610900 VDMA_1F114_Heave: 8 Vector__XXX
 SG_ Heave_RawPayload : 0|64@1+ (1,0) [0|18446744073709551615] "" Vector__XXX

BO_ 2147610905 VDMA_1F119_Attitude: 8 Vector__XXX
 SG_ Attitude_RawPayload : 0|64@1+ (1,0) [0|18446744073709551615] "" Vector__XXX

BO_ 2147610906 VDMA_1F11A_Magnetic_Variation: 8 Vector__XXX
 SG_ Magnetic_Variation_RawPayload : 0|64@1+ (1,0) [0|18446744073709551615] "" Vector__XXX

BO_ 2147611136 VDMA_1F200_Engine_Parameters_Rap: 8 Vector__XXX
 SG_ Engine_Parameters_Rapid_Update_R : 0|64@1+ (1,0) [0|18446744073709551615] "" Vector__XXX

BO_ 2147611137 VDMA_1F201_Engine_Parameters_Dyn: 8 Vector__XXX
 SG_ Engine_Parameters_Dynamic_RawPay : 0|64@1+ (1,0) [0|18446744073709551615] "" Vector__XXX

BO_ 2147611138 VDMA_1F202_Electric_Drive_Status: 8 Vector__XXX
 SG_ Electric_Drive_Status_Dynamic_Ra : 0|64@1+ (1,0) [0|18446744073709551615] "" Vector__XXX

BO_ 2147611139 VDMA_1F203_Electric_Energy_Stora: 8 Vector__XXX
 SG_ Electric_Energy_Storage_Status_D : 0|64@1+ (1,0) [0|18446744073709551615] "" Vector__XXX

BO_ 2147611141 VDMA_1F205_Transmission_Paramete: 8 Vector__XXX
 SG_ Transmission_Parameters_Dynamic_ : 0|64@1+ (1,0) [0|18446744073709551615] "" Vector__XXX

BO_ 2147611142 VDMA_1F206_Electric_Drive_Inform: 8 Vector__XXX
 SG_ Electric_Drive_Information_RawPa : 0|64@1+ (1,0) [0|18446744073709551615] "" Vector__XXX

BO_ 2147611143 VDMA_1F207_Electric_Energy_Stora: 8 Vector__XXX
 SG_ Electric_Energy_Storage_Informat : 0|64@1+ (1,0) [0|18446744073709551615] "" Vector__XXX

BO_ 2147611144 VDMA_1F208_Trip_Parameters_Vesse: 8 Vector__XXX
 SG_ Trip_Parameters_Vessel_RawPayloa : 0|64@1+ (1,0) [0|18446744073709551615] "" Vector__XXX

BO_ 2147611145 VDMA_1F209_Trip_Parameters_Small: 8 Vector__XXX
 SG_ Trip_Parameters_Small_Craft_RawP : 0|64@1+ (1,0) [0|18446744073709551615] "" Vector__XXX

BO_ 2147611146 VDMA_1F20A_Engine_Parameters_Sta: 8 Vector__XXX
 SG_ Engine_Parameters_Static_RawPayl : 0|64@1+ (1,0) [0|18446744073709551615] "" Vector__XXX

BO_ 2147611148 VDMA_1F20C_Load_Controller_Conne: 8 Vector__XXX
 SG_ Load_Controller_Connection_State : 0|64@1+ (1,0) [0|18446744073709551615] "" Vector__XXX

BO_ 2147611149 VDMA_1F20D_Binary_Switch_Bank_St: 8 Vector__XXX
 SG_ Binary_Switch_Bank_Status_RawPay : 0|64@1+ (1,0) [0|18446744073709551615] "" Vector__XXX

BO_ 2147611150 VDMA_1F20E_Switch_Bank_Control: 8 Vector__XXX
 SG_ Switch_Bank_Control_RawPayload : 0|64@1+ (1,0) [0|18446744073709551615] "" Vector__XXX

BO_ 2147611151 VDMA_1F20F_AC_Input_Status: 8 Vector__XXX
 SG_ AC_Input_Status_RawPayload : 0|64@1+ (1,0) [0|18446744073709551615] "" Vector__XXX

BO_ 2147611152 VDMA_1F210_AC_Output_Status: 8 Vector__XXX
 SG_ AC_Output_Status_RawPayload : 0|64@1+ (1,0) [0|18446744073709551615] "" Vector__XXX

BO_ 2147611153 VDMA_1F211_Fluid_Level: 8 Vector__XXX
 SG_ Fluid_Level_RawPayload : 0|64@1+ (1,0) [0|18446744073709551615] "" Vector__XXX

BO_ 2147611154 VDMA_1F212_DC_Detailed_Status: 8 Vector__XXX
 SG_ DC_Detailed_Status_RawPayload : 0|64@1+ (1,0) [0|18446744073709551615] "" Vector__XXX

BO_ 2147611155 VDMA_1F213_Charger_Status: 8 Vector__XXX
 SG_ Charger_Status_RawPayload : 0|64@1+ (1,0) [0|18446744073709551615] "" Vector__XXX

BO_ 2147611156 VDMA_1F214_Battery_Status: 8 Vector__XXX
 SG_ Battery_Status_RawPayload : 0|64@1+ (1,0) [0|18446744073709551615] "" Vector__XXX

BO_ 2147611157 VDMA_1F215_Inverter_Status: 8 Vector__XXX
 SG_ Inverter_Status_RawPayload : 0|64@1+ (1,0) [0|18446744073709551615] "" Vector__XXX

BO_ 2147611158 VDMA_1F216_Charger_Configuration: 8 Vector__XXX
 SG_ Charger_Configuration_Status_Raw : 0|64@1+ (1,0) [0|18446744073709551615] "" Vector__XXX

BO_ 2147611159 VDMA_1F217_Inverter_Configuratio: 8 Vector__XXX
 SG_ Inverter_Configuration_Status_Ra : 0|64@1+ (1,0) [0|18446744073709551615] "" Vector__XXX

BO_ 2147611160 VDMA_1F218_AGS_Configuration_Sta: 8 Vector__XXX
 SG_ AGS_Configuration_Status_RawPayl : 0|64@1+ (1,0) [0|18446744073709551615] "" Vector__XXX

BO_ 2147611161 VDMA_1F219_Battery_Configuration: 8 Vector__XXX
 SG_ Battery_Configuration_Status_Raw : 0|64@1+ (1,0) [0|18446744073709551615] "" Vector__XXX

BO_ 2147611162 VDMA_1F21A_AGS_Status: 8 Vector__XXX
 SG_ AGS_Status_RawPayload : 0|64@1+ (1,0) [0|18446744073709551615] "" Vector__XXX

BO_ 2147611392 VDMA_1F300_AC_Power_Current_Phas: 8 Vector__XXX
 SG_ AC_Power_Current_Phase_A_RawPayl : 0|64@1+ (1,0) [0|18446744073709551615] "" Vector__XXX

BO_ 2147611393 VDMA_1F301_AC_Power_Current_Phas: 8 Vector__XXX
 SG_ AC_Power_Current_Phase_B_RawPayl : 0|64@1+ (1,0) [0|18446744073709551615] "" Vector__XXX

BO_ 2147611394 VDMA_1F302_AC_Power_Current_Phas: 8 Vector__XXX
 SG_ AC_Power_Current_Phase_C_RawPayl : 0|64@1+ (1,0) [0|18446744073709551615] "" Vector__XXX

BO_ 2147611395 VDMA_1F303_AC_Voltage_Frequency_: 8 Vector__XXX
 SG_ AC_Voltage_Frequency_Phase_A_Raw : 0|64@1+ (1,0) [0|18446744073709551615] "" Vector__XXX

BO_ 2147611396 VDMA_1F304_AC_Voltage_Frequency_: 8 Vector__XXX
 SG_ AC_Voltage_Frequency_Phase_B_Raw : 0|64@1+ (1,0) [0|18446744073709551615] "" Vector__XXX

BO_ 2147611397 VDMA_1F305_AC_Voltage_Frequency_: 8 Vector__XXX
 SG_ AC_Voltage_Frequency_Phase_C_Raw : 0|64@1+ (1,0) [0|18446744073709551615] "" Vector__XXX

BO_ 2147611398 VDMA_1F306_Converter_Inverter_Ch: 8 Vector__XXX
 SG_ Converter_Inverter_Charger_Statu : 0|64@1+ (1,0) [0|18446744073709551615] "" Vector__XXX

BO_ 2147611399 VDMA_1F307_DC_Voltage_Current: 8 Vector__XXX
 SG_ DC_Voltage_Current_RawPayload : 0|64@1+ (1,0) [0|18446744073709551615] "" Vector__XXX

BO_ 2147611648 VDMA_1F400_Nautical_Leeway_Angle: 8 Vector__XXX
 SG_ Nautical_Leeway_Angle_RawPayload : 0|64@1+ (1,0) [0|18446744073709551615] "" Vector__XXX

BO_ 2147611649 VDMA_1F401_Vessel_Acceleration: 8 Vector__XXX
 SG_ Vessel_Acceleration_RawPayload : 0|64@1+ (1,0) [0|18446744073709551615] "" Vector__XXX

BO_ 2147611650 VDMA_1F402_Electric_Drive_Status: 8 Vector__XXX
 SG_ Electric_Drive_Status_Rapid_Upda : 0|64@1+ (1,0) [0|18446744073709551615] "" Vector__XXX

BO_ 2147611651 VDMA_1F403_Electric_Energy_Stora: 8 Vector__XXX
 SG_ Electric_Energy_Storage_Status_R : 0|64@1+ (1,0) [0|18446744073709551615] "" Vector__XXX

BO_ 2147611654 VDMA_1F406_Thruster_Control_Stat: 8 Vector__XXX
 SG_ Thruster_Control_Status_RawPaylo : 0|64@1+ (1,0) [0|18446744073709551615] "" Vector__XXX

BO_ 2147611655 VDMA_1F407_Thruster_Information: 8 Vector__XXX
 SG_ Thruster_Information_RawPayload : 0|64@1+ (1,0) [0|18446744073709551615] "" Vector__XXX

BO_ 2147611656 VDMA_1F408_Thruster_Motor_Status: 8 Vector__XXX
 SG_ Thruster_Motor_Status_RawPayload : 0|64@1+ (1,0) [0|18446744073709551615] "" Vector__XXX

BO_ 2147611907 VDMA_1F503_Speed: 8 Vector__XXX
 SG_ Speed_RawPayload : 0|64@1+ (1,0) [0|18446744073709551615] "" Vector__XXX

BO_ 2147611915 VDMA_1F50B_Water_Depth: 8 Vector__XXX
 SG_ Water_Depth_RawPayload : 0|64@1+ (1,0) [0|18446744073709551615] "" Vector__XXX

BO_ 2147611923 VDMA_1F513_Distance_Log: 8 Vector__XXX
 SG_ Distance_Log_RawPayload : 0|64@1+ (1,0) [0|18446744073709551615] "" Vector__XXX

BO_ 2147612168 VDMA_1F608_Tracked_Target_Data: 8 Vector__XXX
 SG_ Tracked_Target_Data_RawPayload : 0|64@1+ (1,0) [0|18446744073709551615] "" Vector__XXX

BO_ 2147612186 VDMA_1F61A_Elevator_Car_Status: 8 Vector__XXX
 SG_ Elevator_Car_Status_RawPayload : 0|64@1+ (1,0) [0|18446744073709551615] "" Vector__XXX

BO_ 2147612416 VDMA_1F700_Elevator_Motor_Contro: 8 Vector__XXX
 SG_ Elevator_Motor_Control_RawPayloa : 0|64@1+ (1,0) [0|18446744073709551615] "" Vector__XXX

BO_ 2147612417 VDMA_1F701_Elevator_Deck_Push_Bu: 8 Vector__XXX
 SG_ Elevator_Deck_Push_Button_RawPay : 0|64@1+ (1,0) [0|18446744073709551615] "" Vector__XXX

BO_ 2147612424 VDMA_1F708_Windlass_Control_Stat: 8 Vector__XXX
 SG_ Windlass_Control_Status_RawPaylo : 0|64@1+ (1,0) [0|18446744073709551615] "" Vector__XXX

BO_ 2147612425 VDMA_1F709_Anchor_Windlass_Opera: 8 Vector__XXX
 SG_ Anchor_Windlass_Operating_Status : 0|64@1+ (1,0) [0|18446744073709551615] "" Vector__XXX

BO_ 2147612426 VDMA_1F70A_Anchor_Windlass_Monit: 8 Vector__XXX
 SG_ Anchor_Windlass_Monitoring_Statu : 0|64@1+ (1,0) [0|18446744073709551615] "" Vector__XXX

BO_ 2147612428 VDMA_1F70C_Linear_Actuator_Contr: 8 Vector__XXX
 SG_ Linear_Actuator_Control_Status_R : 0|64@1+ (1,0) [0|18446744073709551615] "" Vector__XXX

BO_ 2147612676 VDMA_1F804_Altitude_Delta_High_P: 8 Vector__XXX
 SG_ Altitude_Delta_High_Precision_Ra : 0|64@1+ (1,0) [0|18446744073709551615] "" Vector__XXX

CM_ BO_ 2147548683  "Source: isobus.net VDMA Data Dictionary (https://www.isobus.net/isobus/pGNAndSPN/15831?type=PGN)";
CM_ BO_ 2147548684  "Source: isobus.net VDMA Data Dictionary (https://www.isobus.net/isobus/pGNAndSPN/15832?type=PGN)";
CM_ BO_ 2147548686  "Source: isobus.net VDMA Data Dictionary (https://www.isobus.net/isobus/pGNAndSPN/15835?type=PGN)";
CM_ BO_ 2147548688  "Source: isobus.net VDMA Data Dictionary (https://www.isobus.net/isobus/pGNAndSPN/15855?type=PGN)";
CM_ BO_ 2147548689  "Source: isobus.net VDMA Data Dictionary (https://www.isobus.net/isobus/pGNAndSPN/15862?type=PGN)";
CM_ BO_ 2147548690  "Source: isobus.net VDMA Data Dictionary (https://www.isobus.net/isobus/pGNAndSPN/15869?type=PGN)";
CM_ BO_ 2147548691  "Source: isobus.net VDMA Data Dictionary (https://www.isobus.net/isobus/pGNAndSPN/15876?type=PGN)";
CM_ BO_ 2147548692  "Source: isobus.net VDMA Data Dictionary (https://www.isobus.net/isobus/pGNAndSPN/15883?type=PGN)";
CM_ BO_ 2147548693  "Source: isobus.net VDMA Data Dictionary (https://www.isobus.net/isobus/pGNAndSPN/15890?type=PGN)";
CM_ BO_ 2147548694  "Source: isobus.net VDMA Data Dictionary (https://www.isobus.net/isobus/pGNAndSPN/15897?type=PGN)";
CM_ BO_ 2147548695  "Source: isobus.net VDMA Data Dictionary (https://www.isobus.net/isobus/pGNAndSPN/15904?type=PGN)";
CM_ BO_ 2147548696  "Source: isobus.net VDMA Data Dictionary (https://www.isobus.net/isobus/pGNAndSPN/15911?type=PGN)";
CM_ BO_ 2147548697  "Source: isobus.net VDMA Data Dictionary (https://www.isobus.net/isobus/pGNAndSPN/15918?type=PGN)";
CM_ BO_ 2147548698  "Source: isobus.net VDMA Data Dictionary (https://www.isobus.net/isobus/pGNAndSPN/15925?type=PGN)";
CM_ BO_ 2147548699  "Source: isobus.net VDMA Data Dictionary (https://www.isobus.net/isobus/pGNAndSPN/15932?type=PGN)";
CM_ BO_ 2147548700  "Source: isobus.net VDMA Data Dictionary (https://www.isobus.net/isobus/pGNAndSPN/15939?type=PGN)";
CM_ BO_ 2147548701  "Source: isobus.net VDMA Data Dictionary (https://www.isobus.net/isobus/pGNAndSPN/15946?type=PGN)";
CM_ BO_ 2147548702  "Source: isobus.net VDMA Data Dictionary (https://www.isobus.net/isobus/pGNAndSPN/15953?type=PGN)";
CM_ BO_ 2147548703  "Source: isobus.net VDMA Data Dictionary (https://www.isobus.net/isobus/pGNAndSPN/15960?type=PGN)";
CM_ BO_ 2147548704  "Source: isobus.net VDMA Data Dictionary (https://www.isobus.net/isobus/pGNAndSPN/15966?type=PGN)";
CM_ BO_ 2147548705  "Source: isobus.net VDMA Data Dictionary (https://www.isobus.net/isobus/pGNAndSPN/15972?type=PGN)";
CM_ BO_ 2147548706  "Source: isobus.net VDMA Data Dictionary (https://www.isobus.net/isobus/pGNAndSPN/15978?type=PGN)";
CM_ BO_ 2147548707  "Source: isobus.net VDMA Data Dictionary (https://www.isobus.net/isobus/pGNAndSPN/15984?type=PGN)";
CM_ BO_ 2147548708  "Source: isobus.net VDMA Data Dictionary (https://www.isobus.net/isobus/pGNAndSPN/15990?type=PGN)";
CM_ BO_ 2147548709  "Source: isobus.net VDMA Data Dictionary (https://www.isobus.net/isobus/pGNAndSPN/15996?type=PGN)";
CM_ BO_ 2147548710  "Source: isobus.net VDMA Data Dictionary (https://www.isobus.net/isobus/pGNAndSPN/16002?type=PGN)";
CM_ BO_ 2147548711  "Source: isobus.net VDMA Data Dictionary (https://www.isobus.net/isobus/pGNAndSPN/16008?type=PGN)";
CM_ BO_ 2147548712  "Source: isobus.net VDMA Data Dictionary (https://www.isobus.net/isobus/pGNAndSPN/16014?type=PGN)";
CM_ BO_ 2147548713  "Source: isobus.net VDMA Data Dictionary (https://www.isobus.net/isobus/pGNAndSPN/16020?type=PGN)";
CM_ BO_ 2147548714  "Source: isobus.net VDMA Data Dictionary (https://www.isobus.net/isobus/pGNAndSPN/16026?type=PGN)";
CM_ BO_ 2147548715  "Source: isobus.net VDMA Data Dictionary (https://www.isobus.net/isobus/pGNAndSPN/16032?type=PGN)";
CM_ BO_ 2147548716  "Source: isobus.net VDMA Data Dictionary (https://www.isobus.net/isobus/pGNAndSPN/16038?type=PGN)";
CM_ BO_ 2147548717  "Source: isobus.net VDMA Data Dictionary (https://www.isobus.net/isobus/pGNAndSPN/16044?type=PGN)";
CM_ BO_ 2147548718  "Source: isobus.net VDMA Data Dictionary (https://www.isobus.net/isobus/pGNAndSPN/16050?type=PGN)";
CM_ BO_ 2147548719  "Source: isobus.net VDMA Data Dictionary (https://www.isobus.net/isobus/pGNAndSPN/16056?type=PGN)";
CM_ BO_ 2147548720  "Source: isobus.net VDMA Data Dictionary (https://www.isobus.net/isobus/pGNAndSPN/16061?type=PGN)";
CM_ BO_ 2147548721  "Source: isobus.net VDMA Data Dictionary (https://www.isobus.net/isobus/pGNAndSPN/16066?type=PGN)";
CM_ BO_ 2147548722  "Source: isobus.net VDMA Data Dictionary (https://www.isobus.net/isobus/pGNAndSPN/16071?type=PGN)";
CM_ BO_ 2147548723  "Source: isobus.net VDMA Data Dictionary (https://www.isobus.net/isobus/pGNAndSPN/16076?type=PGN)";
CM_ BO_ 2147548724  "Source: isobus.net VDMA Data Dictionary (https://www.isobus.net/isobus/pGNAndSPN/16081?type=PGN)";
CM_ BO_ 2147548725  "Source: isobus.net VDMA Data Dictionary (https://www.isobus.net/isobus/pGNAndSPN/16086?type=PGN)";
CM_ BO_ 2147548726  "Source: isobus.net VDMA Data Dictionary (https://www.isobus.net/isobus/pGNAndSPN/16091?type=PGN)";
CM_ BO_ 2147548727  "Source: isobus.net VDMA Data Dictionary (https://www.isobus.net/isobus/pGNAndSPN/16096?type=PGN)";
CM_ BO_ 2147548728  "Source: isobus.net VDMA Data Dictionary (https://www.isobus.net/isobus/pGNAndSPN/16101?type=PGN)";
CM_ BO_ 2147548729  "Source: isobus.net VDMA Data Dictionary (https://www.isobus.net/isobus/pGNAndSPN/16106?type=PGN)";
CM_ BO_ 2147548730  "Source: isobus.net VDMA Data Dictionary (https://www.isobus.net/isobus/pGNAndSPN/16111?type=PGN)";
CM_ BO_ 2147548731  "Source: isobus.net VDMA Data Dictionary (https://www.isobus.net/isobus/pGNAndSPN/16116?type=PGN)";
CM_ BO_ 2147548732  "Source: isobus.net VDMA Data Dictionary (https://www.isobus.net/isobus/pGNAndSPN/16121?type=PGN)";
CM_ BO_ 2147548733  "Source: isobus.net VDMA Data Dictionary (https://www.isobus.net/isobus/pGNAndSPN/16126?type=PGN)";
CM_ BO_ 2147548734  "Source: isobus.net VDMA Data Dictionary (https://www.isobus.net/isobus/pGNAndSPN/16131?type=PGN)";
CM_ BO_ 2147548735  "Source: isobus.net VDMA Data Dictionary (https://www.isobus.net/isobus/pGNAndSPN/16136?type=PGN)";
CM_ BO_ 2147548736  "Source: isobus.net VDMA Data Dictionary (https://www.isobus.net/isobus/pGNAndSPN/16167?type=PGN)";
CM_ BO_ 2147548737  "Source: isobus.net VDMA Data Dictionary (https://www.isobus.net/isobus/pGNAndSPN/16199?type=PGN)";
CM_ BO_ 2147548738  "Source: isobus.net VDMA Data Dictionary (https://www.isobus.net/isobus/pGNAndSPN/16209?type=PGN)";
CM_ BO_ 2147548739  "Source: isobus.net VDMA Data Dictionary (https://www.isobus.net/isobus/pGNAndSPN/16219?type=PGN)";
CM_ BO_ 2147548740  "Source: isobus.net VDMA Data Dictionary (https://www.isobus.net/isobus/pGNAndSPN/16229?type=PGN)";
CM_ BO_ 2147548741  "Source: isobus.net VDMA Data Dictionary (https://www.isobus.net/isobus/pGNAndSPN/16235?type=PGN)";
CM_ BO_ 2147548742  "Source: isobus.net VDMA Data Dictionary (https://www.isobus.net/isobus/pGNAndSPN/16241?type=PGN)";
CM_ BO_ 2147548746  "Source: isobus.net VDMA Data Dictionary (https://www.isobus.net/isobus/pGNAndSPN/16285?type=PGN)";
CM_ BO_ 2147548747  "Source: isobus.net VDMA Data Dictionary (https://www.isobus.net/isobus/pGNAndSPN/16290?type=PGN)";
CM_ BO_ 2147548748  "Source: isobus.net VDMA Data Dictionary (https://www.isobus.net/isobus/pGNAndSPN/16298?type=PGN)";
CM_ BO_ 2147548749  "Source: isobus.net VDMA Data Dictionary (https://www.isobus.net/isobus/pGNAndSPN/16300?type=PGN)";
CM_ BO_ 2147548750  "Source: isobus.net VDMA Data Dictionary (https://www.isobus.net/isobus/pGNAndSPN/16303?type=PGN)";
CM_ BO_ 2147548751  "Source: isobus.net VDMA Data Dictionary (https://www.isobus.net/isobus/pGNAndSPN/16311?type=PGN)";
CM_ BO_ 2147548752  "Source: isobus.net VDMA Data Dictionary (https://www.isobus.net/isobus/pGNAndSPN/16315?type=PGN)";
CM_ BO_ 2147548753  "Source: isobus.net VDMA Data Dictionary (https://www.isobus.net/isobus/pGNAndSPN/16317?type=PGN)";
CM_ BO_ 2147548754  "Source: isobus.net VDMA Data Dictionary (https://www.isobus.net/isobus/pGNAndSPN/16321?type=PGN)";
CM_ BO_ 2147548755  "Source: isobus.net VDMA Data Dictionary (https://www.isobus.net/isobus/pGNAndSPN/16329?type=PGN)";
CM_ BO_ 2147548756  "Source: isobus.net VDMA Data Dictionary (https://www.isobus.net/isobus/pGNAndSPN/16337?type=PGN)";
CM_ BO_ 2147548757  "Source: isobus.net VDMA Data Dictionary (https://www.isobus.net/isobus/pGNAndSPN/16340?type=PGN)";
CM_ BO_ 2147548758  "Source: isobus.net VDMA Data Dictionary (https://www.isobus.net/isobus/pGNAndSPN/16349?type=PGN)";
CM_ BO_ 2147548759  "Source: isobus.net VDMA Data Dictionary (https://www.isobus.net/isobus/pGNAndSPN/16355?type=PGN)";
CM_ BO_ 2147548760  "Source: isobus.net VDMA Data Dictionary (https://www.isobus.net/isobus/pGNAndSPN/16359?type=PGN)";
CM_ BO_ 2147548761  "Source: isobus.net VDMA Data Dictionary (https://www.isobus.net/isobus/pGNAndSPN/16363?type=PGN)";
CM_ BO_ 2147548762  "Source: isobus.net VDMA Data Dictionary (https://www.isobus.net/isobus/pGNAndSPN/16388?type=PGN)";
CM_ BO_ 2147548763  "Source: isobus.net VDMA Data Dictionary (https://www.isobus.net/isobus/pGNAndSPN/16397?type=PGN)";
CM_ BO_ 2147548764  "Source: isobus.net VDMA Data Dictionary (https://www.isobus.net/isobus/pGNAndSPN/16398?type=PGN)";
CM_ BO_ 2147548765  "Source: isobus.net VDMA Data Dictionary (https://www.isobus.net/isobus/pGNAndSPN/16399?type=PGN)";
CM_ BO_ 2147548766  "Source: isobus.net VDMA Data Dictionary (https://www.isobus.net/isobus/pGNAndSPN/16400?type=PGN)";
CM_ BO_ 2147548767  "Source: isobus.net VDMA Data Dictionary (https://www.isobus.net/isobus/pGNAndSPN/16401?type=PGN)";
CM_ BO_ 2147548768  "Source: isobus.net VDMA Data Dictionary (https://www.isobus.net/isobus/pGNAndSPN/16402?type=PGN)";
CM_ BO_ 2147548769  "Source: isobus.net VDMA Data Dictionary (https://www.isobus.net/isobus/pGNAndSPN/16403?type=PGN)";
CM_ BO_ 2147548770  "Source: isobus.net VDMA Data Dictionary (https://www.isobus.net/isobus/pGNAndSPN/16404?type=PGN)";
CM_ BO_ 2147548771  "Source: isobus.net VDMA Data Dictionary (https://www.isobus.net/isobus/pGNAndSPN/16405?type=PGN)";
CM_ BO_ 2147548772  "Source: isobus.net VDMA Data Dictionary (https://www.isobus.net/isobus/pGNAndSPN/16406?type=PGN)";
CM_ BO_ 2147548773  "Source: isobus.net VDMA Data Dictionary (https://www.isobus.net/isobus/pGNAndSPN/16407?type=PGN)";
CM_ BO_ 2147548774  "Source: isobus.net VDMA Data Dictionary (https://www.isobus.net/isobus/pGNAndSPN/16408?type=PGN)";
CM_ BO_ 2147548775  "Source: isobus.net VDMA Data Dictionary (https://www.isobus.net/isobus/pGNAndSPN/16409?type=PGN)";
CM_ BO_ 2147548776  "Source: isobus.net VDMA Data Dictionary (https://www.isobus.net/isobus/pGNAndSPN/16413?type=PGN)";
CM_ BO_ 2147548777  "Source: isobus.net VDMA Data Dictionary (https://www.isobus.net/isobus/pGNAndSPN/16417?type=PGN)";
CM_ BO_ 2147548778  "Source: isobus.net VDMA Data Dictionary (https://www.isobus.net/isobus/pGNAndSPN/16430?type=PGN)";
CM_ BO_ 2147548779  "Source: isobus.net VDMA Data Dictionary (https://www.isobus.net/isobus/pGNAndSPN/16432?type=PGN)";
CM_ BO_ 2147548780  "Source: isobus.net VDMA Data Dictionary (https://www.isobus.net/isobus/pGNAndSPN/16446?type=PGN)";
CM_ BO_ 2147548781  "Source: isobus.net VDMA Data Dictionary (https://www.isobus.net/isobus/pGNAndSPN/16455?type=PGN)";
CM_ BO_ 2147548782  "Source: isobus.net VDMA Data Dictionary (https://www.isobus.net/isobus/pGNAndSPN/16459?type=PGN)";
CM_ BO_ 2147548783  "Source: isobus.net VDMA Data Dictionary (https://www.isobus.net/isobus/pGNAndSPN/16469?type=PGN)";
CM_ BO_ 2147548784  "Source: isobus.net VDMA Data Dictionary (https://www.isobus.net/isobus/pGNAndSPN/16472?type=PGN)";
CM_ BO_ 2147548785  "Source: isobus.net VDMA Data Dictionary (https://www.isobus.net/isobus/pGNAndSPN/16477?type=PGN)";
CM_ BO_ 2147548786  "Source: isobus.net VDMA Data Dictionary (https://www.isobus.net/isobus/pGNAndSPN/16482?type=PGN)";
CM_ BO_ 2147548787  "Source: isobus.net VDMA Data Dictionary (https://www.isobus.net/isobus/pGNAndSPN/16483?type=PGN)";
CM_ BO_ 2147548788  "Source: isobus.net VDMA Data Dictionary (https://www.isobus.net/isobus/pGNAndSPN/16485?type=PGN)";
CM_ BO_ 2147548789  "Source: isobus.net VDMA Data Dictionary (https://www.isobus.net/isobus/pGNAndSPN/16489?type=PGN)";
CM_ BO_ 2147548790  "Source: isobus.net VDMA Data Dictionary (https://www.isobus.net/isobus/pGNAndSPN/16494?type=PGN)";
CM_ BO_ 2147548791  "Source: isobus.net VDMA Data Dictionary (https://www.isobus.net/isobus/pGNAndSPN/16497?type=PGN)";
CM_ BO_ 2147548792  "Source: isobus.net VDMA Data Dictionary (https://www.isobus.net/isobus/pGNAndSPN/16508?type=PGN)";
CM_ BO_ 2147548793  "Source: isobus.net VDMA Data Dictionary (https://www.isobus.net/isobus/pGNAndSPN/16511?type=PGN)";
CM_ BO_ 2147548794  "Source: isobus.net VDMA Data Dictionary (https://www.isobus.net/isobus/pGNAndSPN/16514?type=PGN)";
CM_ BO_ 2147548795  "Source: isobus.net VDMA Data Dictionary (https://www.isobus.net/isobus/pGNAndSPN/16518?type=PGN)";
CM_ BO_ 2147548796  "Source: isobus.net VDMA Data Dictionary (https://www.isobus.net/isobus/pGNAndSPN/16522?type=PGN)";
CM_ BO_ 2147548797  "Source: isobus.net VDMA Data Dictionary (https://www.isobus.net/isobus/pGNAndSPN/16526?type=PGN)";
CM_ BO_ 2147548798  "Source: isobus.net VDMA Data Dictionary (https://www.isobus.net/isobus/pGNAndSPN/16530?type=PGN)";
CM_ BO_ 2147548799  "Source: isobus.net VDMA Data Dictionary (https://www.isobus.net/isobus/pGNAndSPN/16534?type=PGN)";
CM_ BO_ 2147548800  "Source: isobus.net VDMA Data Dictionary (https://www.isobus.net/isobus/pGNAndSPN/16536?type=PGN)";
CM_ BO_ 2147548801  "Source: isobus.net VDMA Data Dictionary (https://www.isobus.net/isobus/pGNAndSPN/16542?type=PGN)";
CM_ BO_ 2147548802  "Source: isobus.net VDMA Data Dictionary (https://www.isobus.net/isobus/pGNAndSPN/16546?type=PGN)";
CM_ BO_ 2147548803  "Source: isobus.net VDMA Data Dictionary (https://www.isobus.net/isobus/pGNAndSPN/16550?type=PGN)";
CM_ BO_ 2147548804  "Source: isobus.net VDMA Data Dictionary (https://www.isobus.net/isobus/pGNAndSPN/16554?type=PGN)";
CM_ BO_ 2147548805  "Source: isobus.net VDMA Data Dictionary (https://www.isobus.net/isobus/pGNAndSPN/16558?type=PGN)";
CM_ BO_ 2147548806  "Source: isobus.net VDMA Data Dictionary (https://www.isobus.net/isobus/pGNAndSPN/16562?type=PGN)";
CM_ BO_ 2147548807  "Source: isobus.net VDMA Data Dictionary (https://www.isobus.net/isobus/pGNAndSPN/16566?type=PGN)";
CM_ BO_ 2147548808  "Source: isobus.net VDMA Data Dictionary (https://www.isobus.net/isobus/pGNAndSPN/16574?type=PGN)";
CM_ BO_ 2147548809  "Source: isobus.net VDMA Data Dictionary (https://www.isobus.net/isobus/pGNAndSPN/16582?type=PGN)";
CM_ BO_ 2147548810  "Source: isobus.net VDMA Data Dictionary (https://www.isobus.net/isobus/pGNAndSPN/16586?type=PGN)";
CM_ BO_ 2147548811  "Source: isobus.net VDMA Data Dictionary (https://www.isobus.net/isobus/pGNAndSPN/16590?type=PGN)";
CM_ BO_ 2147548812  "Source: isobus.net VDMA Data Dictionary (https://www.isobus.net/isobus/pGNAndSPN/16597?type=PGN)";
CM_ BO_ 2147548813  "Source: isobus.net VDMA Data Dictionary (https://www.isobus.net/isobus/pGNAndSPN/16601?type=PGN)";
CM_ BO_ 2147548814  "Source: isobus.net VDMA Data Dictionary (https://www.isobus.net/isobus/pGNAndSPN/16603?type=PGN)";
CM_ BO_ 2147548815  "Source: isobus.net VDMA Data Dictionary (https://www.isobus.net/isobus/pGNAndSPN/16604?type=PGN)";
CM_ BO_ 2147548816  "Source: isobus.net VDMA Data Dictionary (https://www.isobus.net/isobus/pGNAndSPN/16623?type=PGN)";
CM_ BO_ 2147548817  "Source: isobus.net VDMA Data Dictionary (https://www.isobus.net/isobus/pGNAndSPN/16626?type=PGN)";
CM_ BO_ 2147548818  "Source: isobus.net VDMA Data Dictionary (https://www.isobus.net/isobus/pGNAndSPN/16631?type=PGN)";
CM_ BO_ 2147548819  "Source: isobus.net VDMA Data Dictionary (https://www.isobus.net/isobus/pGNAndSPN/16634?type=PGN)";
CM_ BO_ 2147548820  "Source: isobus.net VDMA Data Dictionary (https://www.isobus.net/isobus/pGNAndSPN/16642?type=PGN)";
CM_ BO_ 2147548821  "Source: isobus.net VDMA Data Dictionary (https://www.isobus.net/isobus/pGNAndSPN/16643?type=PGN)";
CM_ BO_ 2147548822  "Source: isobus.net VDMA Data Dictionary (https://www.isobus.net/isobus/pGNAndSPN/16652?type=PGN)";
CM_ BO_ 2147548823  "Source: isobus.net VDMA Data Dictionary (https://www.isobus.net/isobus/pGNAndSPN/16656?type=PGN)";
CM_ BO_ 2147548824  "Source: isobus.net VDMA Data Dictionary (https://www.isobus.net/isobus/pGNAndSPN/16660?type=PGN)";
CM_ BO_ 2147548825  "Source: isobus.net VDMA Data Dictionary (https://www.isobus.net/isobus/pGNAndSPN/16664?type=PGN)";
CM_ BO_ 2147548826  "Source: isobus.net VDMA Data Dictionary (https://www.isobus.net/isobus/pGNAndSPN/16668?type=PGN)";
CM_ BO_ 2147548827  "Source: isobus.net VDMA Data Dictionary (https://www.isobus.net/isobus/pGNAndSPN/16672?type=PGN)";
CM_ BO_ 2147548828  "Source: isobus.net VDMA Data Dictionary (https://www.isobus.net/isobus/pGNAndSPN/16676?type=PGN)";
CM_ BO_ 2147548829  "Source: isobus.net VDMA Data Dictionary (https://www.isobus.net/isobus/pGNAndSPN/16680?type=PGN)";
CM_ BO_ 2147548830  "Source: isobus.net VDMA Data Dictionary (https://www.isobus.net/isobus/pGNAndSPN/16684?type=PGN)";
CM_ BO_ 2147548831  "Source: isobus.net VDMA Data Dictionary (https://www.isobus.net/isobus/pGNAndSPN/16688?type=PGN)";
CM_ BO_ 2147548832  "Source: isobus.net VDMA Data Dictionary (https://www.isobus.net/isobus/pGNAndSPN/16692?type=PGN)";
CM_ BO_ 2147548833  "Source: isobus.net VDMA Data Dictionary (https://www.isobus.net/isobus/pGNAndSPN/16696?type=PGN)";
CM_ BO_ 2147548834  "Source: isobus.net VDMA Data Dictionary (https://www.isobus.net/isobus/pGNAndSPN/16700?type=PGN)";
CM_ BO_ 2147548835  "Source: isobus.net VDMA Data Dictionary (https://www.isobus.net/isobus/pGNAndSPN/16704?type=PGN)";
CM_ BO_ 2147548836  "Source: isobus.net VDMA Data Dictionary (https://www.isobus.net/isobus/pGNAndSPN/16708?type=PGN)";
CM_ BO_ 2147548837  "Source: isobus.net VDMA Data Dictionary (https://www.isobus.net/isobus/pGNAndSPN/16715?type=PGN)";
CM_ BO_ 2147548838  "Source: isobus.net VDMA Data Dictionary (https://www.isobus.net/isobus/pGNAndSPN/16719?type=PGN)";
CM_ BO_ 2147548839  "Source: isobus.net VDMA Data Dictionary (https://www.isobus.net/isobus/pGNAndSPN/16727?type=PGN)";
CM_ BO_ 2147548840  "Source: isobus.net VDMA Data Dictionary (https://www.isobus.net/isobus/pGNAndSPN/16729?type=PGN)";
CM_ BO_ 2147548841  "Source: isobus.net VDMA Data Dictionary (https://www.isobus.net/isobus/pGNAndSPN/16734?type=PGN)";
CM_ BO_ 2147548842  "Source: isobus.net VDMA Data Dictionary (https://www.isobus.net/isobus/pGNAndSPN/16739?type=PGN)";
CM_ BO_ 2147548843  "Source: isobus.net VDMA Data Dictionary (https://www.isobus.net/isobus/pGNAndSPN/16743?type=PGN)";
CM_ BO_ 2147548844  "Source: isobus.net VDMA Data Dictionary (https://www.isobus.net/isobus/pGNAndSPN/16751?type=PGN)";
CM_ BO_ 2147548845  "Source: isobus.net VDMA Data Dictionary (https://www.isobus.net/isobus/pGNAndSPN/16759?type=PGN)";
CM_ BO_ 2147548846  "Source: isobus.net VDMA Data Dictionary (https://www.isobus.net/isobus/pGNAndSPN/16767?type=PGN)";
CM_ BO_ 2147548847  "Source: isobus.net VDMA Data Dictionary (https://www.isobus.net/isobus/pGNAndSPN/16769?type=PGN)";
CM_ BO_ 2147548848  "Source: isobus.net VDMA Data Dictionary (https://www.isobus.net/isobus/pGNAndSPN/16774?type=PGN)";
CM_ BO_ 2147548849  "Source: isobus.net VDMA Data Dictionary (https://www.isobus.net/isobus/pGNAndSPN/16776?type=PGN)";
CM_ BO_ 2147548850  "Source: isobus.net VDMA Data Dictionary (https://www.isobus.net/isobus/pGNAndSPN/16779?type=PGN)";
CM_ BO_ 2147548851  "Source: isobus.net VDMA Data Dictionary (https://www.isobus.net/isobus/pGNAndSPN/16782?type=PGN)";
CM_ BO_ 2147548852  "Source: isobus.net VDMA Data Dictionary (https://www.isobus.net/isobus/pGNAndSPN/16786?type=PGN)";
CM_ BO_ 2147548853  "Source: isobus.net VDMA Data Dictionary (https://www.isobus.net/isobus/pGNAndSPN/16790?type=PGN)";
CM_ BO_ 2147548854  "Source: isobus.net VDMA Data Dictionary (https://www.isobus.net/isobus/pGNAndSPN/16792?type=PGN)";
CM_ BO_ 2147548855  "Source: isobus.net VDMA Data Dictionary (https://www.isobus.net/isobus/pGNAndSPN/16797?type=PGN)";
CM_ BO_ 2147548856  "Source: isobus.net VDMA Data Dictionary (https://www.isobus.net/isobus/pGNAndSPN/16803?type=PGN)";
CM_ BO_ 2147548857  "Source: isobus.net VDMA Data Dictionary (https://www.isobus.net/isobus/pGNAndSPN/16809?type=PGN)";
CM_ BO_ 2147548858  "Source: isobus.net VDMA Data Dictionary (https://www.isobus.net/isobus/pGNAndSPN/16812?type=PGN)";
CM_ BO_ 2147548859  "Source: isobus.net VDMA Data Dictionary (https://www.isobus.net/isobus/pGNAndSPN/16816?type=PGN)";
CM_ BO_ 2147548860  "Source: isobus.net VDMA Data Dictionary (https://www.isobus.net/isobus/pGNAndSPN/16820?type=PGN)";
CM_ BO_ 2147548861  "Source: isobus.net VDMA Data Dictionary (https://www.isobus.net/isobus/pGNAndSPN/16827?type=PGN)";
CM_ BO_ 2147548862  "Source: isobus.net VDMA Data Dictionary (https://www.isobus.net/isobus/pGNAndSPN/16833?type=PGN)";
CM_ BO_ 2147548863  "Source: isobus.net VDMA Data Dictionary (https://www.isobus.net/isobus/pGNAndSPN/16840?type=PGN)";
CM_ BO_ 2147548864  "Source: isobus.net VDMA Data Dictionary (https://www.isobus.net/isobus/pGNAndSPN/16846?type=PGN)";
CM_ BO_ 2147548865  "Source: isobus.net VDMA Data Dictionary (https://www.isobus.net/isobus/pGNAndSPN/16848?type=PGN)";
CM_ BO_ 2147548866  "Source: isobus.net VDMA Data Dictionary (https://www.isobus.net/isobus/pGNAndSPN/16856?type=PGN)";
CM_ BO_ 2147548867  "Source: isobus.net VDMA Data Dictionary (https://www.isobus.net/isobus/pGNAndSPN/16862?type=PGN)";
CM_ BO_ 2147548868  "Source: isobus.net VDMA Data Dictionary (https://www.isobus.net/isobus/pGNAndSPN/16863?type=PGN)";
CM_ BO_ 2147548869  "Source: isobus.net VDMA Data Dictionary (https://www.isobus.net/isobus/pGNAndSPN/16865?type=PGN)";
CM_ BO_ 2147548870  "Source: isobus.net VDMA Data Dictionary (https://www.isobus.net/isobus/pGNAndSPN/16866?type=PGN)";
CM_ BO_ 2147548871  "Source: isobus.net VDMA Data Dictionary (https://www.isobus.net/isobus/pGNAndSPN/16883?type=PGN)";
CM_ BO_ 2147548872  "Source: isobus.net VDMA Data Dictionary (https://www.isobus.net/isobus/pGNAndSPN/16884?type=PGN)";
CM_ BO_ 2147548873  "Source: isobus.net VDMA Data Dictionary (https://www.isobus.net/isobus/pGNAndSPN/16885?type=PGN)";
CM_ BO_ 2147548877  "Source: isobus.net VDMA Data Dictionary (https://www.isobus.net/isobus/pGNAndSPN/16900?type=PGN)";
CM_ BO_ 2147548878  "Source: isobus.net VDMA Data Dictionary (https://www.isobus.net/isobus/pGNAndSPN/16906?type=PGN)";
CM_ BO_ 2147548879  "Source: isobus.net VDMA Data Dictionary (https://www.isobus.net/isobus/pGNAndSPN/16918?type=PGN)";
CM_ BO_ 2147548880  "Source: isobus.net VDMA Data Dictionary (https://www.isobus.net/isobus/pGNAndSPN/16923?type=PGN)";
CM_ BO_ 2147548881  "Source: isobus.net VDMA Data Dictionary (https://www.isobus.net/isobus/pGNAndSPN/16924?type=PGN)";
CM_ BO_ 2147548882  "Source: isobus.net VDMA Data Dictionary (https://www.isobus.net/isobus/pGNAndSPN/16925?type=PGN)";
CM_ BO_ 2147548884  "Source: isobus.net VDMA Data Dictionary (https://www.isobus.net/isobus/pGNAndSPN/16938?type=PGN)";
CM_ BO_ 2147548885  "Source: isobus.net VDMA Data Dictionary (https://www.isobus.net/isobus/pGNAndSPN/16950?type=PGN)";
CM_ BO_ 2147548886  "Source: isobus.net VDMA Data Dictionary (https://www.isobus.net/isobus/pGNAndSPN/16966?type=PGN)";
CM_ BO_ 2147548889  "Source: isobus.net VDMA Data Dictionary (https://www.isobus.net/isobus/pGNAndSPN/16986?type=PGN)";
CM_ BO_ 2147548891  "Source: isobus.net VDMA Data Dictionary (https://www.isobus.net/isobus/pGNAndSPN/16992?type=PGN)";
CM_ BO_ 2147548892  "Source: isobus.net VDMA Data Dictionary (https://www.isobus.net/isobus/pGNAndSPN/16994?type=PGN)";
CM_ BO_ 2147548893  "Source: isobus.net VDMA Data Dictionary (https://www.isobus.net/isobus/pGNAndSPN/16998?type=PGN)";
CM_ BO_ 2147548894  "Source: isobus.net VDMA Data Dictionary (https://www.isobus.net/isobus/pGNAndSPN/17001?type=PGN)";
CM_ BO_ 2147548895  "Source: isobus.net VDMA Data Dictionary (https://www.isobus.net/isobus/pGNAndSPN/17010?type=PGN)";
CM_ BO_ 2147548896  "Source: isobus.net VDMA Data Dictionary (https://www.isobus.net/isobus/pGNAndSPN/17012?type=PGN)";
CM_ BO_ 2147548897  "Source: isobus.net VDMA Data Dictionary (https://www.isobus.net/isobus/pGNAndSPN/17026?type=PGN)";
CM_ BO_ 2147548898  "Source: isobus.net VDMA Data Dictionary (https://www.isobus.net/isobus/pGNAndSPN/17029?type=PGN)";
CM_ BO_ 2147548899  "Source: isobus.net VDMA Data Dictionary (https://www.isobus.net/isobus/pGNAndSPN/17058?type=PGN)";
CM_ BO_ 2147548900  "Source: isobus.net VDMA Data Dictionary (https://www.isobus.net/isobus/pGNAndSPN/17081?type=PGN)";
CM_ BO_ 2147548901  "Source: isobus.net VDMA Data Dictionary (https://www.isobus.net/isobus/pGNAndSPN/17083?type=PGN)";
CM_ BO_ 2147548903  "Source: isobus.net VDMA Data Dictionary (https://www.isobus.net/isobus/pGNAndSPN/17093?type=PGN)";
CM_ BO_ 2147548904  "Source: isobus.net VDMA Data Dictionary (https://www.isobus.net/isobus/pGNAndSPN/17097?type=PGN)";
CM_ BO_ 2147548905  "Source: isobus.net VDMA Data Dictionary (https://www.isobus.net/isobus/pGNAndSPN/17099?type=PGN)";
CM_ BO_ 2147548906  "Source: isobus.net VDMA Data Dictionary (https://www.isobus.net/isobus/pGNAndSPN/17103?type=PGN)";
CM_ BO_ 2147548908  "Source: isobus.net VDMA Data Dictionary (https://www.isobus.net/isobus/pGNAndSPN/17108?type=PGN)";
CM_ BO_ 2147548909  "Source: isobus.net VDMA Data Dictionary (https://www.isobus.net/isobus/pGNAndSPN/17118?type=PGN)";
CM_ BO_ 2147548910  "Source: isobus.net VDMA Data Dictionary (https://www.isobus.net/isobus/pGNAndSPN/17124?type=PGN)";
CM_ BO_ 2147548911  "Source: isobus.net VDMA Data Dictionary (https://www.isobus.net/isobus/pGNAndSPN/17131?type=PGN)";
CM_ BO_ 2147548912  "Source: isobus.net VDMA Data Dictionary (https://www.isobus.net/isobus/pGNAndSPN/17145?type=PGN)";
CM_ BO_ 2147548913  "Source: isobus.net VDMA Data Dictionary (https://www.isobus.net/isobus/pGNAndSPN/17165?type=PGN)";
CM_ BO_ 2147548914  "Source: isobus.net VDMA Data Dictionary (https://www.isobus.net/isobus/pGNAndSPN/17170?type=PGN)";
CM_ BO_ 2147548915  "Source: isobus.net VDMA Data Dictionary (https://www.isobus.net/isobus/pGNAndSPN/17172?type=PGN)";
CM_ BO_ 2147548916  "Source: isobus.net VDMA Data Dictionary (https://www.isobus.net/isobus/pGNAndSPN/17181?type=PGN)";
CM_ BO_ 2147548917  "Source: isobus.net VDMA Data Dictionary (https://www.isobus.net/isobus/pGNAndSPN/17186?type=PGN)";
CM_ BO_ 2147548918  "Source: isobus.net VDMA Data Dictionary (https://www.isobus.net/isobus/pGNAndSPN/17193?type=PGN)";
CM_ BO_ 2147548919  "Source: isobus.net VDMA Data Dictionary (https://www.isobus.net/isobus/pGNAndSPN/17198?type=PGN)";
CM_ BO_ 2147548920  "Source: isobus.net VDMA Data Dictionary (https://www.isobus.net/isobus/pGNAndSPN/17206?type=PGN)";
CM_ BO_ 2147548921  "Source: isobus.net VDMA Data Dictionary (https://www.isobus.net/isobus/pGNAndSPN/17212?type=PGN)";
CM_ BO_ 2147548922  "Source: isobus.net VDMA Data Dictionary (https://www.isobus.net/isobus/pGNAndSPN/17219?type=PGN)";
CM_ BO_ 2147548923  "Source: isobus.net VDMA Data Dictionary (https://www.isobus.net/isobus/pGNAndSPN/17223?type=PGN)";
CM_ BO_ 2147548924  "Source: isobus.net VDMA Data Dictionary (https://www.isobus.net/isobus/pGNAndSPN/17230?type=PGN)";
CM_ BO_ 2147548925  "Source: isobus.net VDMA Data Dictionary (https://www.isobus.net/isobus/pGNAndSPN/17235?type=PGN)";
CM_ BO_ 2147548926  "Source: isobus.net VDMA Data Dictionary (https://www.isobus.net/isobus/pGNAndSPN/17236?type=PGN)";
CM_ BO_ 2147548927  "Source: isobus.net VDMA Data Dictionary (https://www.isobus.net/isobus/pGNAndSPN/17252?type=PGN)";
CM_ BO_ 2147609856  "Source: isobus.net VDMA Data Dictionary (https://www.isobus.net/isobus/pGNAndSPN/17509?type=PGN)";
CM_ BO_ 2147610112  "Source: isobus.net VDMA Data Dictionary (https://www.isobus.net/isobus/pGNAndSPN/17510?type=PGN)";
CM_ BO_ 2147610368  "Source: isobus.net VDMA Data Dictionary (https://www.isobus.net/isobus/pGNAndSPN/17511?type=PGN)";
CM_ BO_ 2147610631  "Source: isobus.net VDMA Data Dictionary (https://www.isobus.net/isobus/pGNAndSPN/17512?type=PGN)";
CM_ BO_ 2147610632  "Source: isobus.net VDMA Data Dictionary (https://www.isobus.net/isobus/pGNAndSPN/17513?type=PGN)";
CM_ BO_ 2147610633  "Source: isobus.net VDMA Data Dictionary (https://www.isobus.net/isobus/pGNAndSPN/17514?type=PGN)";
CM_ BO_ 2147610634  "Source: isobus.net VDMA Data Dictionary (https://www.isobus.net/isobus/pGNAndSPN/17515?type=PGN)";
CM_ BO_ 2147610635  "Source: isobus.net VDMA Data Dictionary (https://www.isobus.net/isobus/pGNAndSPN/17516?type=PGN)";
CM_ BO_ 2147610636  "Source: isobus.net VDMA Data Dictionary (https://www.isobus.net/isobus/pGNAndSPN/17517?type=PGN)";
CM_ BO_ 2147610640  "Source: isobus.net VDMA Data Dictionary (https://www.isobus.net/isobus/pGNAndSPN/17518?type=PGN)";
CM_ BO_ 2147610641  "Source: isobus.net VDMA Data Dictionary (https://www.isobus.net/isobus/pGNAndSPN/17519?type=PGN)";
CM_ BO_ 2147610644  "Source: isobus.net VDMA Data Dictionary (https://www.isobus.net/isobus/pGNAndSPN/17520?type=PGN)";
CM_ BO_ 2147610646  "Source: isobus.net VDMA Data Dictionary (https://www.isobus.net/isobus/pGNAndSPN/17521?type=PGN)";
CM_ BO_ 2147610649  "Source: isobus.net VDMA Data Dictionary (https://www.isobus.net/isobus/pGNAndSPN/17522?type=PGN)";
CM_ BO_ 2147610650  "Source: isobus.net VDMA Data Dictionary (https://www.isobus.net/isobus/pGNAndSPN/17523?type=PGN)";
CM_ BO_ 2147610881  "Source: isobus.net VDMA Data Dictionary (https://www.isobus.net/isobus/pGNAndSPN/17524?type=PGN)";
CM_ BO_ 2147610885  "Source: isobus.net VDMA Data Dictionary (https://www.isobus.net/isobus/pGNAndSPN/17525?type=PGN)";
CM_ BO_ 2147610893  "Source: isobus.net VDMA Data Dictionary (https://www.isobus.net/isobus/pGNAndSPN/17526?type=PGN)";
CM_ BO_ 2147610900  "Source: isobus.net VDMA Data Dictionary (https://www.isobus.net/isobus/pGNAndSPN/17529?type=PGN)";
CM_ BO_ 2147610905  "Source: isobus.net VDMA Data Dictionary (https://www.isobus.net/isobus/pGNAndSPN/17530?type=PGN)";
CM_ BO_ 2147610906  "Source: isobus.net VDMA Data Dictionary (https://www.isobus.net/isobus/pGNAndSPN/17531?type=PGN)";
CM_ BO_ 2147611136  "Source: isobus.net VDMA Data Dictionary (https://www.isobus.net/isobus/pGNAndSPN/17532?type=PGN)";
CM_ BO_ 2147611137  "Source: isobus.net VDMA Data Dictionary (https://www.isobus.net/isobus/pGNAndSPN/17533?type=PGN)";
CM_ BO_ 2147611138  "Source: isobus.net VDMA Data Dictionary (https://www.isobus.net/isobus/pGNAndSPN/17534?type=PGN)";
CM_ BO_ 2147611139  "Source: isobus.net VDMA Data Dictionary (https://www.isobus.net/isobus/pGNAndSPN/17535?type=PGN)";
CM_ BO_ 2147611141  "Source: isobus.net VDMA Data Dictionary (https://www.isobus.net/isobus/pGNAndSPN/17536?type=PGN)";
CM_ BO_ 2147611142  "Source: isobus.net VDMA Data Dictionary (https://www.isobus.net/isobus/pGNAndSPN/17537?type=PGN)";
CM_ BO_ 2147611143  "Source: isobus.net VDMA Data Dictionary (https://www.isobus.net/isobus/pGNAndSPN/17538?type=PGN)";
CM_ BO_ 2147611144  "Source: isobus.net VDMA Data Dictionary (https://www.isobus.net/isobus/pGNAndSPN/17539?type=PGN)";
CM_ BO_ 2147611145  "Source: isobus.net VDMA Data Dictionary (https://www.isobus.net/isobus/pGNAndSPN/17540?type=PGN)";
CM_ BO_ 2147611146  "Source: isobus.net VDMA Data Dictionary (https://www.isobus.net/isobus/pGNAndSPN/17541?type=PGN)";
CM_ BO_ 2147611148  "Source: isobus.net VDMA Data Dictionary (https://www.isobus.net/isobus/pGNAndSPN/17542?type=PGN)";
CM_ BO_ 2147611149  "Source: isobus.net VDMA Data Dictionary (https://www.isobus.net/isobus/pGNAndSPN/17543?type=PGN)";
CM_ BO_ 2147611150  "Source: isobus.net VDMA Data Dictionary (https://www.isobus.net/isobus/pGNAndSPN/17544?type=PGN)";
CM_ BO_ 2147611151  "Source: isobus.net VDMA Data Dictionary (https://www.isobus.net/isobus/pGNAndSPN/17545?type=PGN)";
CM_ BO_ 2147611152  "Source: isobus.net VDMA Data Dictionary (https://www.isobus.net/isobus/pGNAndSPN/17546?type=PGN)";
CM_ BO_ 2147611153  "Source: isobus.net VDMA Data Dictionary (https://www.isobus.net/isobus/pGNAndSPN/17547?type=PGN)";
CM_ BO_ 2147611154  "Source: isobus.net VDMA Data Dictionary (https://www.isobus.net/isobus/pGNAndSPN/17548?type=PGN)";
CM_ BO_ 2147611155  "Source: isobus.net VDMA Data Dictionary (https://www.isobus.net/isobus/pGNAndSPN/17549?type=PGN)";
CM_ BO_ 2147611156  "Source: isobus.net VDMA Data Dictionary (https://www.isobus.net/isobus/pGNAndSPN/17550?type=PGN)";
CM_ BO_ 2147611157  "Source: isobus.net VDMA Data Dictionary (https://www.isobus.net/isobus/pGNAndSPN/17551?type=PGN)";
CM_ BO_ 2147611158  "Source: isobus.net VDMA Data Dictionary (https://www.isobus.net/isobus/pGNAndSPN/17552?type=PGN)";
CM_ BO_ 2147611159  "Source: isobus.net VDMA Data Dictionary (https://www.isobus.net/isobus/pGNAndSPN/17553?type=PGN)";
CM_ BO_ 2147611160  "Source: isobus.net VDMA Data Dictionary (https://www.isobus.net/isobus/pGNAndSPN/17554?type=PGN)";
CM_ BO_ 2147611161  "Source: isobus.net VDMA Data Dictionary (https://www.isobus.net/isobus/pGNAndSPN/17555?type=PGN)";
CM_ BO_ 2147611162  "Source: isobus.net VDMA Data Dictionary (https://www.isobus.net/isobus/pGNAndSPN/17556?type=PGN)";
CM_ BO_ 2147611392  "Source: isobus.net VDMA Data Dictionary (https://www.isobus.net/isobus/pGNAndSPN/17557?type=PGN)";
CM_ BO_ 2147611393  "Source: isobus.net VDMA Data Dictionary (https://www.isobus.net/isobus/pGNAndSPN/17558?type=PGN)";
CM_ BO_ 2147611394  "Source: isobus.net VDMA Data Dictionary (https://www.isobus.net/isobus/pGNAndSPN/17559?type=PGN)";
CM_ BO_ 2147611395  "Source: isobus.net VDMA Data Dictionary (https://www.isobus.net/isobus/pGNAndSPN/17560?type=PGN)";
CM_ BO_ 2147611396  "Source: isobus.net VDMA Data Dictionary (https://www.isobus.net/isobus/pGNAndSPN/17561?type=PGN)";
CM_ BO_ 2147611397  "Source: isobus.net VDMA Data Dictionary (https://www.isobus.net/isobus/pGNAndSPN/17562?type=PGN)";
CM_ BO_ 2147611398  "Source: isobus.net VDMA Data Dictionary (https://www.isobus.net/isobus/pGNAndSPN/17563?type=PGN)";
CM_ BO_ 2147611399  "Source: isobus.net VDMA Data Dictionary (https://www.isobus.net/isobus/pGNAndSPN/17564?type=PGN)";
CM_ BO_ 2147611648  "Source: isobus.net VDMA Data Dictionary (https://www.isobus.net/isobus/pGNAndSPN/17565?type=PGN)";
CM_ BO_ 2147611649  "Source: isobus.net VDMA Data Dictionary (https://www.isobus.net/isobus/pGNAndSPN/17566?type=PGN)";
CM_ BO_ 2147611650  "Source: isobus.net VDMA Data Dictionary (https://www.isobus.net/isobus/pGNAndSPN/17567?type=PGN)";
CM_ BO_ 2147611651  "Source: isobus.net VDMA Data Dictionary (https://www.isobus.net/isobus/pGNAndSPN/17568?type=PGN)";
CM_ BO_ 2147611654  "Source: isobus.net VDMA Data Dictionary (https://www.isobus.net/isobus/pGNAndSPN/17569?type=PGN)";
CM_ BO_ 2147611655  "Source: isobus.net VDMA Data Dictionary (https://www.isobus.net/isobus/pGNAndSPN/17570?type=PGN)";
CM_ BO_ 2147611656  "Source: isobus.net VDMA Data Dictionary (https://www.isobus.net/isobus/pGNAndSPN/17571?type=PGN)";
CM_ BO_ 2147611907  "Source: isobus.net VDMA Data Dictionary (https://www.isobus.net/isobus/pGNAndSPN/17572?type=PGN)";
CM_ BO_ 2147611915  "Source: isobus.net VDMA Data Dictionary (https://www.isobus.net/isobus/pGNAndSPN/17573?type=PGN)";
CM_ BO_ 2147611923  "Source: isobus.net VDMA Data Dictionary (https://www.isobus.net/isobus/pGNAndSPN/17574?type=PGN)";
CM_ BO_ 2147612168  "Source: isobus.net VDMA Data Dictionary (https://www.isobus.net/isobus/pGNAndSPN/17575?type=PGN)";
CM_ BO_ 2147612186  "Source: isobus.net VDMA Data Dictionary (https://www.isobus.net/isobus/pGNAndSPN/17576?type=PGN)";
CM_ BO_ 2147612416  "Source: isobus.net VDMA Data Dictionary (https://www.isobus.net/isobus/pGNAndSPN/17577?type=PGN)";
CM_ BO_ 2147612417  "Source: isobus.net VDMA Data Dictionary (https://www.isobus.net/isobus/pGNAndSPN/17578?type=PGN)";
CM_ BO_ 2147612424  "Source: isobus.net VDMA Data Dictionary (https://www.isobus.net/isobus/pGNAndSPN/17579?type=PGN)";
CM_ BO_ 2147612425  "Source: isobus.net VDMA Data Dictionary (https://www.isobus.net/isobus/pGNAndSPN/17580?type=PGN)";
CM_ BO_ 2147612426  "Source: isobus.net VDMA Data Dictionary (https://www.isobus.net/isobus/pGNAndSPN/17581?type=PGN)";
CM_ BO_ 2147612428  "Source: isobus.net VDMA Data Dictionary (https://www.isobus.net/isobus/pGNAndSPN/17582?type=PGN)";
CM_ BO_ 2147612676  "Source: isobus.net VDMA Data Dictionary (https://www.isobus.net/isobus/pGNAndSPN/17586?type=PGN)";
CM_ SG_ 2147548683 Tractor_control_mode_command_Raw "Generic 8-byte raw payload. Detail page: https://www.isobus.net/isobus/pGNAndSPN/15831?type=PGN. Signal-level enrichment via PR welcome  see CONTRIBUTING.md.";
CM_ SG_ 2147548684 Working_Set_Member_RawPayload "Generic 8-byte raw payload. Detail page: https://www.isobus.net/isobus/pGNAndSPN/15832?type=PGN. Signal-level enrichment via PR welcome  see CONTRIBUTING.md.";
CM_ SG_ 2147548686 Response_for_Repetition_Rate_Raw "Generic 8-byte raw payload. Detail page: https://www.isobus.net/isobus/pGNAndSPN/15835?type=PGN. Signal-level enrichment via PR welcome  see CONTRIBUTING.md.";
CM_ SG_ 2147548688 Auxiliary_valve_0_estimated_flow "Generic 8-byte raw payload. Detail page: https://www.isobus.net/isobus/pGNAndSPN/15855?type=PGN. Signal-level enrichment via PR welcome  see CONTRIBUTING.md.";
CM_ SG_ 2147548689 Auxiliary_valve_1_estimated_flow "Generic 8-byte raw payload. Detail page: https://www.isobus.net/isobus/pGNAndSPN/15862?type=PGN. Signal-level enrichment via PR welcome  see CONTRIBUTING.md.";
CM_ SG_ 2147548690 Auxiliary_valve_2_estimated_flow "Generic 8-byte raw payload. Detail page: https://www.isobus.net/isobus/pGNAndSPN/15869?type=PGN. Signal-level enrichment via PR welcome  see CONTRIBUTING.md.";
CM_ SG_ 2147548691 Auxiliary_valve_3_estimated_flow "Generic 8-byte raw payload. Detail page: https://www.isobus.net/isobus/pGNAndSPN/15876?type=PGN. Signal-level enrichment via PR welcome  see CONTRIBUTING.md.";
CM_ SG_ 2147548692 Auxiliary_valve_4_estimated_flow "Generic 8-byte raw payload. Detail page: https://www.isobus.net/isobus/pGNAndSPN/15883?type=PGN. Signal-level enrichment via PR welcome  see CONTRIBUTING.md.";
CM_ SG_ 2147548693 Auxiliary_valve_5_estimated_flow "Generic 8-byte raw payload. Detail page: https://www.isobus.net/isobus/pGNAndSPN/15890?type=PGN. Signal-level enrichment via PR welcome  see CONTRIBUTING.md.";
CM_ SG_ 2147548694 Auxiliary_valve_6_estimated_flow "Generic 8-byte raw payload. Detail page: https://www.isobus.net/isobus/pGNAndSPN/15897?type=PGN. Signal-level enrichment via PR welcome  see CONTRIBUTING.md.";
CM_ SG_ 2147548695 Auxiliary_valve_7_estimated_flow "Generic 8-byte raw payload. Detail page: https://www.isobus.net/isobus/pGNAndSPN/15904?type=PGN. Signal-level enrichment via PR welcome  see CONTRIBUTING.md.";
CM_ SG_ 2147548696 Auxiliary_valve_8_estimated_flow "Generic 8-byte raw payload. Detail page: https://www.isobus.net/isobus/pGNAndSPN/15911?type=PGN. Signal-level enrichment via PR welcome  see CONTRIBUTING.md.";
CM_ SG_ 2147548697 Auxiliary_valve_9_estimated_flow "Generic 8-byte raw payload. Detail page: https://www.isobus.net/isobus/pGNAndSPN/15918?type=PGN. Signal-level enrichment via PR welcome  see CONTRIBUTING.md.";
CM_ SG_ 2147548698 Auxiliary_valve_10_estimated_flo "Generic 8-byte raw payload. Detail page: https://www.isobus.net/isobus/pGNAndSPN/15925?type=PGN. Signal-level enrichment via PR welcome  see CONTRIBUTING.md.";
CM_ SG_ 2147548699 Auxiliary_valve_11_estimated_flo "Generic 8-byte raw payload. Detail page: https://www.isobus.net/isobus/pGNAndSPN/15932?type=PGN. Signal-level enrichment via PR welcome  see CONTRIBUTING.md.";
CM_ SG_ 2147548700 Auxiliary_valve_12_estimated_flo "Generic 8-byte raw payload. Detail page: https://www.isobus.net/isobus/pGNAndSPN/15939?type=PGN. Signal-level enrichment via PR welcome  see CONTRIBUTING.md.";
CM_ SG_ 2147548701 Auxiliary_valve_13_estimated_flo "Generic 8-byte raw payload. Detail page: https://www.isobus.net/isobus/pGNAndSPN/15946?type=PGN. Signal-level enrichment via PR welcome  see CONTRIBUTING.md.";
CM_ SG_ 2147548702 Auxiliary_valve_14_estimated_flo "Generic 8-byte raw payload. Detail page: https://www.isobus.net/isobus/pGNAndSPN/15953?type=PGN. Signal-level enrichment via PR welcome  see CONTRIBUTING.md.";
CM_ SG_ 2147548703 Auxiliary_valve_15_estimated_flo "Generic 8-byte raw payload. Detail page: https://www.isobus.net/isobus/pGNAndSPN/15960?type=PGN. Signal-level enrichment via PR welcome  see CONTRIBUTING.md.";
CM_ SG_ 2147548704 Auxiliary_valve_0_measured_flow_ "Generic 8-byte raw payload. Detail page: https://www.isobus.net/isobus/pGNAndSPN/15966?type=PGN. Signal-level enrichment via PR welcome  see CONTRIBUTING.md.";
CM_ SG_ 2147548705 Auxiliary_valve_1_measured_flow_ "Generic 8-byte raw payload. Detail page: https://www.isobus.net/isobus/pGNAndSPN/15972?type=PGN. Signal-level enrichment via PR welcome  see CONTRIBUTING.md.";
CM_ SG_ 2147548706 Auxiliary_valve_2_measured_flow_ "Generic 8-byte raw payload. Detail page: https://www.isobus.net/isobus/pGNAndSPN/15978?type=PGN. Signal-level enrichment via PR welcome  see CONTRIBUTING.md.";
CM_ SG_ 2147548707 Auxiliary_valve_3_measured_flow_ "Generic 8-byte raw payload. Detail page: https://www.isobus.net/isobus/pGNAndSPN/15984?type=PGN. Signal-level enrichment via PR welcome  see CONTRIBUTING.md.";
CM_ SG_ 2147548708 Auxiliary_valve_4_measured_flow_ "Generic 8-byte raw payload. Detail page: https://www.isobus.net/isobus/pGNAndSPN/15990?type=PGN. Signal-level enrichment via PR welcome  see CONTRIBUTING.md.";
CM_ SG_ 2147548709 Auxiliary_valve_5_measured_flow_ "Generic 8-byte raw payload. Detail page: https://www.isobus.net/isobus/pGNAndSPN/15996?type=PGN. Signal-level enrichment via PR welcome  see CONTRIBUTING.md.";
CM_ SG_ 2147548710 Auxiliary_valve_6_measured_flow_ "Generic 8-byte raw payload. Detail page: https://www.isobus.net/isobus/pGNAndSPN/16002?type=PGN. Signal-level enrichment via PR welcome  see CONTRIBUTING.md.";
CM_ SG_ 2147548711 Auxiliary_valve_7_measured_flow_ "Generic 8-byte raw payload. Detail page: https://www.isobus.net/isobus/pGNAndSPN/16008?type=PGN. Signal-level enrichment via PR welcome  see CONTRIBUTING.md.";
CM_ SG_ 2147548712 Auxiliary_valve_8_measured_flow_ "Generic 8-byte raw payload. Detail page: https://www.isobus.net/isobus/pGNAndSPN/16014?type=PGN. Signal-level enrichment via PR welcome  see CONTRIBUTING.md.";
CM_ SG_ 2147548713 Auxiliary_valve_9_measured_flow_ "Generic 8-byte raw payload. Detail page: https://www.isobus.net/isobus/pGNAndSPN/16020?type=PGN. Signal-level enrichment via PR welcome  see CONTRIBUTING.md.";
CM_ SG_ 2147548714 Auxiliary_valve_10_measured_flow "Generic 8-byte raw payload. Detail page: https://www.isobus.net/isobus/pGNAndSPN/16026?type=PGN. Signal-level enrichment via PR welcome  see CONTRIBUTING.md.";
CM_ SG_ 2147548715 Auxiliary_valve_11_measured_flow "Generic 8-byte raw payload. Detail page: https://www.isobus.net/isobus/pGNAndSPN/16032?type=PGN. Signal-level enrichment via PR welcome  see CONTRIBUTING.md.";
CM_ SG_ 2147548716 Auxiliary_valve_12_measured_flow "Generic 8-byte raw payload. Detail page: https://www.isobus.net/isobus/pGNAndSPN/16038?type=PGN. Signal-level enrichment via PR welcome  see CONTRIBUTING.md.";
CM_ SG_ 2147548717 Auxiliary_valve_13_measured_flow "Generic 8-byte raw payload. Detail page: https://www.isobus.net/isobus/pGNAndSPN/16044?type=PGN. Signal-level enrichment via PR welcome  see CONTRIBUTING.md.";
CM_ SG_ 2147548718 Auxiliary_valve_14_measured_flow "Generic 8-byte raw payload. Detail page: https://www.isobus.net/isobus/pGNAndSPN/16050?type=PGN. Signal-level enrichment via PR welcome  see CONTRIBUTING.md.";
CM_ SG_ 2147548719 Auxiliary_valve_15_measured_flow "Generic 8-byte raw payload. Detail page: https://www.isobus.net/isobus/pGNAndSPN/16056?type=PGN. Signal-level enrichment via PR welcome  see CONTRIBUTING.md.";
CM_ SG_ 2147548720 Auxiliary_valve_0_command_RawPay "Generic 8-byte raw payload. Detail page: https://www.isobus.net/isobus/pGNAndSPN/16061?type=PGN. Signal-level enrichment via PR welcome  see CONTRIBUTING.md.";
CM_ SG_ 2147548721 Auxiliary_valve_1_command_RawPay "Generic 8-byte raw payload. Detail page: https://www.isobus.net/isobus/pGNAndSPN/16066?type=PGN. Signal-level enrichment via PR welcome  see CONTRIBUTING.md.";
CM_ SG_ 2147548722 Auxiliary_valve_2_command_RawPay "Generic 8-byte raw payload. Detail page: https://www.isobus.net/isobus/pGNAndSPN/16071?type=PGN. Signal-level enrichment via PR welcome  see CONTRIBUTING.md.";
CM_ SG_ 2147548723 Auxiliary_valve_3_command_RawPay "Generic 8-byte raw payload. Detail page: https://www.isobus.net/isobus/pGNAndSPN/16076?type=PGN. Signal-level enrichment via PR welcome  see CONTRIBUTING.md.";
CM_ SG_ 2147548724 Auxiliary_valve_4_command_RawPay "Generic 8-byte raw payload. Detail page: https://www.isobus.net/isobus/pGNAndSPN/16081?type=PGN. Signal-level enrichment via PR welcome  see CONTRIBUTING.md.";
CM_ SG_ 2147548725 Auxiliary_valve_5_command_RawPay "Generic 8-byte raw payload. Detail page: https://www.isobus.net/isobus/pGNAndSPN/16086?type=PGN. Signal-level enrichment via PR welcome  see CONTRIBUTING.md.";
CM_ SG_ 2147548726 Auxiliary_valve_6_command_RawPay "Generic 8-byte raw payload. Detail page: https://www.isobus.net/isobus/pGNAndSPN/16091?type=PGN. Signal-level enrichment via PR welcome  see CONTRIBUTING.md.";
CM_ SG_ 2147548727 Auxiliary_valve_7_command_RawPay "Generic 8-byte raw payload. Detail page: https://www.isobus.net/isobus/pGNAndSPN/16096?type=PGN. Signal-level enrichment via PR welcome  see CONTRIBUTING.md.";
CM_ SG_ 2147548728 Auxiliary_valve_8_command_RawPay "Generic 8-byte raw payload. Detail page: https://www.isobus.net/isobus/pGNAndSPN/16101?type=PGN. Signal-level enrichment via PR welcome  see CONTRIBUTING.md.";
CM_ SG_ 2147548729 Auxiliary_valve_9_command_RawPay "Generic 8-byte raw payload. Detail page: https://www.isobus.net/isobus/pGNAndSPN/16106?type=PGN. Signal-level enrichment via PR welcome  see CONTRIBUTING.md.";
CM_ SG_ 2147548730 Auxiliary_valve_10_command_RawPa "Generic 8-byte raw payload. Detail page: https://www.isobus.net/isobus/pGNAndSPN/16111?type=PGN. Signal-level enrichment via PR welcome  see CONTRIBUTING.md.";
CM_ SG_ 2147548731 Auxiliary_valve_11_command_RawPa "Generic 8-byte raw payload. Detail page: https://www.isobus.net/isobus/pGNAndSPN/16116?type=PGN. Signal-level enrichment via PR welcome  see CONTRIBUTING.md.";
CM_ SG_ 2147548732 Auxiliary_valve_12_command_RawPa "Generic 8-byte raw payload. Detail page: https://www.isobus.net/isobus/pGNAndSPN/16121?type=PGN. Signal-level enrichment via PR welcome  see CONTRIBUTING.md.";
CM_ SG_ 2147548733 Auxiliary_valve_13_command_RawPa "Generic 8-byte raw payload. Detail page: https://www.isobus.net/isobus/pGNAndSPN/16126?type=PGN. Signal-level enrichment via PR welcome  see CONTRIBUTING.md.";
CM_ SG_ 2147548734 Auxiliary_valve_14_command_RawPa "Generic 8-byte raw payload. Detail page: https://www.isobus.net/isobus/pGNAndSPN/16131?type=PGN. Signal-level enrichment via PR welcome  see CONTRIBUTING.md.";
CM_ SG_ 2147548735 Auxiliary_valve_15_command_RawPa "Generic 8-byte raw payload. Detail page: https://www.isobus.net/isobus/pGNAndSPN/16136?type=PGN. Signal-level enrichment via PR welcome  see CONTRIBUTING.md.";
CM_ SG_ 2147548736 Lighting_Data_RawPayload "Generic 8-byte raw payload. Detail page: https://www.isobus.net/isobus/pGNAndSPN/16167?type=PGN. Signal-level enrichment via PR welcome  see CONTRIBUTING.md.";
CM_ SG_ 2147548737 Lighting_command_RawPayload "Generic 8-byte raw payload. Detail page: https://www.isobus.net/isobus/pGNAndSPN/16199?type=PGN. Signal-level enrichment via PR welcome  see CONTRIBUTING.md.";
CM_ SG_ 2147548738 Hitch_and_PTO_commands_RawPayloa "Generic 8-byte raw payload. Detail page: https://www.isobus.net/isobus/pGNAndSPN/16209?type=PGN. Signal-level enrichment via PR welcome  see CONTRIBUTING.md.";
CM_ SG_ 2147548739 Primary_or_Rear_Power_Take_off_O "Generic 8-byte raw payload. Detail page: https://www.isobus.net/isobus/pGNAndSPN/16219?type=PGN. Signal-level enrichment via PR welcome  see CONTRIBUTING.md.";
CM_ SG_ 2147548740 Secondary_or_Front_Power_Take_of "Generic 8-byte raw payload. Detail page: https://www.isobus.net/isobus/pGNAndSPN/16229?type=PGN. Signal-level enrichment via PR welcome  see CONTRIBUTING.md.";
CM_ SG_ 2147548741 Primary_or_Rear_Hitch_Status_Raw "Generic 8-byte raw payload. Detail page: https://www.isobus.net/isobus/pGNAndSPN/16235?type=PGN. Signal-level enrichment via PR welcome  see CONTRIBUTING.md.";
CM_ SG_ 2147548742 Secondary_or_Front_Hitch_Status_ "Generic 8-byte raw payload. Detail page: https://www.isobus.net/isobus/pGNAndSPN/16241?type=PGN. Signal-level enrichment via PR welcome  see CONTRIBUTING.md.";
CM_ SG_ 2147548746 Electronic_Transmission_Controll "Generic 8-byte raw payload. Detail page: https://www.isobus.net/isobus/pGNAndSPN/16285?type=PGN. Signal-level enrichment via PR welcome  see CONTRIBUTING.md.";
CM_ SG_ 2147548747 Transmission_Configuration_2_Raw "Generic 8-byte raw payload. Detail page: https://www.isobus.net/isobus/pGNAndSPN/16290?type=PGN. Signal-level enrichment via PR welcome  see CONTRIBUTING.md.";
CM_ SG_ 2147548748 Military_Lighting_Command_RawPay "Generic 8-byte raw payload. Detail page: https://www.isobus.net/isobus/pGNAndSPN/16298?type=PGN. Signal-level enrichment via PR welcome  see CONTRIBUTING.md.";
CM_ SG_ 2147548749 Total_Averaged_Information_RawPa "Generic 8-byte raw payload. Detail page: https://www.isobus.net/isobus/pGNAndSPN/16300?type=PGN. Signal-level enrichment via PR welcome  see CONTRIBUTING.md.";
CM_ SG_ 2147548750 Door_Control_1_RawPayload "Generic 8-byte raw payload. Detail page: https://www.isobus.net/isobus/pGNAndSPN/16303?type=PGN. Signal-level enrichment via PR welcome  see CONTRIBUTING.md.";
CM_ SG_ 2147548751 Vehicle_Dynamic_Stability_Contro "Generic 8-byte raw payload. Detail page: https://www.isobus.net/isobus/pGNAndSPN/16311?type=PGN. Signal-level enrichment via PR welcome  see CONTRIBUTING.md.";
CM_ SG_ 2147548752 Battery_Temperature_RawPayload "Generic 8-byte raw payload. Detail page: https://www.isobus.net/isobus/pGNAndSPN/16315?type=PGN. Signal-level enrichment via PR welcome  see CONTRIBUTING.md.";
CM_ SG_ 2147548753 Adaptive_Cruise_Control_Operator "Generic 8-byte raw payload. Detail page: https://www.isobus.net/isobus/pGNAndSPN/16317?type=PGN. Signal-level enrichment via PR welcome  see CONTRIBUTING.md.";
CM_ SG_ 2147548754 Vehicle_Electrical_Power_3_RawPa "Generic 8-byte raw payload. Detail page: https://www.isobus.net/isobus/pGNAndSPN/16321?type=PGN. Signal-level enrichment via PR welcome  see CONTRIBUTING.md.";
CM_ SG_ 2147548755 Retarder_Continuous_Torque_Speed "Generic 8-byte raw payload. Detail page: https://www.isobus.net/isobus/pGNAndSPN/16329?type=PGN. Signal-level enrichment via PR welcome  see CONTRIBUTING.md.";
CM_ SG_ 2147548756 Engine_Continuous_Torque_Speed_L "Generic 8-byte raw payload. Detail page: https://www.isobus.net/isobus/pGNAndSPN/16337?type=PGN. Signal-level enrichment via PR welcome  see CONTRIBUTING.md.";
CM_ SG_ 2147548757 Gaseous_Fuel_Properties_RawPaylo "Generic 8-byte raw payload. Detail page: https://www.isobus.net/isobus/pGNAndSPN/16340?type=PGN. Signal-level enrichment via PR welcome  see CONTRIBUTING.md.";
CM_ SG_ 2147548758 Aftertreatment_1_Diesel_Exhaust_ "Generic 8-byte raw payload. Detail page: https://www.isobus.net/isobus/pGNAndSPN/16349?type=PGN. Signal-level enrichment via PR welcome  see CONTRIBUTING.md.";
CM_ SG_ 2147548759 Air_Suspension_Control_5_RawPayl "Generic 8-byte raw payload. Detail page: https://www.isobus.net/isobus/pGNAndSPN/16355?type=PGN. Signal-level enrichment via PR welcome  see CONTRIBUTING.md.";
CM_ SG_ 2147548760 Air_Suspension_Control_4_RawPayl "Generic 8-byte raw payload. Detail page: https://www.isobus.net/isobus/pGNAndSPN/16359?type=PGN. Signal-level enrichment via PR welcome  see CONTRIBUTING.md.";
CM_ SG_ 2147548761 Air_Suspension_Control_3_RawPayl "Generic 8-byte raw payload. Detail page: https://www.isobus.net/isobus/pGNAndSPN/16363?type=PGN. Signal-level enrichment via PR welcome  see CONTRIBUTING.md.";
CM_ SG_ 2147548762 Air_Suspension_Control_1_RawPayl "Generic 8-byte raw payload. Detail page: https://www.isobus.net/isobus/pGNAndSPN/16388?type=PGN. Signal-level enrichment via PR welcome  see CONTRIBUTING.md.";
CM_ SG_ 2147548763 Forward_Lane_Image_2_RawPayload "Generic 8-byte raw payload. Detail page: https://www.isobus.net/isobus/pGNAndSPN/16397?type=PGN. Signal-level enrichment via PR welcome  see CONTRIBUTING.md.";
CM_ SG_ 2147548764 Running_Gear_Equipment_2_2_RawPa "Generic 8-byte raw payload. Detail page: https://www.isobus.net/isobus/pGNAndSPN/16398?type=PGN. Signal-level enrichment via PR welcome  see CONTRIBUTING.md.";
CM_ SG_ 2147548765 General_Purpose_Message_1_2_RawP "Generic 8-byte raw payload. Detail page: https://www.isobus.net/isobus/pGNAndSPN/16399?type=PGN. Signal-level enrichment via PR welcome  see CONTRIBUTING.md.";
CM_ SG_ 2147548766 Running_Gear_Equipment_2_3_RawPa "Generic 8-byte raw payload. Detail page: https://www.isobus.net/isobus/pGNAndSPN/16400?type=PGN. Signal-level enrichment via PR welcome  see CONTRIBUTING.md.";
CM_ SG_ 2147548767 General_Purpose_Message_1_3_RawP "Generic 8-byte raw payload. Detail page: https://www.isobus.net/isobus/pGNAndSPN/16401?type=PGN. Signal-level enrichment via PR welcome  see CONTRIBUTING.md.";
CM_ SG_ 2147548768 General_Purpose_Message_2_3_RawP "Generic 8-byte raw payload. Detail page: https://www.isobus.net/isobus/pGNAndSPN/16402?type=PGN. Signal-level enrichment via PR welcome  see CONTRIBUTING.md.";
CM_ SG_ 2147548769 General_Purpose_Message_1_4_RawP "Generic 8-byte raw payload. Detail page: https://www.isobus.net/isobus/pGNAndSPN/16403?type=PGN. Signal-level enrichment via PR welcome  see CONTRIBUTING.md.";
CM_ SG_ 2147548770 General_Purpose_Message_2_4_RawP "Generic 8-byte raw payload. Detail page: https://www.isobus.net/isobus/pGNAndSPN/16404?type=PGN. Signal-level enrichment via PR welcome  see CONTRIBUTING.md.";
CM_ SG_ 2147548771 General_Purpose_Message_1_5_RawP "Generic 8-byte raw payload. Detail page: https://www.isobus.net/isobus/pGNAndSPN/16405?type=PGN. Signal-level enrichment via PR welcome  see CONTRIBUTING.md.";
CM_ SG_ 2147548772 General_Purpose_Message_2_5_RawP "Generic 8-byte raw payload. Detail page: https://www.isobus.net/isobus/pGNAndSPN/16406?type=PGN. Signal-level enrichment via PR welcome  see CONTRIBUTING.md.";
CM_ SG_ 2147548773 General_Purpose_Message_1_6_RawP "Generic 8-byte raw payload. Detail page: https://www.isobus.net/isobus/pGNAndSPN/16407?type=PGN. Signal-level enrichment via PR welcome  see CONTRIBUTING.md.";
CM_ SG_ 2147548774 Battery_Main_Switch_Information_ "Generic 8-byte raw payload. Detail page: https://www.isobus.net/isobus/pGNAndSPN/16408?type=PGN. Signal-level enrichment via PR welcome  see CONTRIBUTING.md.";
CM_ SG_ 2147548775 Climate_Control_Configuration_Ra "Generic 8-byte raw payload. Detail page: https://www.isobus.net/isobus/pGNAndSPN/16409?type=PGN. Signal-level enrichment via PR welcome  see CONTRIBUTING.md.";
CM_ SG_ 2147548776 Vehicle_Fluids_RawPayload "Generic 8-byte raw payload. Detail page: https://www.isobus.net/isobus/pGNAndSPN/16413?type=PGN. Signal-level enrichment via PR welcome  see CONTRIBUTING.md.";
CM_ SG_ 2147548777 Engine_Temperature_3_RawPayload "Generic 8-byte raw payload. Detail page: https://www.isobus.net/isobus/pGNAndSPN/16417?type=PGN. Signal-level enrichment via PR welcome  see CONTRIBUTING.md.";
CM_ SG_ 2147548778 Engine_Fuel_Lube_Systems_RawPayl "Generic 8-byte raw payload. Detail page: https://www.isobus.net/isobus/pGNAndSPN/16430?type=PGN. Signal-level enrichment via PR welcome  see CONTRIBUTING.md.";
CM_ SG_ 2147548779 Driver_s_Identification_RawPaylo "Generic 8-byte raw payload. Detail page: https://www.isobus.net/isobus/pGNAndSPN/16432?type=PGN. Signal-level enrichment via PR welcome  see CONTRIBUTING.md.";
CM_ SG_ 2147548780 Tachograph_RawPayload "Generic 8-byte raw payload. Detail page: https://www.isobus.net/isobus/pGNAndSPN/16446?type=PGN. Signal-level enrichment via PR welcome  see CONTRIBUTING.md.";
CM_ SG_ 2147548781 Heater_Information_RawPayload "Generic 8-byte raw payload. Detail page: https://www.isobus.net/isobus/pGNAndSPN/16455?type=PGN. Signal-level enrichment via PR welcome  see CONTRIBUTING.md.";
CM_ SG_ 2147548782 High_Resolution_Wheel_Speed_RawP "Generic 8-byte raw payload. Detail page: https://www.isobus.net/isobus/pGNAndSPN/16459?type=PGN. Signal-level enrichment via PR welcome  see CONTRIBUTING.md.";
CM_ SG_ 2147548783 Adaptive_Cruise_Control_1_RawPay "Generic 8-byte raw payload. Detail page: https://www.isobus.net/isobus/pGNAndSPN/16469?type=PGN. Signal-level enrichment via PR welcome  see CONTRIBUTING.md.";
CM_ SG_ 2147548784 Combination_Vehicle_Weight_RawPa "Generic 8-byte raw payload. Detail page: https://www.isobus.net/isobus/pGNAndSPN/16472?type=PGN. Signal-level enrichment via PR welcome  see CONTRIBUTING.md.";
CM_ SG_ 2147548785 Laser_Tracer_Position_RawPayload "Generic 8-byte raw payload. Detail page: https://www.isobus.net/isobus/pGNAndSPN/16477?type=PGN. Signal-level enrichment via PR welcome  see CONTRIBUTING.md.";
CM_ SG_ 2147548786 Laser_Leveling_System_Blade_Cont "Generic 8-byte raw payload. Detail page: https://www.isobus.net/isobus/pGNAndSPN/16482?type=PGN. Signal-level enrichment via PR welcome  see CONTRIBUTING.md.";
CM_ SG_ 2147548787 Laser_Receiver_Mast_Position_Raw "Generic 8-byte raw payload. Detail page: https://www.isobus.net/isobus/pGNAndSPN/16483?type=PGN. Signal-level enrichment via PR welcome  see CONTRIBUTING.md.";
CM_ SG_ 2147548788 Modify_Leveling_System_Control_S "Generic 8-byte raw payload. Detail page: https://www.isobus.net/isobus/pGNAndSPN/16485?type=PGN. Signal-level enrichment via PR welcome  see CONTRIBUTING.md.";
CM_ SG_ 2147548789 Laser_Leveling_System_Vertical_D "Generic 8-byte raw payload. Detail page: https://www.isobus.net/isobus/pGNAndSPN/16489?type=PGN. Signal-level enrichment via PR welcome  see CONTRIBUTING.md.";
CM_ SG_ 2147548790 Laser_Leveling_System_Vertical_P "Generic 8-byte raw payload. Detail page: https://www.isobus.net/isobus/pGNAndSPN/16494?type=PGN. Signal-level enrichment via PR welcome  see CONTRIBUTING.md.";
CM_ SG_ 2147548791 Auxiliary_Pressures_RawPayload "Generic 8-byte raw payload. Detail page: https://www.isobus.net/isobus/pGNAndSPN/16497?type=PGN. Signal-level enrichment via PR welcome  see CONTRIBUTING.md.";
CM_ SG_ 2147548792 Tire_Pressure_Control_Unit_Mode_ "Generic 8-byte raw payload. Detail page: https://www.isobus.net/isobus/pGNAndSPN/16508?type=PGN. Signal-level enrichment via PR welcome  see CONTRIBUTING.md.";
CM_ SG_ 2147548793 Tire_Pressure_Control_Unit_Targe "Generic 8-byte raw payload. Detail page: https://www.isobus.net/isobus/pGNAndSPN/16511?type=PGN. Signal-level enrichment via PR welcome  see CONTRIBUTING.md.";
CM_ SG_ 2147548794 Tire_Pressure_Control_Unit_Curre "Generic 8-byte raw payload. Detail page: https://www.isobus.net/isobus/pGNAndSPN/16514?type=PGN. Signal-level enrichment via PR welcome  see CONTRIBUTING.md.";
CM_ SG_ 2147548795 Combustion_Time_1_RawPayload "Generic 8-byte raw payload. Detail page: https://www.isobus.net/isobus/pGNAndSPN/16518?type=PGN. Signal-level enrichment via PR welcome  see CONTRIBUTING.md.";
CM_ SG_ 2147548796 Combustion_Time_2_RawPayload "Generic 8-byte raw payload. Detail page: https://www.isobus.net/isobus/pGNAndSPN/16522?type=PGN. Signal-level enrichment via PR welcome  see CONTRIBUTING.md.";
CM_ SG_ 2147548797 Combustion_Time_3_RawPayload "Generic 8-byte raw payload. Detail page: https://www.isobus.net/isobus/pGNAndSPN/16526?type=PGN. Signal-level enrichment via PR welcome  see CONTRIBUTING.md.";
CM_ SG_ 2147548798 Combustion_Time_4_RawPayload "Generic 8-byte raw payload. Detail page: https://www.isobus.net/isobus/pGNAndSPN/16530?type=PGN. Signal-level enrichment via PR welcome  see CONTRIBUTING.md.";
CM_ SG_ 2147548799 Combustion_Time_5_RawPayload "Generic 8-byte raw payload. Detail page: https://www.isobus.net/isobus/pGNAndSPN/16534?type=PGN. Signal-level enrichment via PR welcome  see CONTRIBUTING.md.";
CM_ SG_ 2147548800 Combustion_Time_6_RawPayload "Generic 8-byte raw payload. Detail page: https://www.isobus.net/isobus/pGNAndSPN/16536?type=PGN. Signal-level enrichment via PR welcome  see CONTRIBUTING.md.";
CM_ SG_ 2147548801 Fuel_Information_2_Gaseous_RawPa "Generic 8-byte raw payload. Detail page: https://www.isobus.net/isobus/pGNAndSPN/16542?type=PGN. Signal-level enrichment via PR welcome  see CONTRIBUTING.md.";
CM_ SG_ 2147548802 Ignition_Timing_1_RawPayload "Generic 8-byte raw payload. Detail page: https://www.isobus.net/isobus/pGNAndSPN/16546?type=PGN. Signal-level enrichment via PR welcome  see CONTRIBUTING.md.";
CM_ SG_ 2147548803 Ignition_Timing_2_RawPayload "Generic 8-byte raw payload. Detail page: https://www.isobus.net/isobus/pGNAndSPN/16550?type=PGN. Signal-level enrichment via PR welcome  see CONTRIBUTING.md.";
CM_ SG_ 2147548804 Ignition_Timing_3_RawPayload "Generic 8-byte raw payload. Detail page: https://www.isobus.net/isobus/pGNAndSPN/16554?type=PGN. Signal-level enrichment via PR welcome  see CONTRIBUTING.md.";
CM_ SG_ 2147548805 Ignition_Timing_4_RawPayload "Generic 8-byte raw payload. Detail page: https://www.isobus.net/isobus/pGNAndSPN/16558?type=PGN. Signal-level enrichment via PR welcome  see CONTRIBUTING.md.";
CM_ SG_ 2147548806 Ignition_Timing_5_RawPayload "Generic 8-byte raw payload. Detail page: https://www.isobus.net/isobus/pGNAndSPN/16562?type=PGN. Signal-level enrichment via PR welcome  see CONTRIBUTING.md.";
CM_ SG_ 2147548807 Ignition_Timing_6_RawPayload "Generic 8-byte raw payload. Detail page: https://www.isobus.net/isobus/pGNAndSPN/16566?type=PGN. Signal-level enrichment via PR welcome  see CONTRIBUTING.md.";
CM_ SG_ 2147548808 Ignition_Transformer_Secondary_O "Generic 8-byte raw payload. Detail page: https://www.isobus.net/isobus/pGNAndSPN/16574?type=PGN. Signal-level enrichment via PR welcome  see CONTRIBUTING.md.";
CM_ SG_ 2147548809 Ignition_Transformer_Secondary_O "Generic 8-byte raw payload. Detail page: https://www.isobus.net/isobus/pGNAndSPN/16582?type=PGN. Signal-level enrichment via PR welcome  see CONTRIBUTING.md.";
CM_ SG_ 2147548810 Ignition_Transformer_Secondary_O "Generic 8-byte raw payload. Detail page: https://www.isobus.net/isobus/pGNAndSPN/16586?type=PGN. Signal-level enrichment via PR welcome  see CONTRIBUTING.md.";
CM_ SG_ 2147548811 Gaseous_Fuel_Pressure_1_RawPaylo "Generic 8-byte raw payload. Detail page: https://www.isobus.net/isobus/pGNAndSPN/16590?type=PGN. Signal-level enrichment via PR welcome  see CONTRIBUTING.md.";
CM_ SG_ 2147548812 Auxiliary_Analog_Information_Raw "Generic 8-byte raw payload. Detail page: https://www.isobus.net/isobus/pGNAndSPN/16597?type=PGN. Signal-level enrichment via PR welcome  see CONTRIBUTING.md.";
CM_ SG_ 2147548813 Vehicle_Electrical_Power_2_RawPa "Generic 8-byte raw payload. Detail page: https://www.isobus.net/isobus/pGNAndSPN/16601?type=PGN. Signal-level enrichment via PR welcome  see CONTRIBUTING.md.";
CM_ SG_ 2147548814 Service_2_RawPayload "Generic 8-byte raw payload. Detail page: https://www.isobus.net/isobus/pGNAndSPN/16603?type=PGN. Signal-level enrichment via PR welcome  see CONTRIBUTING.md.";
CM_ SG_ 2147548815 Supply_Pressure_2_RawPayload "Generic 8-byte raw payload. Detail page: https://www.isobus.net/isobus/pGNAndSPN/16604?type=PGN. Signal-level enrichment via PR welcome  see CONTRIBUTING.md.";
CM_ SG_ 2147548816 Engine_Torque_History_RawPayload "Generic 8-byte raw payload. Detail page: https://www.isobus.net/isobus/pGNAndSPN/16623?type=PGN. Signal-level enrichment via PR welcome  see CONTRIBUTING.md.";
CM_ SG_ 2147548817 Fuel_Leakage_RawPayload "Generic 8-byte raw payload. Detail page: https://www.isobus.net/isobus/pGNAndSPN/16626?type=PGN. Signal-level enrichment via PR welcome  see CONTRIBUTING.md.";
CM_ SG_ 2147548818 Engine_Information_1_RawPayload "Generic 8-byte raw payload. Detail page: https://www.isobus.net/isobus/pGNAndSPN/16631?type=PGN. Signal-level enrichment via PR welcome  see CONTRIBUTING.md.";
CM_ SG_ 2147548819 Engine_Electrical_System_Module_ "Generic 8-byte raw payload. Detail page: https://www.isobus.net/isobus/pGNAndSPN/16634?type=PGN. Signal-level enrichment via PR welcome  see CONTRIBUTING.md.";
CM_ SG_ 2147548820 Engine_Auxiliary_Coolant_RawPayl "Generic 8-byte raw payload. Detail page: https://www.isobus.net/isobus/pGNAndSPN/16642?type=PGN. Signal-level enrichment via PR welcome  see CONTRIBUTING.md.";
CM_ SG_ 2147548821 Rebuild_Information_RawPayload "Generic 8-byte raw payload. Detail page: https://www.isobus.net/isobus/pGNAndSPN/16643?type=PGN. Signal-level enrichment via PR welcome  see CONTRIBUTING.md.";
CM_ SG_ 2147548822 Turbocharger_Wastegate_RawPayloa "Generic 8-byte raw payload. Detail page: https://www.isobus.net/isobus/pGNAndSPN/16652?type=PGN. Signal-level enrichment via PR welcome  see CONTRIBUTING.md.";
CM_ SG_ 2147548823 Turbocharger_Information_5_RawPa "Generic 8-byte raw payload. Detail page: https://www.isobus.net/isobus/pGNAndSPN/16656?type=PGN. Signal-level enrichment via PR welcome  see CONTRIBUTING.md.";
CM_ SG_ 2147548824 Turbocharger_Information_4_RawPa "Generic 8-byte raw payload. Detail page: https://www.isobus.net/isobus/pGNAndSPN/16660?type=PGN. Signal-level enrichment via PR welcome  see CONTRIBUTING.md.";
CM_ SG_ 2147548825 Turbocharger_Information_3_RawPa "Generic 8-byte raw payload. Detail page: https://www.isobus.net/isobus/pGNAndSPN/16664?type=PGN. Signal-level enrichment via PR welcome  see CONTRIBUTING.md.";
CM_ SG_ 2147548826 Turbocharger_Information_2_RawPa "Generic 8-byte raw payload. Detail page: https://www.isobus.net/isobus/pGNAndSPN/16668?type=PGN. Signal-level enrichment via PR welcome  see CONTRIBUTING.md.";
CM_ SG_ 2147548827 Turbocharger_Information_1_RawPa "Generic 8-byte raw payload. Detail page: https://www.isobus.net/isobus/pGNAndSPN/16672?type=PGN. Signal-level enrichment via PR welcome  see CONTRIBUTING.md.";
CM_ SG_ 2147548828 Main_Bearing_Temperature_3_RawPa "Generic 8-byte raw payload. Detail page: https://www.isobus.net/isobus/pGNAndSPN/16676?type=PGN. Signal-level enrichment via PR welcome  see CONTRIBUTING.md.";
CM_ SG_ 2147548829 Main_Bearing_Temperature_2_RawPa "Generic 8-byte raw payload. Detail page: https://www.isobus.net/isobus/pGNAndSPN/16680?type=PGN. Signal-level enrichment via PR welcome  see CONTRIBUTING.md.";
CM_ SG_ 2147548830 Main_Bearing_Temperature_1_RawPa "Generic 8-byte raw payload. Detail page: https://www.isobus.net/isobus/pGNAndSPN/16684?type=PGN. Signal-level enrichment via PR welcome  see CONTRIBUTING.md.";
CM_ SG_ 2147548831 Exhaust_Port_Temperature_5_RawPa "Generic 8-byte raw payload. Detail page: https://www.isobus.net/isobus/pGNAndSPN/16688?type=PGN. Signal-level enrichment via PR welcome  see CONTRIBUTING.md.";
CM_ SG_ 2147548832 Exhaust_Port_Temperature_4_RawPa "Generic 8-byte raw payload. Detail page: https://www.isobus.net/isobus/pGNAndSPN/16692?type=PGN. Signal-level enrichment via PR welcome  see CONTRIBUTING.md.";
CM_ SG_ 2147548833 Exhaust_Port_Temperature_3_RawPa "Generic 8-byte raw payload. Detail page: https://www.isobus.net/isobus/pGNAndSPN/16696?type=PGN. Signal-level enrichment via PR welcome  see CONTRIBUTING.md.";
CM_ SG_ 2147548834 Exhaust_Port_Temperature_2_RawPa "Generic 8-byte raw payload. Detail page: https://www.isobus.net/isobus/pGNAndSPN/16700?type=PGN. Signal-level enrichment via PR welcome  see CONTRIBUTING.md.";
CM_ SG_ 2147548835 Exhaust_Port_Temperature_1_RawPa "Generic 8-byte raw payload. Detail page: https://www.isobus.net/isobus/pGNAndSPN/16704?type=PGN. Signal-level enrichment via PR welcome  see CONTRIBUTING.md.";
CM_ SG_ 2147548836 Engine_Temperature_2_RawPayload "Generic 8-byte raw payload. Detail page: https://www.isobus.net/isobus/pGNAndSPN/16708?type=PGN. Signal-level enrichment via PR welcome  see CONTRIBUTING.md.";
CM_ SG_ 2147548837 Intake_Manifold_Information_2_Ra "Generic 8-byte raw payload. Detail page: https://www.isobus.net/isobus/pGNAndSPN/16715?type=PGN. Signal-level enrichment via PR welcome  see CONTRIBUTING.md.";
CM_ SG_ 2147548838 Intake_Manifold_Information_1_Ra "Generic 8-byte raw payload. Detail page: https://www.isobus.net/isobus/pGNAndSPN/16719?type=PGN. Signal-level enrichment via PR welcome  see CONTRIBUTING.md.";
CM_ SG_ 2147548839 Alternator_Temperature_1_RawPayl "Generic 8-byte raw payload. Detail page: https://www.isobus.net/isobus/pGNAndSPN/16727?type=PGN. Signal-level enrichment via PR welcome  see CONTRIBUTING.md.";
CM_ SG_ 2147548840 Articulation_Control_RawPayload "Generic 8-byte raw payload. Detail page: https://www.isobus.net/isobus/pGNAndSPN/16729?type=PGN. Signal-level enrichment via PR welcome  see CONTRIBUTING.md.";
CM_ SG_ 2147548841 Exhaust_Oxygen_1_RawPayload "Generic 8-byte raw payload. Detail page: https://www.isobus.net/isobus/pGNAndSPN/16734?type=PGN. Signal-level enrichment via PR welcome  see CONTRIBUTING.md.";
CM_ SG_ 2147548842 Alternate_Fuel_2_RawPayload "Generic 8-byte raw payload. Detail page: https://www.isobus.net/isobus/pGNAndSPN/16739?type=PGN. Signal-level enrichment via PR welcome  see CONTRIBUTING.md.";
CM_ SG_ 2147548843 Electronic_Transmission_Controll "Generic 8-byte raw payload. Detail page: https://www.isobus.net/isobus/pGNAndSPN/16743?type=PGN. Signal-level enrichment via PR welcome  see CONTRIBUTING.md.";
CM_ SG_ 2147548844 Wheel_Brake_Lining_Remaining_Inf "Generic 8-byte raw payload. Detail page: https://www.isobus.net/isobus/pGNAndSPN/16751?type=PGN. Signal-level enrichment via PR welcome  see CONTRIBUTING.md.";
CM_ SG_ 2147548845 Wheel_Application_Pressure_High_ "Generic 8-byte raw payload. Detail page: https://www.isobus.net/isobus/pGNAndSPN/16759?type=PGN. Signal-level enrichment via PR welcome  see CONTRIBUTING.md.";
CM_ SG_ 2147548846 Air_Supply_Pressure_RawPayload "Generic 8-byte raw payload. Detail page: https://www.isobus.net/isobus/pGNAndSPN/16767?type=PGN. Signal-level enrichment via PR welcome  see CONTRIBUTING.md.";
CM_ SG_ 2147548847 Fuel_Consumption_Gaseous_RawPayl "Generic 8-byte raw payload. Detail page: https://www.isobus.net/isobus/pGNAndSPN/16769?type=PGN. Signal-level enrichment via PR welcome  see CONTRIBUTING.md.";
CM_ SG_ 2147548848 Trip_Time_Information_2_RawPaylo "Generic 8-byte raw payload. Detail page: https://www.isobus.net/isobus/pGNAndSPN/16774?type=PGN. Signal-level enrichment via PR welcome  see CONTRIBUTING.md.";
CM_ SG_ 2147548849 ECU_History_RawPayload "Generic 8-byte raw payload. Detail page: https://www.isobus.net/isobus/pGNAndSPN/16776?type=PGN. Signal-level enrichment via PR welcome  see CONTRIBUTING.md.";
CM_ SG_ 2147548850 Fuel_Information_1_Gaseous_RawPa "Generic 8-byte raw payload. Detail page: https://www.isobus.net/isobus/pGNAndSPN/16779?type=PGN. Signal-level enrichment via PR welcome  see CONTRIBUTING.md.";
CM_ SG_ 2147548851 Fuel_Information_1_Liquid_RawPay "Generic 8-byte raw payload. Detail page: https://www.isobus.net/isobus/pGNAndSPN/16782?type=PGN. Signal-level enrichment via PR welcome  see CONTRIBUTING.md.";
CM_ SG_ 2147548852 Trip_Time_Information_1_RawPaylo "Generic 8-byte raw payload. Detail page: https://www.isobus.net/isobus/pGNAndSPN/16786?type=PGN. Signal-level enrichment via PR welcome  see CONTRIBUTING.md.";
CM_ SG_ 2147548853 Trip_Shutdown_Information_RawPay "Generic 8-byte raw payload. Detail page: https://www.isobus.net/isobus/pGNAndSPN/16790?type=PGN. Signal-level enrichment via PR welcome  see CONTRIBUTING.md.";
CM_ SG_ 2147548854 Trip_Vehicle_Speed_Cruise_Distan "Generic 8-byte raw payload. Detail page: https://www.isobus.net/isobus/pGNAndSPN/16792?type=PGN. Signal-level enrichment via PR welcome  see CONTRIBUTING.md.";
CM_ SG_ 2147548855 Engine_Speed_Load_Factor_Informa "Generic 8-byte raw payload. Detail page: https://www.isobus.net/isobus/pGNAndSPN/16797?type=PGN. Signal-level enrichment via PR welcome  see CONTRIBUTING.md.";
CM_ SG_ 2147548856 Trip_Fuel_Information_Gaseous_Ra "Generic 8-byte raw payload. Detail page: https://www.isobus.net/isobus/pGNAndSPN/16803?type=PGN. Signal-level enrichment via PR welcome  see CONTRIBUTING.md.";
CM_ SG_ 2147548857 Trip_Fuel_Information_Liquid_Raw "Generic 8-byte raw payload. Detail page: https://www.isobus.net/isobus/pGNAndSPN/16809?type=PGN. Signal-level enrichment via PR welcome  see CONTRIBUTING.md.";
CM_ SG_ 2147548858 Trip_Distance_Information_RawPay "Generic 8-byte raw payload. Detail page: https://www.isobus.net/isobus/pGNAndSPN/16812?type=PGN. Signal-level enrichment via PR welcome  see CONTRIBUTING.md.";
CM_ SG_ 2147548859 Trip_Fan_Information_RawPayload "Generic 8-byte raw payload. Detail page: https://www.isobus.net/isobus/pGNAndSPN/16816?type=PGN. Signal-level enrichment via PR welcome  see CONTRIBUTING.md.";
CM_ SG_ 2147548860 Compression_Service_Brake_Inform "Generic 8-byte raw payload. Detail page: https://www.isobus.net/isobus/pGNAndSPN/16820?type=PGN. Signal-level enrichment via PR welcome  see CONTRIBUTING.md.";
CM_ SG_ 2147548861 Fan_Drive_1_RawPayload "Generic 8-byte raw payload. Detail page: https://www.isobus.net/isobus/pGNAndSPN/16827?type=PGN. Signal-level enrichment via PR welcome  see CONTRIBUTING.md.";
CM_ SG_ 2147548862 Electronic_Engine_Controller_4_R "Generic 8-byte raw payload. Detail page: https://www.isobus.net/isobus/pGNAndSPN/16833?type=PGN. Signal-level enrichment via PR welcome  see CONTRIBUTING.md.";
CM_ SG_ 2147548863 Wheel_Speed_Information_RawPaylo "Generic 8-byte raw payload. Detail page: https://www.isobus.net/isobus/pGNAndSPN/16840?type=PGN. Signal-level enrichment via PR welcome  see CONTRIBUTING.md.";
CM_ SG_ 2147548864 Service_Information_RawPayload "Generic 8-byte raw payload. Detail page: https://www.isobus.net/isobus/pGNAndSPN/16846?type=PGN. Signal-level enrichment via PR welcome  see CONTRIBUTING.md.";
CM_ SG_ 2147548865 High_Resolution_Vehicle_Distance "Generic 8-byte raw payload. Detail page: https://www.isobus.net/isobus/pGNAndSPN/16848?type=PGN. Signal-level enrichment via PR welcome  see CONTRIBUTING.md.";
CM_ SG_ 2147548866 Electronic_Retarder_Controller_2 "Generic 8-byte raw payload. Detail page: https://www.isobus.net/isobus/pGNAndSPN/16856?type=PGN. Signal-level enrichment via PR welcome  see CONTRIBUTING.md.";
CM_ SG_ 2147548867 Electronic_Transmission_Controll "Generic 8-byte raw payload. Detail page: https://www.isobus.net/isobus/pGNAndSPN/16862?type=PGN. Signal-level enrichment via PR welcome  see CONTRIBUTING.md.";
CM_ SG_ 2147548868 Electronic_Brake_System_2_2_RawP "Generic 8-byte raw payload. Detail page: https://www.isobus.net/isobus/pGNAndSPN/16863?type=PGN. Signal-level enrichment via PR welcome  see CONTRIBUTING.md.";
CM_ SG_ 2147548869 Electronic_Transmission_Controll "Generic 8-byte raw payload. Detail page: https://www.isobus.net/isobus/pGNAndSPN/16865?type=PGN. Signal-level enrichment via PR welcome  see CONTRIBUTING.md.";
CM_ SG_ 2147548870 Electronic_Brake_System_2_3_RawP "Generic 8-byte raw payload. Detail page: https://www.isobus.net/isobus/pGNAndSPN/16866?type=PGN. Signal-level enrichment via PR welcome  see CONTRIBUTING.md.";
CM_ SG_ 2147548871 Electronic_Transmission_Controll "Generic 8-byte raw payload. Detail page: https://www.isobus.net/isobus/pGNAndSPN/16883?type=PGN. Signal-level enrichment via PR welcome  see CONTRIBUTING.md.";
CM_ SG_ 2147548872 General_Purpose_Message_2_2_RawP "Generic 8-byte raw payload. Detail page: https://www.isobus.net/isobus/pGNAndSPN/16884?type=PGN. Signal-level enrichment via PR welcome  see CONTRIBUTING.md.";
CM_ SG_ 2147548873 Electronic_Brake_System_1_2_RawP "Generic 8-byte raw payload. Detail page: https://www.isobus.net/isobus/pGNAndSPN/16885?type=PGN. Signal-level enrichment via PR welcome  see CONTRIBUTING.md.";
CM_ SG_ 2147548877 Freeze_Frame_Parameters_RawPaylo "Generic 8-byte raw payload. Detail page: https://www.isobus.net/isobus/pGNAndSPN/16900?type=PGN. Signal-level enrichment via PR welcome  see CONTRIBUTING.md.";
CM_ SG_ 2147548878 Diagnostic_Readiness_1_RawPayloa "Generic 8-byte raw payload. Detail page: https://www.isobus.net/isobus/pGNAndSPN/16906?type=PGN. Signal-level enrichment via PR welcome  see CONTRIBUTING.md.";
CM_ SG_ 2147548879 Emission_Related_Pending_Diagnos "Generic 8-byte raw payload. Detail page: https://www.isobus.net/isobus/pGNAndSPN/16918?type=PGN. Signal-level enrichment via PR welcome  see CONTRIBUTING.md.";
CM_ SG_ 2147548880 Test_Results_for_Non_continuousl "Generic 8-byte raw payload. Detail page: https://www.isobus.net/isobus/pGNAndSPN/16923?type=PGN. Signal-level enrichment via PR welcome  see CONTRIBUTING.md.";
CM_ SG_ 2147548881 Oxygen_Sensor_Test_Results_RawPa "Generic 8-byte raw payload. Detail page: https://www.isobus.net/isobus/pGNAndSPN/16924?type=PGN. Signal-level enrichment via PR welcome  see CONTRIBUTING.md.";
CM_ SG_ 2147548882 Non_Continuously_Monitored_Syste "Generic 8-byte raw payload. Detail page: https://www.isobus.net/isobus/pGNAndSPN/16925?type=PGN. Signal-level enrichment via PR welcome  see CONTRIBUTING.md.";
CM_ SG_ 2147548884 Emission_Related_MIL_On_Diagnost "Generic 8-byte raw payload. Detail page: https://www.isobus.net/isobus/pGNAndSPN/16938?type=PGN. Signal-level enrichment via PR welcome  see CONTRIBUTING.md.";
CM_ SG_ 2147548885 Alternator_Information_1_RawPayl "Generic 8-byte raw payload. Detail page: https://www.isobus.net/isobus/pGNAndSPN/16950?type=PGN. Signal-level enrichment via PR welcome  see CONTRIBUTING.md.";
CM_ SG_ 2147548886 Hybrid_or_EV_System_Inputs_1_Raw "Generic 8-byte raw payload. Detail page: https://www.isobus.net/isobus/pGNAndSPN/16966?type=PGN. Signal-level enrichment via PR welcome  see CONTRIBUTING.md.";
CM_ SG_ 2147548889 Auxiliary_Input_Output_Status_1_ "Generic 8-byte raw payload. Detail page: https://www.isobus.net/isobus/pGNAndSPN/16986?type=PGN. Signal-level enrichment via PR welcome  see CONTRIBUTING.md.";
CM_ SG_ 2147548891 Engine_Fluid_Level_Pressure_2_Ra "Generic 8-byte raw payload. Detail page: https://www.isobus.net/isobus/pGNAndSPN/16992?type=PGN. Signal-level enrichment via PR welcome  see CONTRIBUTING.md.";
CM_ SG_ 2147548892 Idle_Operation_RawPayload "Generic 8-byte raw payload. Detail page: https://www.isobus.net/isobus/pGNAndSPN/16994?type=PGN. Signal-level enrichment via PR welcome  see CONTRIBUTING.md.";
CM_ SG_ 2147548893 Turbocharger_RawPayload "Generic 8-byte raw payload. Detail page: https://www.isobus.net/isobus/pGNAndSPN/16998?type=PGN. Signal-level enrichment via PR welcome  see CONTRIBUTING.md.";
CM_ SG_ 2147548894 Engine_Air_Start_Pressure_RawPay "Generic 8-byte raw payload. Detail page: https://www.isobus.net/isobus/pGNAndSPN/17001?type=PGN. Signal-level enrichment via PR welcome  see CONTRIBUTING.md.";
CM_ SG_ 2147548895 Electronic_Engine_Controller_3_R "Generic 8-byte raw payload. Detail page: https://www.isobus.net/isobus/pGNAndSPN/17010?type=PGN. Signal-level enrichment via PR welcome  see CONTRIBUTING.md.";
CM_ SG_ 2147548896 Vehicle_Distance_RawPayload "Generic 8-byte raw payload. Detail page: https://www.isobus.net/isobus/pGNAndSPN/17012?type=PGN. Signal-level enrichment via PR welcome  see CONTRIBUTING.md.";
CM_ SG_ 2147548897 Retarder_Configuration_RawPayloa "Generic 8-byte raw payload. Detail page: https://www.isobus.net/isobus/pGNAndSPN/17026?type=PGN. Signal-level enrichment via PR welcome  see CONTRIBUTING.md.";
CM_ SG_ 2147548898 Transmission_Configuration_RawPa "Generic 8-byte raw payload. Detail page: https://www.isobus.net/isobus/pGNAndSPN/17029?type=PGN. Signal-level enrichment via PR welcome  see CONTRIBUTING.md.";
CM_ SG_ 2147548899 Engine_Configuration_1_RawPayloa "Generic 8-byte raw payload. Detail page: https://www.isobus.net/isobus/pGNAndSPN/17058?type=PGN. Signal-level enrichment via PR welcome  see CONTRIBUTING.md.";
CM_ SG_ 2147548900 Shutdown_RawPayload "Generic 8-byte raw payload. Detail page: https://www.isobus.net/isobus/pGNAndSPN/17081?type=PGN. Signal-level enrichment via PR welcome  see CONTRIBUTING.md.";
CM_ SG_ 2147548901 Engine_Hours_Revolutions_RawPayl "Generic 8-byte raw payload. Detail page: https://www.isobus.net/isobus/pGNAndSPN/17083?type=PGN. Signal-level enrichment via PR welcome  see CONTRIBUTING.md.";
CM_ SG_ 2147548903 Vehicle_Hours_RawPayload "Generic 8-byte raw payload. Detail page: https://www.isobus.net/isobus/pGNAndSPN/17093?type=PGN. Signal-level enrichment via PR welcome  see CONTRIBUTING.md.";
CM_ SG_ 2147548904 Vehicle_Direction_Speed_RawPaylo "Generic 8-byte raw payload. Detail page: https://www.isobus.net/isobus/pGNAndSPN/17097?type=PGN. Signal-level enrichment via PR welcome  see CONTRIBUTING.md.";
CM_ SG_ 2147548905 Fuel_Consumption_Liquid_1_RawPay "Generic 8-byte raw payload. Detail page: https://www.isobus.net/isobus/pGNAndSPN/17099?type=PGN. Signal-level enrichment via PR welcome  see CONTRIBUTING.md.";
CM_ SG_ 2147548906 Vehicle_Weight_RawPayload "Generic 8-byte raw payload. Detail page: https://www.isobus.net/isobus/pGNAndSPN/17103?type=PGN. Signal-level enrichment via PR welcome  see CONTRIBUTING.md.";
CM_ SG_ 2147548908 Vehicle_Identification_RawPayloa "Generic 8-byte raw payload. Detail page: https://www.isobus.net/isobus/pGNAndSPN/17108?type=PGN. Signal-level enrichment via PR welcome  see CONTRIBUTING.md.";
CM_ SG_ 2147548909 Cruise_Control_Vehicle_Speed_Set "Generic 8-byte raw payload. Detail page: https://www.isobus.net/isobus/pGNAndSPN/17118?type=PGN. Signal-level enrichment via PR welcome  see CONTRIBUTING.md.";
CM_ SG_ 2147548910 Engine_Temperature_1_RawPayload "Generic 8-byte raw payload. Detail page: https://www.isobus.net/isobus/pGNAndSPN/17124?type=PGN. Signal-level enrichment via PR welcome  see CONTRIBUTING.md.";
CM_ SG_ 2147548911 Engine_Fluid_Level_Pressure_1_Ra "Generic 8-byte raw payload. Detail page: https://www.isobus.net/isobus/pGNAndSPN/17131?type=PGN. Signal-level enrichment via PR welcome  see CONTRIBUTING.md.";
CM_ SG_ 2147548912 Power_Takeoff_Information_1_RawP "Generic 8-byte raw payload. Detail page: https://www.isobus.net/isobus/pGNAndSPN/17145?type=PGN. Signal-level enrichment via PR welcome  see CONTRIBUTING.md.";
CM_ SG_ 2147548913 Cruise_Control_Vehicle_Speed_1_R "Generic 8-byte raw payload. Detail page: https://www.isobus.net/isobus/pGNAndSPN/17165?type=PGN. Signal-level enrichment via PR welcome  see CONTRIBUTING.md.";
CM_ SG_ 2147548914 Fuel_Economy_Liquid_RawPayload "Generic 8-byte raw payload. Detail page: https://www.isobus.net/isobus/pGNAndSPN/17170?type=PGN. Signal-level enrichment via PR welcome  see CONTRIBUTING.md.";
CM_ SG_ 2147548915 Vehicle_Position_1_RawPayload "Generic 8-byte raw payload. Detail page: https://www.isobus.net/isobus/pGNAndSPN/17172?type=PGN. Signal-level enrichment via PR welcome  see CONTRIBUTING.md.";
CM_ SG_ 2147548916 Tire_Condition_Message_1_RawPayl "Generic 8-byte raw payload. Detail page: https://www.isobus.net/isobus/pGNAndSPN/17181?type=PGN. Signal-level enrichment via PR welcome  see CONTRIBUTING.md.";
CM_ SG_ 2147548917 Ambient_Conditions_RawPayload "Generic 8-byte raw payload. Detail page: https://www.isobus.net/isobus/pGNAndSPN/17186?type=PGN. Signal-level enrichment via PR welcome  see CONTRIBUTING.md.";
CM_ SG_ 2147548918 Intake_Exhaust_Conditions_1_RawP "Generic 8-byte raw payload. Detail page: https://www.isobus.net/isobus/pGNAndSPN/17193?type=PGN. Signal-level enrichment via PR welcome  see CONTRIBUTING.md.";
CM_ SG_ 2147548919 Vehicle_Electrical_Power_1_RawPa "Generic 8-byte raw payload. Detail page: https://www.isobus.net/isobus/pGNAndSPN/17198?type=PGN. Signal-level enrichment via PR welcome  see CONTRIBUTING.md.";
CM_ SG_ 2147548920 Transmission_Fluids_1_RawPayload "Generic 8-byte raw payload. Detail page: https://www.isobus.net/isobus/pGNAndSPN/17206?type=PGN. Signal-level enrichment via PR welcome  see CONTRIBUTING.md.";
CM_ SG_ 2147548921 Axle_Information_RawPayload "Generic 8-byte raw payload. Detail page: https://www.isobus.net/isobus/pGNAndSPN/17212?type=PGN. Signal-level enrichment via PR welcome  see CONTRIBUTING.md.";
CM_ SG_ 2147548922 Brakes_1_RawPayload "Generic 8-byte raw payload. Detail page: https://www.isobus.net/isobus/pGNAndSPN/17219?type=PGN. Signal-level enrichment via PR welcome  see CONTRIBUTING.md.";
CM_ SG_ 2147548923 Retarder_fluids_RawPayload "Generic 8-byte raw payload. Detail page: https://www.isobus.net/isobus/pGNAndSPN/17223?type=PGN. Signal-level enrichment via PR welcome  see CONTRIBUTING.md.";
CM_ SG_ 2147548924 Dash_Display_1_RawPayload "Generic 8-byte raw payload. Detail page: https://www.isobus.net/isobus/pGNAndSPN/17230?type=PGN. Signal-level enrichment via PR welcome  see CONTRIBUTING.md.";
CM_ SG_ 2147548925 Alternate_Fuel_1_RawPayload "Generic 8-byte raw payload. Detail page: https://www.isobus.net/isobus/pGNAndSPN/17235?type=PGN. Signal-level enrichment via PR welcome  see CONTRIBUTING.md.";
CM_ SG_ 2147548926 Auxiliary_Water_Pump_Pressure_Ra "Generic 8-byte raw payload. Detail page: https://www.isobus.net/isobus/pGNAndSPN/17236?type=PGN. Signal-level enrichment via PR welcome  see CONTRIBUTING.md.";
CM_ SG_ 2147548927 Operator_indicators_RawPayload "Generic 8-byte raw payload. Detail page: https://www.isobus.net/isobus/pGNAndSPN/17252?type=PGN. Signal-level enrichment via PR welcome  see CONTRIBUTING.md.";
CM_ SG_ 2147609856 NMEA_Request_Command_Acknowledge "Generic 8-byte raw payload. Detail page: https://www.isobus.net/isobus/pGNAndSPN/17509?type=PGN. Signal-level enrichment via PR welcome  see CONTRIBUTING.md.";
CM_ SG_ 2147610112 PGN_List_Transmit_Receive_PGN_s_ "Generic 8-byte raw payload. Detail page: https://www.isobus.net/isobus/pGNAndSPN/17510?type=PGN. Signal-level enrichment via PR welcome  see CONTRIBUTING.md.";
CM_ SG_ 2147610368 Proprietary_A2_RawPayload "Generic 8-byte raw payload. Detail page: https://www.isobus.net/isobus/pGNAndSPN/17511?type=PGN. Signal-level enrichment via PR welcome  see CONTRIBUTING.md.";
CM_ SG_ 2147610631 Alert_RawPayload "Generic 8-byte raw payload. Detail page: https://www.isobus.net/isobus/pGNAndSPN/17512?type=PGN. Signal-level enrichment via PR welcome  see CONTRIBUTING.md.";
CM_ SG_ 2147610632 Alert_Response_RawPayload "Generic 8-byte raw payload. Detail page: https://www.isobus.net/isobus/pGNAndSPN/17513?type=PGN. Signal-level enrichment via PR welcome  see CONTRIBUTING.md.";
CM_ SG_ 2147610633 Alert_Text_RawPayload "Generic 8-byte raw payload. Detail page: https://www.isobus.net/isobus/pGNAndSPN/17514?type=PGN. Signal-level enrichment via PR welcome  see CONTRIBUTING.md.";
CM_ SG_ 2147610634 Alert_Configuration_RawPayload "Generic 8-byte raw payload. Detail page: https://www.isobus.net/isobus/pGNAndSPN/17515?type=PGN. Signal-level enrichment via PR welcome  see CONTRIBUTING.md.";
CM_ SG_ 2147610635 Alert_Threshold_RawPayload "Generic 8-byte raw payload. Detail page: https://www.isobus.net/isobus/pGNAndSPN/17516?type=PGN. Signal-level enrichment via PR welcome  see CONTRIBUTING.md.";
CM_ SG_ 2147610636 Alert_Value_RawPayload "Generic 8-byte raw payload. Detail page: https://www.isobus.net/isobus/pGNAndSPN/17517?type=PGN. Signal-level enrichment via PR welcome  see CONTRIBUTING.md.";
CM_ SG_ 2147610640 System_Time_RawPayload "Generic 8-byte raw payload. Detail page: https://www.isobus.net/isobus/pGNAndSPN/17518?type=PGN. Signal-level enrichment via PR welcome  see CONTRIBUTING.md.";
CM_ SG_ 2147610641 Heartbeat_RawPayload "Generic 8-byte raw payload. Detail page: https://www.isobus.net/isobus/pGNAndSPN/17519?type=PGN. Signal-level enrichment via PR welcome  see CONTRIBUTING.md.";
CM_ SG_ 2147610644 Product_Information_RawPayload "Generic 8-byte raw payload. Detail page: https://www.isobus.net/isobus/pGNAndSPN/17520?type=PGN. Signal-level enrichment via PR welcome  see CONTRIBUTING.md.";
CM_ SG_ 2147610646 Configuration_Information_RawPay "Generic 8-byte raw payload. Detail page: https://www.isobus.net/isobus/pGNAndSPN/17521?type=PGN. Signal-level enrichment via PR welcome  see CONTRIBUTING.md.";
CM_ SG_ 2147610649 Cyclic_Alert_List_IEC_61924_2_Ra "Generic 8-byte raw payload. Detail page: https://www.isobus.net/isobus/pGNAndSPN/17522?type=PGN. Signal-level enrichment via PR welcome  see CONTRIBUTING.md.";
CM_ SG_ 2147610650 Responsibility_Transfer_Function "Generic 8-byte raw payload. Detail page: https://www.isobus.net/isobus/pGNAndSPN/17523?type=PGN. Signal-level enrichment via PR welcome  see CONTRIBUTING.md.";
CM_ SG_ 2147610881 Man_Overboard_Notification_MOB_R "Generic 8-byte raw payload. Detail page: https://www.isobus.net/isobus/pGNAndSPN/17524?type=PGN. Signal-level enrichment via PR welcome  see CONTRIBUTING.md.";
CM_ SG_ 2147610885 Heading_Track_Control_RawPayload "Generic 8-byte raw payload. Detail page: https://www.isobus.net/isobus/pGNAndSPN/17525?type=PGN. Signal-level enrichment via PR welcome  see CONTRIBUTING.md.";
CM_ SG_ 2147610893 Rudder_RawPayload "Generic 8-byte raw payload. Detail page: https://www.isobus.net/isobus/pGNAndSPN/17526?type=PGN. Signal-level enrichment via PR welcome  see CONTRIBUTING.md.";
CM_ SG_ 2147610900 Heave_RawPayload "Generic 8-byte raw payload. Detail page: https://www.isobus.net/isobus/pGNAndSPN/17529?type=PGN. Signal-level enrichment via PR welcome  see CONTRIBUTING.md.";
CM_ SG_ 2147610905 Attitude_RawPayload "Generic 8-byte raw payload. Detail page: https://www.isobus.net/isobus/pGNAndSPN/17530?type=PGN. Signal-level enrichment via PR welcome  see CONTRIBUTING.md.";
CM_ SG_ 2147610906 Magnetic_Variation_RawPayload "Generic 8-byte raw payload. Detail page: https://www.isobus.net/isobus/pGNAndSPN/17531?type=PGN. Signal-level enrichment via PR welcome  see CONTRIBUTING.md.";
CM_ SG_ 2147611136 Engine_Parameters_Rapid_Update_R "Generic 8-byte raw payload. Detail page: https://www.isobus.net/isobus/pGNAndSPN/17532?type=PGN. Signal-level enrichment via PR welcome  see CONTRIBUTING.md.";
CM_ SG_ 2147611137 Engine_Parameters_Dynamic_RawPay "Generic 8-byte raw payload. Detail page: https://www.isobus.net/isobus/pGNAndSPN/17533?type=PGN. Signal-level enrichment via PR welcome  see CONTRIBUTING.md.";
CM_ SG_ 2147611138 Electric_Drive_Status_Dynamic_Ra "Generic 8-byte raw payload. Detail page: https://www.isobus.net/isobus/pGNAndSPN/17534?type=PGN. Signal-level enrichment via PR welcome  see CONTRIBUTING.md.";
CM_ SG_ 2147611139 Electric_Energy_Storage_Status_D "Generic 8-byte raw payload. Detail page: https://www.isobus.net/isobus/pGNAndSPN/17535?type=PGN. Signal-level enrichment via PR welcome  see CONTRIBUTING.md.";
CM_ SG_ 2147611141 Transmission_Parameters_Dynamic_ "Generic 8-byte raw payload. Detail page: https://www.isobus.net/isobus/pGNAndSPN/17536?type=PGN. Signal-level enrichment via PR welcome  see CONTRIBUTING.md.";
CM_ SG_ 2147611142 Electric_Drive_Information_RawPa "Generic 8-byte raw payload. Detail page: https://www.isobus.net/isobus/pGNAndSPN/17537?type=PGN. Signal-level enrichment via PR welcome  see CONTRIBUTING.md.";
CM_ SG_ 2147611143 Electric_Energy_Storage_Informat "Generic 8-byte raw payload. Detail page: https://www.isobus.net/isobus/pGNAndSPN/17538?type=PGN. Signal-level enrichment via PR welcome  see CONTRIBUTING.md.";
CM_ SG_ 2147611144 Trip_Parameters_Vessel_RawPayloa "Generic 8-byte raw payload. Detail page: https://www.isobus.net/isobus/pGNAndSPN/17539?type=PGN. Signal-level enrichment via PR welcome  see CONTRIBUTING.md.";
CM_ SG_ 2147611145 Trip_Parameters_Small_Craft_RawP "Generic 8-byte raw payload. Detail page: https://www.isobus.net/isobus/pGNAndSPN/17540?type=PGN. Signal-level enrichment via PR welcome  see CONTRIBUTING.md.";
CM_ SG_ 2147611146 Engine_Parameters_Static_RawPayl "Generic 8-byte raw payload. Detail page: https://www.isobus.net/isobus/pGNAndSPN/17541?type=PGN. Signal-level enrichment via PR welcome  see CONTRIBUTING.md.";
CM_ SG_ 2147611148 Load_Controller_Connection_State "Generic 8-byte raw payload. Detail page: https://www.isobus.net/isobus/pGNAndSPN/17542?type=PGN. Signal-level enrichment via PR welcome  see CONTRIBUTING.md.";
CM_ SG_ 2147611149 Binary_Switch_Bank_Status_RawPay "Generic 8-byte raw payload. Detail page: https://www.isobus.net/isobus/pGNAndSPN/17543?type=PGN. Signal-level enrichment via PR welcome  see CONTRIBUTING.md.";
CM_ SG_ 2147611150 Switch_Bank_Control_RawPayload "Generic 8-byte raw payload. Detail page: https://www.isobus.net/isobus/pGNAndSPN/17544?type=PGN. Signal-level enrichment via PR welcome  see CONTRIBUTING.md.";
CM_ SG_ 2147611151 AC_Input_Status_RawPayload "Generic 8-byte raw payload. Detail page: https://www.isobus.net/isobus/pGNAndSPN/17545?type=PGN. Signal-level enrichment via PR welcome  see CONTRIBUTING.md.";
CM_ SG_ 2147611152 AC_Output_Status_RawPayload "Generic 8-byte raw payload. Detail page: https://www.isobus.net/isobus/pGNAndSPN/17546?type=PGN. Signal-level enrichment via PR welcome  see CONTRIBUTING.md.";
CM_ SG_ 2147611153 Fluid_Level_RawPayload "Generic 8-byte raw payload. Detail page: https://www.isobus.net/isobus/pGNAndSPN/17547?type=PGN. Signal-level enrichment via PR welcome  see CONTRIBUTING.md.";
CM_ SG_ 2147611154 DC_Detailed_Status_RawPayload "Generic 8-byte raw payload. Detail page: https://www.isobus.net/isobus/pGNAndSPN/17548?type=PGN. Signal-level enrichment via PR welcome  see CONTRIBUTING.md.";
CM_ SG_ 2147611155 Charger_Status_RawPayload "Generic 8-byte raw payload. Detail page: https://www.isobus.net/isobus/pGNAndSPN/17549?type=PGN. Signal-level enrichment via PR welcome  see CONTRIBUTING.md.";
CM_ SG_ 2147611156 Battery_Status_RawPayload "Generic 8-byte raw payload. Detail page: https://www.isobus.net/isobus/pGNAndSPN/17550?type=PGN. Signal-level enrichment via PR welcome  see CONTRIBUTING.md.";
CM_ SG_ 2147611157 Inverter_Status_RawPayload "Generic 8-byte raw payload. Detail page: https://www.isobus.net/isobus/pGNAndSPN/17551?type=PGN. Signal-level enrichment via PR welcome  see CONTRIBUTING.md.";
CM_ SG_ 2147611158 Charger_Configuration_Status_Raw "Generic 8-byte raw payload. Detail page: https://www.isobus.net/isobus/pGNAndSPN/17552?type=PGN. Signal-level enrichment via PR welcome  see CONTRIBUTING.md.";
CM_ SG_ 2147611159 Inverter_Configuration_Status_Ra "Generic 8-byte raw payload. Detail page: https://www.isobus.net/isobus/pGNAndSPN/17553?type=PGN. Signal-level enrichment via PR welcome  see CONTRIBUTING.md.";
CM_ SG_ 2147611160 AGS_Configuration_Status_RawPayl "Generic 8-byte raw payload. Detail page: https://www.isobus.net/isobus/pGNAndSPN/17554?type=PGN. Signal-level enrichment via PR welcome  see CONTRIBUTING.md.";
CM_ SG_ 2147611161 Battery_Configuration_Status_Raw "Generic 8-byte raw payload. Detail page: https://www.isobus.net/isobus/pGNAndSPN/17555?type=PGN. Signal-level enrichment via PR welcome  see CONTRIBUTING.md.";
CM_ SG_ 2147611162 AGS_Status_RawPayload "Generic 8-byte raw payload. Detail page: https://www.isobus.net/isobus/pGNAndSPN/17556?type=PGN. Signal-level enrichment via PR welcome  see CONTRIBUTING.md.";
CM_ SG_ 2147611392 AC_Power_Current_Phase_A_RawPayl "Generic 8-byte raw payload. Detail page: https://www.isobus.net/isobus/pGNAndSPN/17557?type=PGN. Signal-level enrichment via PR welcome  see CONTRIBUTING.md.";
CM_ SG_ 2147611393 AC_Power_Current_Phase_B_RawPayl "Generic 8-byte raw payload. Detail page: https://www.isobus.net/isobus/pGNAndSPN/17558?type=PGN. Signal-level enrichment via PR welcome  see CONTRIBUTING.md.";
CM_ SG_ 2147611394 AC_Power_Current_Phase_C_RawPayl "Generic 8-byte raw payload. Detail page: https://www.isobus.net/isobus/pGNAndSPN/17559?type=PGN. Signal-level enrichment via PR welcome  see CONTRIBUTING.md.";
CM_ SG_ 2147611395 AC_Voltage_Frequency_Phase_A_Raw "Generic 8-byte raw payload. Detail page: https://www.isobus.net/isobus/pGNAndSPN/17560?type=PGN. Signal-level enrichment via PR welcome  see CONTRIBUTING.md.";
CM_ SG_ 2147611396 AC_Voltage_Frequency_Phase_B_Raw "Generic 8-byte raw payload. Detail page: https://www.isobus.net/isobus/pGNAndSPN/17561?type=PGN. Signal-level enrichment via PR welcome  see CONTRIBUTING.md.";
CM_ SG_ 2147611397 AC_Voltage_Frequency_Phase_C_Raw "Generic 8-byte raw payload. Detail page: https://www.isobus.net/isobus/pGNAndSPN/17562?type=PGN. Signal-level enrichment via PR welcome  see CONTRIBUTING.md.";
CM_ SG_ 2147611398 Converter_Inverter_Charger_Statu "Generic 8-byte raw payload. Detail page: https://www.isobus.net/isobus/pGNAndSPN/17563?type=PGN. Signal-level enrichment via PR welcome  see CONTRIBUTING.md.";
CM_ SG_ 2147611399 DC_Voltage_Current_RawPayload "Generic 8-byte raw payload. Detail page: https://www.isobus.net/isobus/pGNAndSPN/17564?type=PGN. Signal-level enrichment via PR welcome  see CONTRIBUTING.md.";
CM_ SG_ 2147611648 Nautical_Leeway_Angle_RawPayload "Generic 8-byte raw payload. Detail page: https://www.isobus.net/isobus/pGNAndSPN/17565?type=PGN. Signal-level enrichment via PR welcome  see CONTRIBUTING.md.";
CM_ SG_ 2147611649 Vessel_Acceleration_RawPayload "Generic 8-byte raw payload. Detail page: https://www.isobus.net/isobus/pGNAndSPN/17566?type=PGN. Signal-level enrichment via PR welcome  see CONTRIBUTING.md.";
CM_ SG_ 2147611650 Electric_Drive_Status_Rapid_Upda "Generic 8-byte raw payload. Detail page: https://www.isobus.net/isobus/pGNAndSPN/17567?type=PGN. Signal-level enrichment via PR welcome  see CONTRIBUTING.md.";
CM_ SG_ 2147611651 Electric_Energy_Storage_Status_R "Generic 8-byte raw payload. Detail page: https://www.isobus.net/isobus/pGNAndSPN/17568?type=PGN. Signal-level enrichment via PR welcome  see CONTRIBUTING.md.";
CM_ SG_ 2147611654 Thruster_Control_Status_RawPaylo "Generic 8-byte raw payload. Detail page: https://www.isobus.net/isobus/pGNAndSPN/17569?type=PGN. Signal-level enrichment via PR welcome  see CONTRIBUTING.md.";
CM_ SG_ 2147611655 Thruster_Information_RawPayload "Generic 8-byte raw payload. Detail page: https://www.isobus.net/isobus/pGNAndSPN/17570?type=PGN. Signal-level enrichment via PR welcome  see CONTRIBUTING.md.";
CM_ SG_ 2147611656 Thruster_Motor_Status_RawPayload "Generic 8-byte raw payload. Detail page: https://www.isobus.net/isobus/pGNAndSPN/17571?type=PGN. Signal-level enrichment via PR welcome  see CONTRIBUTING.md.";
CM_ SG_ 2147611907 Speed_RawPayload "Generic 8-byte raw payload. Detail page: https://www.isobus.net/isobus/pGNAndSPN/17572?type=PGN. Signal-level enrichment via PR welcome  see CONTRIBUTING.md.";
CM_ SG_ 2147611915 Water_Depth_RawPayload "Generic 8-byte raw payload. Detail page: https://www.isobus.net/isobus/pGNAndSPN/17573?type=PGN. Signal-level enrichment via PR welcome  see CONTRIBUTING.md.";
CM_ SG_ 2147611923 Distance_Log_RawPayload "Generic 8-byte raw payload. Detail page: https://www.isobus.net/isobus/pGNAndSPN/17574?type=PGN. Signal-level enrichment via PR welcome  see CONTRIBUTING.md.";
CM_ SG_ 2147612168 Tracked_Target_Data_RawPayload "Generic 8-byte raw payload. Detail page: https://www.isobus.net/isobus/pGNAndSPN/17575?type=PGN. Signal-level enrichment via PR welcome  see CONTRIBUTING.md.";
CM_ SG_ 2147612186 Elevator_Car_Status_RawPayload "Generic 8-byte raw payload. Detail page: https://www.isobus.net/isobus/pGNAndSPN/17576?type=PGN. Signal-level enrichment via PR welcome  see CONTRIBUTING.md.";
CM_ SG_ 2147612416 Elevator_Motor_Control_RawPayloa "Generic 8-byte raw payload. Detail page: https://www.isobus.net/isobus/pGNAndSPN/17577?type=PGN. Signal-level enrichment via PR welcome  see CONTRIBUTING.md.";
CM_ SG_ 2147612417 Elevator_Deck_Push_Button_RawPay "Generic 8-byte raw payload. Detail page: https://www.isobus.net/isobus/pGNAndSPN/17578?type=PGN. Signal-level enrichment via PR welcome  see CONTRIBUTING.md.";
CM_ SG_ 2147612424 Windlass_Control_Status_RawPaylo "Generic 8-byte raw payload. Detail page: https://www.isobus.net/isobus/pGNAndSPN/17579?type=PGN. Signal-level enrichment via PR welcome  see CONTRIBUTING.md.";
CM_ SG_ 2147612425 Anchor_Windlass_Operating_Status "Generic 8-byte raw payload. Detail page: https://www.isobus.net/isobus/pGNAndSPN/17580?type=PGN. Signal-level enrichment via PR welcome  see CONTRIBUTING.md.";
CM_ SG_ 2147612426 Anchor_Windlass_Monitoring_Statu "Generic 8-byte raw payload. Detail page: https://www.isobus.net/isobus/pGNAndSPN/17581?type=PGN. Signal-level enrichment via PR welcome  see CONTRIBUTING.md.";
CM_ SG_ 2147612428 Linear_Actuator_Control_Status_R "Generic 8-byte raw payload. Detail page: https://www.isobus.net/isobus/pGNAndSPN/17582?type=PGN. Signal-level enrichment via PR welcome  see CONTRIBUTING.md.";
CM_ SG_ 2147612676 Altitude_Delta_High_Precision_Ra "Generic 8-byte raw payload. Detail page: https://www.isobus.net/isobus/pGNAndSPN/17586?type=PGN. Signal-level enrichment via PR welcome  see CONTRIBUTING.md.";

BA_DEF_ BO_ "SystemMessageLongSymbol" STRING;
BA_DEF_ SG_ "SystemSignalLongSymbol" STRING;
BA_ "SystemMessageLongSymbol" BO_ 2147548683 "VDMA_FE0B_Tractor_control_mode_command";
BA_ "SystemMessageLongSymbol" BO_ 2147548686 "VDMA_FE0E_Response_for_Repetition_Rate";
BA_ "SystemMessageLongSymbol" BO_ 2147548688 "VDMA_FE10_Auxiliary_valve_0_estimated_flow";
BA_ "SystemMessageLongSymbol" BO_ 2147548689 "VDMA_FE11_Auxiliary_valve_1_estimated_flow";
BA_ "SystemMessageLongSymbol" BO_ 2147548690 "VDMA_FE12_Auxiliary_valve_2_estimated_flow";
BA_ "SystemMessageLongSymbol" BO_ 2147548691 "VDMA_FE13_Auxiliary_valve_3_estimated_flow";
BA_ "SystemMessageLongSymbol" BO_ 2147548692 "VDMA_FE14_Auxiliary_valve_4_estimated_flow";
BA_ "SystemMessageLongSymbol" BO_ 2147548693 "VDMA_FE15_Auxiliary_valve_5_estimated_flow";
BA_ "SystemMessageLongSymbol" BO_ 2147548694 "VDMA_FE16_Auxiliary_valve_6_estimated_flow";
BA_ "SystemMessageLongSymbol" BO_ 2147548695 "VDMA_FE17_Auxiliary_valve_7_estimated_flow";
BA_ "SystemMessageLongSymbol" BO_ 2147548696 "VDMA_FE18_Auxiliary_valve_8_estimated_flow";
BA_ "SystemMessageLongSymbol" BO_ 2147548697 "VDMA_FE19_Auxiliary_valve_9_estimated_flow";
BA_ "SystemMessageLongSymbol" BO_ 2147548698 "VDMA_FE1A_Auxiliary_valve_10_estimated_flo";
BA_ "SystemMessageLongSymbol" BO_ 2147548699 "VDMA_FE1B_Auxiliary_valve_11_estimated_flo";
BA_ "SystemMessageLongSymbol" BO_ 2147548700 "VDMA_FE1C_Auxiliary_valve_12_estimated_flo";
BA_ "SystemMessageLongSymbol" BO_ 2147548701 "VDMA_FE1D_Auxiliary_valve_13_estimated_flo";
BA_ "SystemMessageLongSymbol" BO_ 2147548702 "VDMA_FE1E_Auxiliary_valve_14_estimated_flo";
BA_ "SystemMessageLongSymbol" BO_ 2147548703 "VDMA_FE1F_Auxiliary_valve_15_estimated_flo";
BA_ "SystemMessageLongSymbol" BO_ 2147548704 "VDMA_FE20_Auxiliary_valve_0_measured_flow";
BA_ "SystemMessageLongSymbol" BO_ 2147548705 "VDMA_FE21_Auxiliary_valve_1_measured_flow";
BA_ "SystemMessageLongSymbol" BO_ 2147548706 "VDMA_FE22_Auxiliary_valve_2_measured_flow";
BA_ "SystemMessageLongSymbol" BO_ 2147548707 "VDMA_FE23_Auxiliary_valve_3_measured_flow";
BA_ "SystemMessageLongSymbol" BO_ 2147548708 "VDMA_FE24_Auxiliary_valve_4_measured_flow";
BA_ "SystemMessageLongSymbol" BO_ 2147548709 "VDMA_FE25_Auxiliary_valve_5_measured_flow";
BA_ "SystemMessageLongSymbol" BO_ 2147548710 "VDMA_FE26_Auxiliary_valve_6_measured_flow";
BA_ "SystemMessageLongSymbol" BO_ 2147548711 "VDMA_FE27_Auxiliary_valve_7_measured_flow";
BA_ "SystemMessageLongSymbol" BO_ 2147548712 "VDMA_FE28_Auxiliary_valve_8_measured_flow";
BA_ "SystemMessageLongSymbol" BO_ 2147548713 "VDMA_FE29_Auxiliary_valve_9_measured_flow";
BA_ "SystemMessageLongSymbol" BO_ 2147548714 "VDMA_FE2A_Auxiliary_valve_10_measured_flow";
BA_ "SystemMessageLongSymbol" BO_ 2147548715 "VDMA_FE2B_Auxiliary_valve_11_measured_flow";
BA_ "SystemMessageLongSymbol" BO_ 2147548716 "VDMA_FE2C_Auxiliary_valve_12_measured_flow";
BA_ "SystemMessageLongSymbol" BO_ 2147548717 "VDMA_FE2D_Auxiliary_valve_13_measured_flow";
BA_ "SystemMessageLongSymbol" BO_ 2147548718 "VDMA_FE2E_Auxiliary_valve_14_measured_flow";
BA_ "SystemMessageLongSymbol" BO_ 2147548719 "VDMA_FE2F_Auxiliary_valve_15_measured_flow";
BA_ "SystemMessageLongSymbol" BO_ 2147548720 "VDMA_FE30_Auxiliary_valve_0_command";
BA_ "SystemMessageLongSymbol" BO_ 2147548721 "VDMA_FE31_Auxiliary_valve_1_command";
BA_ "SystemMessageLongSymbol" BO_ 2147548722 "VDMA_FE32_Auxiliary_valve_2_command";
BA_ "SystemMessageLongSymbol" BO_ 2147548723 "VDMA_FE33_Auxiliary_valve_3_command";
BA_ "SystemMessageLongSymbol" BO_ 2147548724 "VDMA_FE34_Auxiliary_valve_4_command";
BA_ "SystemMessageLongSymbol" BO_ 2147548725 "VDMA_FE35_Auxiliary_valve_5_command";
BA_ "SystemMessageLongSymbol" BO_ 2147548726 "VDMA_FE36_Auxiliary_valve_6_command";
BA_ "SystemMessageLongSymbol" BO_ 2147548727 "VDMA_FE37_Auxiliary_valve_7_command";
BA_ "SystemMessageLongSymbol" BO_ 2147548728 "VDMA_FE38_Auxiliary_valve_8_command";
BA_ "SystemMessageLongSymbol" BO_ 2147548729 "VDMA_FE39_Auxiliary_valve_9_command";
BA_ "SystemMessageLongSymbol" BO_ 2147548730 "VDMA_FE3A_Auxiliary_valve_10_command";
BA_ "SystemMessageLongSymbol" BO_ 2147548731 "VDMA_FE3B_Auxiliary_valve_11_command";
BA_ "SystemMessageLongSymbol" BO_ 2147548732 "VDMA_FE3C_Auxiliary_valve_12_command";
BA_ "SystemMessageLongSymbol" BO_ 2147548733 "VDMA_FE3D_Auxiliary_valve_13_command";
BA_ "SystemMessageLongSymbol" BO_ 2147548734 "VDMA_FE3E_Auxiliary_valve_14_command";
BA_ "SystemMessageLongSymbol" BO_ 2147548735 "VDMA_FE3F_Auxiliary_valve_15_command";
BA_ "SystemMessageLongSymbol" BO_ 2147548739 "VDMA_FE43_Primary_or_Rear_Power_Take_off_O";
BA_ "SystemMessageLongSymbol" BO_ 2147548740 "VDMA_FE44_Secondary_or_Front_Power_Take_of";
BA_ "SystemMessageLongSymbol" BO_ 2147548741 "VDMA_FE45_Primary_or_Rear_Hitch_Status";
BA_ "SystemMessageLongSymbol" BO_ 2147548742 "VDMA_FE46_Secondary_or_Front_Hitch_Status";
BA_ "SystemMessageLongSymbol" BO_ 2147548746 "VDMA_FE4A_Electronic_Transmission_Controll";
BA_ "SystemMessageLongSymbol" BO_ 2147548747 "VDMA_FE4B_Transmission_Configuration_2";
BA_ "SystemMessageLongSymbol" BO_ 2147548748 "VDMA_FE4C_Military_Lighting_Command";
BA_ "SystemMessageLongSymbol" BO_ 2147548749 "VDMA_FE4D_Total_Averaged_Information";
BA_ "SystemMessageLongSymbol" BO_ 2147548751 "VDMA_FE4F_Vehicle_Dynamic_Stability_Contro";
BA_ "SystemMessageLongSymbol" BO_ 2147548753 "VDMA_FE51_Adaptive_Cruise_Control_Operator";
BA_ "SystemMessageLongSymbol" BO_ 2147548754 "VDMA_FE52_Vehicle_Electrical_Power_3";
BA_ "SystemMessageLongSymbol" BO_ 2147548755 "VDMA_FE53_Retarder_Continuous_Torque_Speed";
BA_ "SystemMessageLongSymbol" BO_ 2147548756 "VDMA_FE54_Engine_Continuous_Torque_Speed_L";
BA_ "SystemMessageLongSymbol" BO_ 2147548757 "VDMA_FE55_Gaseous_Fuel_Properties";
BA_ "SystemMessageLongSymbol" BO_ 2147548758 "VDMA_FE56_Aftertreatment_1_Diesel_Exhaust_";
BA_ "SystemMessageLongSymbol" BO_ 2147548759 "VDMA_FE57_Air_Suspension_Control_5";
BA_ "SystemMessageLongSymbol" BO_ 2147548760 "VDMA_FE58_Air_Suspension_Control_4";
BA_ "SystemMessageLongSymbol" BO_ 2147548761 "VDMA_FE59_Air_Suspension_Control_3";
BA_ "SystemMessageLongSymbol" BO_ 2147548762 "VDMA_FE5A_Air_Suspension_Control_1";
BA_ "SystemMessageLongSymbol" BO_ 2147548764 "VDMA_FE5C_Running_Gear_Equipment_2_2";
BA_ "SystemMessageLongSymbol" BO_ 2147548765 "VDMA_FE5D_General_Purpose_Message_1_2";
BA_ "SystemMessageLongSymbol" BO_ 2147548766 "VDMA_FE5E_Running_Gear_Equipment_2_3";
BA_ "SystemMessageLongSymbol" BO_ 2147548767 "VDMA_FE5F_General_Purpose_Message_1_3";
BA_ "SystemMessageLongSymbol" BO_ 2147548768 "VDMA_FE60_General_Purpose_Message_2_3";
BA_ "SystemMessageLongSymbol" BO_ 2147548769 "VDMA_FE61_General_Purpose_Message_1_4";
BA_ "SystemMessageLongSymbol" BO_ 2147548770 "VDMA_FE62_General_Purpose_Message_2_4";
BA_ "SystemMessageLongSymbol" BO_ 2147548771 "VDMA_FE63_General_Purpose_Message_1_5";
BA_ "SystemMessageLongSymbol" BO_ 2147548772 "VDMA_FE64_General_Purpose_Message_2_5";
BA_ "SystemMessageLongSymbol" BO_ 2147548773 "VDMA_FE65_General_Purpose_Message_1_6";
BA_ "SystemMessageLongSymbol" BO_ 2147548774 "VDMA_FE66_Battery_Main_Switch_Information";
BA_ "SystemMessageLongSymbol" BO_ 2147548775 "VDMA_FE67_Climate_Control_Configuration";
BA_ "SystemMessageLongSymbol" BO_ 2147548778 "VDMA_FE6A_Engine_Fuel_Lube_Systems";
BA_ "SystemMessageLongSymbol" BO_ 2147548779 "VDMA_FE6B_Driver_s_Identification";
BA_ "SystemMessageLongSymbol" BO_ 2147548782 "VDMA_FE6E_High_Resolution_Wheel_Speed";
BA_ "SystemMessageLongSymbol" BO_ 2147548783 "VDMA_FE6F_Adaptive_Cruise_Control_1";
BA_ "SystemMessageLongSymbol" BO_ 2147548784 "VDMA_FE70_Combination_Vehicle_Weight";
BA_ "SystemMessageLongSymbol" BO_ 2147548786 "VDMA_FE72_Laser_Leveling_System_Blade_Cont";
BA_ "SystemMessageLongSymbol" BO_ 2147548787 "VDMA_FE73_Laser_Receiver_Mast_Position";
BA_ "SystemMessageLongSymbol" BO_ 2147548788 "VDMA_FE74_Modify_Leveling_System_Control_S";
BA_ "SystemMessageLongSymbol" BO_ 2147548789 "VDMA_FE75_Laser_Leveling_System_Vertical_D";
BA_ "SystemMessageLongSymbol" BO_ 2147548790 "VDMA_FE76_Laser_Leveling_System_Vertical_P";
BA_ "SystemMessageLongSymbol" BO_ 2147548792 "VDMA_FE78_Tire_Pressure_Control_Unit_Mode_";
BA_ "SystemMessageLongSymbol" BO_ 2147548793 "VDMA_FE79_Tire_Pressure_Control_Unit_Targe";
BA_ "SystemMessageLongSymbol" BO_ 2147548794 "VDMA_FE7A_Tire_Pressure_Control_Unit_Curre";
BA_ "SystemMessageLongSymbol" BO_ 2147548801 "VDMA_FE81_Fuel_Information_2_Gaseous";
BA_ "SystemMessageLongSymbol" BO_ 2147548808 "VDMA_FE88_Ignition_Transformer_Secondary_O";
BA_ "SystemMessageLongSymbol" BO_ 2147548809 "VDMA_FE89_Ignition_Transformer_Secondary_O";
BA_ "SystemMessageLongSymbol" BO_ 2147548810 "VDMA_FE8A_Ignition_Transformer_Secondary_O";
BA_ "SystemMessageLongSymbol" BO_ 2147548811 "VDMA_FE8B_Gaseous_Fuel_Pressure_1";
BA_ "SystemMessageLongSymbol" BO_ 2147548812 "VDMA_FE8C_Auxiliary_Analog_Information";
BA_ "SystemMessageLongSymbol" BO_ 2147548813 "VDMA_FE8D_Vehicle_Electrical_Power_2";
BA_ "SystemMessageLongSymbol" BO_ 2147548819 "VDMA_FE93_Engine_Electrical_System_Module_";
BA_ "SystemMessageLongSymbol" BO_ 2147548820 "VDMA_FE94_Engine_Auxiliary_Coolant";
BA_ "SystemMessageLongSymbol" BO_ 2147548823 "VDMA_FE97_Turbocharger_Information_5";
BA_ "SystemMessageLongSymbol" BO_ 2147548824 "VDMA_FE98_Turbocharger_Information_4";
BA_ "SystemMessageLongSymbol" BO_ 2147548825 "VDMA_FE99_Turbocharger_Information_3";
BA_ "SystemMessageLongSymbol" BO_ 2147548826 "VDMA_FE9A_Turbocharger_Information_2";
BA_ "SystemMessageLongSymbol" BO_ 2147548827 "VDMA_FE9B_Turbocharger_Information_1";
BA_ "SystemMessageLongSymbol" BO_ 2147548828 "VDMA_FE9C_Main_Bearing_Temperature_3";
BA_ "SystemMessageLongSymbol" BO_ 2147548829 "VDMA_FE9D_Main_Bearing_Temperature_2";
BA_ "SystemMessageLongSymbol" BO_ 2147548830 "VDMA_FE9E_Main_Bearing_Temperature_1";
BA_ "SystemMessageLongSymbol" BO_ 2147548831 "VDMA_FE9F_Exhaust_Port_Temperature_5";
BA_ "SystemMessageLongSymbol" BO_ 2147548832 "VDMA_FEA0_Exhaust_Port_Temperature_4";
BA_ "SystemMessageLongSymbol" BO_ 2147548833 "VDMA_FEA1_Exhaust_Port_Temperature_3";
BA_ "SystemMessageLongSymbol" BO_ 2147548834 "VDMA_FEA2_Exhaust_Port_Temperature_2";
BA_ "SystemMessageLongSymbol" BO_ 2147548835 "VDMA_FEA3_Exhaust_Port_Temperature_1";
BA_ "SystemMessageLongSymbol" BO_ 2147548837 "VDMA_FEA5_Intake_Manifold_Information_2";
BA_ "SystemMessageLongSymbol" BO_ 2147548838 "VDMA_FEA6_Intake_Manifold_Information_1";
BA_ "SystemMessageLongSymbol" BO_ 2147548839 "VDMA_FEA7_Alternator_Temperature_1";
BA_ "SystemMessageLongSymbol" BO_ 2147548843 "VDMA_FEAB_Electronic_Transmission_Controll";
BA_ "SystemMessageLongSymbol" BO_ 2147548844 "VDMA_FEAC_Wheel_Brake_Lining_Remaining_Inf";
BA_ "SystemMessageLongSymbol" BO_ 2147548845 "VDMA_FEAD_Wheel_Application_Pressure_High_";
BA_ "SystemMessageLongSymbol" BO_ 2147548847 "VDMA_FEAF_Fuel_Consumption_Gaseous";
BA_ "SystemMessageLongSymbol" BO_ 2147548848 "VDMA_FEB0_Trip_Time_Information_2";
BA_ "SystemMessageLongSymbol" BO_ 2147548850 "VDMA_FEB2_Fuel_Information_1_Gaseous";
BA_ "SystemMessageLongSymbol" BO_ 2147548851 "VDMA_FEB3_Fuel_Information_1_Liquid";
BA_ "SystemMessageLongSymbol" BO_ 2147548852 "VDMA_FEB4_Trip_Time_Information_1";
BA_ "SystemMessageLongSymbol" BO_ 2147548853 "VDMA_FEB5_Trip_Shutdown_Information";
BA_ "SystemMessageLongSymbol" BO_ 2147548854 "VDMA_FEB6_Trip_Vehicle_Speed_Cruise_Distan";
BA_ "SystemMessageLongSymbol" BO_ 2147548855 "VDMA_FEB7_Engine_Speed_Load_Factor_Informa";
BA_ "SystemMessageLongSymbol" BO_ 2147548856 "VDMA_FEB8_Trip_Fuel_Information_Gaseous";
BA_ "SystemMessageLongSymbol" BO_ 2147548857 "VDMA_FEB9_Trip_Fuel_Information_Liquid";
BA_ "SystemMessageLongSymbol" BO_ 2147548858 "VDMA_FEBA_Trip_Distance_Information";
BA_ "SystemMessageLongSymbol" BO_ 2147548860 "VDMA_FEBC_Compression_Service_Brake_Inform";
BA_ "SystemMessageLongSymbol" BO_ 2147548862 "VDMA_FEBE_Electronic_Engine_Controller_4";
BA_ "SystemMessageLongSymbol" BO_ 2147548863 "VDMA_FEBF_Wheel_Speed_Information";
BA_ "SystemMessageLongSymbol" BO_ 2147548865 "VDMA_FEC1_High_Resolution_Vehicle_Distance";
BA_ "SystemMessageLongSymbol" BO_ 2147548866 "VDMA_FEC2_Electronic_Retarder_Controller_2";
BA_ "SystemMessageLongSymbol" BO_ 2147548867 "VDMA_FEC3_Electronic_Transmission_Controll";
BA_ "SystemMessageLongSymbol" BO_ 2147548868 "VDMA_FEC4_Electronic_Brake_System_2_2";
BA_ "SystemMessageLongSymbol" BO_ 2147548869 "VDMA_FEC5_Electronic_Transmission_Controll";
BA_ "SystemMessageLongSymbol" BO_ 2147548870 "VDMA_FEC6_Electronic_Brake_System_2_3";
BA_ "SystemMessageLongSymbol" BO_ 2147548871 "VDMA_FEC7_Electronic_Transmission_Controll";
BA_ "SystemMessageLongSymbol" BO_ 2147548872 "VDMA_FEC8_General_Purpose_Message_2_2";
BA_ "SystemMessageLongSymbol" BO_ 2147548873 "VDMA_FEC9_Electronic_Brake_System_1_2";
BA_ "SystemMessageLongSymbol" BO_ 2147548877 "VDMA_FECD_Freeze_Frame_Parameters";
BA_ "SystemMessageLongSymbol" BO_ 2147548879 "VDMA_FECF_Emission_Related_Pending_Diagnos";
BA_ "SystemMessageLongSymbol" BO_ 2147548880 "VDMA_FED0_Test_Results_for_Non_continuousl";
BA_ "SystemMessageLongSymbol" BO_ 2147548881 "VDMA_FED1_Oxygen_Sensor_Test_Results";
BA_ "SystemMessageLongSymbol" BO_ 2147548882 "VDMA_FED2_Non_Continuously_Monitored_Syste";
BA_ "SystemMessageLongSymbol" BO_ 2147548884 "VDMA_FED4_Emission_Related_MIL_On_Diagnost";
BA_ "SystemMessageLongSymbol" BO_ 2147548885 "VDMA_FED5_Alternator_Information_1";
BA_ "SystemMessageLongSymbol" BO_ 2147548886 "VDMA_FED6_Hybrid_or_EV_System_Inputs_1";
BA_ "SystemMessageLongSymbol" BO_ 2147548889 "VDMA_FED9_Auxiliary_Input_Output_Status_1";
BA_ "SystemMessageLongSymbol" BO_ 2147548891 "VDMA_FEDB_Engine_Fluid_Level_Pressure_2";
BA_ "SystemMessageLongSymbol" BO_ 2147548894 "VDMA_FEDE_Engine_Air_Start_Pressure";
BA_ "SystemMessageLongSymbol" BO_ 2147548895 "VDMA_FEDF_Electronic_Engine_Controller_3";
BA_ "SystemMessageLongSymbol" BO_ 2147548898 "VDMA_FEE2_Transmission_Configuration";
BA_ "SystemMessageLongSymbol" BO_ 2147548901 "VDMA_FEE5_Engine_Hours_Revolutions";
BA_ "SystemMessageLongSymbol" BO_ 2147548904 "VDMA_FEE8_Vehicle_Direction_Speed";
BA_ "SystemMessageLongSymbol" BO_ 2147548905 "VDMA_FEE9_Fuel_Consumption_Liquid_1";
BA_ "SystemMessageLongSymbol" BO_ 2147548909 "VDMA_FEED_Cruise_Control_Vehicle_Speed_Set";
BA_ "SystemMessageLongSymbol" BO_ 2147548911 "VDMA_FEEF_Engine_Fluid_Level_Pressure_1";
BA_ "SystemMessageLongSymbol" BO_ 2147548912 "VDMA_FEF0_Power_Takeoff_Information_1";
BA_ "SystemMessageLongSymbol" BO_ 2147548913 "VDMA_FEF1_Cruise_Control_Vehicle_Speed_1";
BA_ "SystemMessageLongSymbol" BO_ 2147548916 "VDMA_FEF4_Tire_Condition_Message_1";
BA_ "SystemMessageLongSymbol" BO_ 2147548918 "VDMA_FEF6_Intake_Exhaust_Conditions_1";
BA_ "SystemMessageLongSymbol" BO_ 2147548919 "VDMA_FEF7_Vehicle_Electrical_Power_1";
BA_ "SystemMessageLongSymbol" BO_ 2147548926 "VDMA_FEFE_Auxiliary_Water_Pump_Pressure";
BA_ "SystemMessageLongSymbol" BO_ 2147609856 "VDMA_1ED00_NMEA_Request_Command_Acknowledge";
BA_ "SystemMessageLongSymbol" BO_ 2147610112 "VDMA_1EE00_PGN_List_Transmit_Receive_PGN_s_";
BA_ "SystemMessageLongSymbol" BO_ 2147610646 "VDMA_1F016_Configuration_Information";
BA_ "SystemMessageLongSymbol" BO_ 2147610649 "VDMA_1F019_Cyclic_Alert_List_IEC_61924_2";
BA_ "SystemMessageLongSymbol" BO_ 2147610650 "VDMA_1F01A_Responsibility_Transfer_Function";
BA_ "SystemMessageLongSymbol" BO_ 2147610881 "VDMA_1F101_Man_Overboard_Notification_MOB";
BA_ "SystemMessageLongSymbol" BO_ 2147611136 "VDMA_1F200_Engine_Parameters_Rapid_Update";
BA_ "SystemMessageLongSymbol" BO_ 2147611137 "VDMA_1F201_Engine_Parameters_Dynamic";
BA_ "SystemMessageLongSymbol" BO_ 2147611138 "VDMA_1F202_Electric_Drive_Status_Dynamic";
BA_ "SystemMessageLongSymbol" BO_ 2147611139 "VDMA_1F203_Electric_Energy_Storage_Status_D";
BA_ "SystemMessageLongSymbol" BO_ 2147611141 "VDMA_1F205_Transmission_Parameters_Dynamic";
BA_ "SystemMessageLongSymbol" BO_ 2147611142 "VDMA_1F206_Electric_Drive_Information";
BA_ "SystemMessageLongSymbol" BO_ 2147611143 "VDMA_1F207_Electric_Energy_Storage_Informat";
BA_ "SystemMessageLongSymbol" BO_ 2147611144 "VDMA_1F208_Trip_Parameters_Vessel";
BA_ "SystemMessageLongSymbol" BO_ 2147611145 "VDMA_1F209_Trip_Parameters_Small_Craft";
BA_ "SystemMessageLongSymbol" BO_ 2147611146 "VDMA_1F20A_Engine_Parameters_Static";
BA_ "SystemMessageLongSymbol" BO_ 2147611148 "VDMA_1F20C_Load_Controller_Connection_State";
BA_ "SystemMessageLongSymbol" BO_ 2147611149 "VDMA_1F20D_Binary_Switch_Bank_Status";
BA_ "SystemMessageLongSymbol" BO_ 2147611158 "VDMA_1F216_Charger_Configuration_Status";
BA_ "SystemMessageLongSymbol" BO_ 2147611159 "VDMA_1F217_Inverter_Configuration_Status";
BA_ "SystemMessageLongSymbol" BO_ 2147611160 "VDMA_1F218_AGS_Configuration_Status";
BA_ "SystemMessageLongSymbol" BO_ 2147611161 "VDMA_1F219_Battery_Configuration_Status";
BA_ "SystemMessageLongSymbol" BO_ 2147611392 "VDMA_1F300_AC_Power_Current_Phase_A";
BA_ "SystemMessageLongSymbol" BO_ 2147611393 "VDMA_1F301_AC_Power_Current_Phase_B";
BA_ "SystemMessageLongSymbol" BO_ 2147611394 "VDMA_1F302_AC_Power_Current_Phase_C";
BA_ "SystemMessageLongSymbol" BO_ 2147611395 "VDMA_1F303_AC_Voltage_Frequency_Phase_A";
BA_ "SystemMessageLongSymbol" BO_ 2147611396 "VDMA_1F304_AC_Voltage_Frequency_Phase_B";
BA_ "SystemMessageLongSymbol" BO_ 2147611397 "VDMA_1F305_AC_Voltage_Frequency_Phase_C";
BA_ "SystemMessageLongSymbol" BO_ 2147611398 "VDMA_1F306_Converter_Inverter_Charger_Statu";
BA_ "SystemMessageLongSymbol" BO_ 2147611650 "VDMA_1F402_Electric_Drive_Status_Rapid_Upda";
BA_ "SystemMessageLongSymbol" BO_ 2147611651 "VDMA_1F403_Electric_Energy_Storage_Status_R";
BA_ "SystemMessageLongSymbol" BO_ 2147611654 "VDMA_1F406_Thruster_Control_Status";
BA_ "SystemMessageLongSymbol" BO_ 2147612416 "VDMA_1F700_Elevator_Motor_Control";
BA_ "SystemMessageLongSymbol" BO_ 2147612417 "VDMA_1F701_Elevator_Deck_Push_Button";
BA_ "SystemMessageLongSymbol" BO_ 2147612424 "VDMA_1F708_Windlass_Control_Status";
BA_ "SystemMessageLongSymbol" BO_ 2147612425 "VDMA_1F709_Anchor_Windlass_Operating_Status";
BA_ "SystemMessageLongSymbol" BO_ 2147612426 "VDMA_1F70A_Anchor_Windlass_Monitoring_Statu";
BA_ "SystemMessageLongSymbol" BO_ 2147612428 "VDMA_1F70C_Linear_Actuator_Control_Status";
BA_ "SystemMessageLongSymbol" BO_ 2147612676 "VDMA_1F804_Altitude_Delta_High_Precision_Ra";
BA_ "SystemSignalLongSymbol" SG_ 2147548683 Tractor_control_mode_command_Raw "Tractor_control_mode_command_RawPayload";
BA_ "SystemSignalLongSymbol" SG_ 2147548686 Response_for_Repetition_Rate_Raw "Response_for_Repetition_Rate_RawPayload";
BA_ "SystemSignalLongSymbol" SG_ 2147548688 Auxiliary_valve_0_estimated_flow "Auxiliary_valve_0_estimated_flow_RawPayload";
BA_ "SystemSignalLongSymbol" SG_ 2147548689 Auxiliary_valve_1_estimated_flow "Auxiliary_valve_1_estimated_flow_RawPayload";
BA_ "SystemSignalLongSymbol" SG_ 2147548690 Auxiliary_valve_2_estimated_flow "Auxiliary_valve_2_estimated_flow_RawPayload";
BA_ "SystemSignalLongSymbol" SG_ 2147548691 Auxiliary_valve_3_estimated_flow "Auxiliary_valve_3_estimated_flow_RawPayload";
BA_ "SystemSignalLongSymbol" SG_ 2147548692 Auxiliary_valve_4_estimated_flow "Auxiliary_valve_4_estimated_flow_RawPayload";
BA_ "SystemSignalLongSymbol" SG_ 2147548693 Auxiliary_valve_5_estimated_flow "Auxiliary_valve_5_estimated_flow_RawPayload";
BA_ "SystemSignalLongSymbol" SG_ 2147548694 Auxiliary_valve_6_estimated_flow "Auxiliary_valve_6_estimated_flow_RawPayload";
BA_ "SystemSignalLongSymbol" SG_ 2147548695 Auxiliary_valve_7_estimated_flow "Auxiliary_valve_7_estimated_flow_RawPayload";
BA_ "SystemSignalLongSymbol" SG_ 2147548696 Auxiliary_valve_8_estimated_flow "Auxiliary_valve_8_estimated_flow_RawPayload";
BA_ "SystemSignalLongSymbol" SG_ 2147548697 Auxiliary_valve_9_estimated_flow "Auxiliary_valve_9_estimated_flow_RawPayload";
BA_ "SystemSignalLongSymbol" SG_ 2147548698 Auxiliary_valve_10_estimated_flo "Auxiliary_valve_10_estimated_flo_RawPayload";
BA_ "SystemSignalLongSymbol" SG_ 2147548699 Auxiliary_valve_11_estimated_flo "Auxiliary_valve_11_estimated_flo_RawPayload";
BA_ "SystemSignalLongSymbol" SG_ 2147548700 Auxiliary_valve_12_estimated_flo "Auxiliary_valve_12_estimated_flo_RawPayload";
BA_ "SystemSignalLongSymbol" SG_ 2147548701 Auxiliary_valve_13_estimated_flo "Auxiliary_valve_13_estimated_flo_RawPayload";
BA_ "SystemSignalLongSymbol" SG_ 2147548702 Auxiliary_valve_14_estimated_flo "Auxiliary_valve_14_estimated_flo_RawPayload";
BA_ "SystemSignalLongSymbol" SG_ 2147548703 Auxiliary_valve_15_estimated_flo "Auxiliary_valve_15_estimated_flo_RawPayload";
BA_ "SystemSignalLongSymbol" SG_ 2147548704 Auxiliary_valve_0_measured_flow_ "Auxiliary_valve_0_measured_flow_RawPayload";
BA_ "SystemSignalLongSymbol" SG_ 2147548705 Auxiliary_valve_1_measured_flow_ "Auxiliary_valve_1_measured_flow_RawPayload";
BA_ "SystemSignalLongSymbol" SG_ 2147548706 Auxiliary_valve_2_measured_flow_ "Auxiliary_valve_2_measured_flow_RawPayload";
BA_ "SystemSignalLongSymbol" SG_ 2147548707 Auxiliary_valve_3_measured_flow_ "Auxiliary_valve_3_measured_flow_RawPayload";
BA_ "SystemSignalLongSymbol" SG_ 2147548708 Auxiliary_valve_4_measured_flow_ "Auxiliary_valve_4_measured_flow_RawPayload";
BA_ "SystemSignalLongSymbol" SG_ 2147548709 Auxiliary_valve_5_measured_flow_ "Auxiliary_valve_5_measured_flow_RawPayload";
BA_ "SystemSignalLongSymbol" SG_ 2147548710 Auxiliary_valve_6_measured_flow_ "Auxiliary_valve_6_measured_flow_RawPayload";
BA_ "SystemSignalLongSymbol" SG_ 2147548711 Auxiliary_valve_7_measured_flow_ "Auxiliary_valve_7_measured_flow_RawPayload";
BA_ "SystemSignalLongSymbol" SG_ 2147548712 Auxiliary_valve_8_measured_flow_ "Auxiliary_valve_8_measured_flow_RawPayload";
BA_ "SystemSignalLongSymbol" SG_ 2147548713 Auxiliary_valve_9_measured_flow_ "Auxiliary_valve_9_measured_flow_RawPayload";
BA_ "SystemSignalLongSymbol" SG_ 2147548714 Auxiliary_valve_10_measured_flow "Auxiliary_valve_10_measured_flow_RawPayload";
BA_ "SystemSignalLongSymbol" SG_ 2147548715 Auxiliary_valve_11_measured_flow "Auxiliary_valve_11_measured_flow_RawPayload";
BA_ "SystemSignalLongSymbol" SG_ 2147548716 Auxiliary_valve_12_measured_flow "Auxiliary_valve_12_measured_flow_RawPayload";
BA_ "SystemSignalLongSymbol" SG_ 2147548717 Auxiliary_valve_13_measured_flow "Auxiliary_valve_13_measured_flow_RawPayload";
BA_ "SystemSignalLongSymbol" SG_ 2147548718 Auxiliary_valve_14_measured_flow "Auxiliary_valve_14_measured_flow_RawPayload";
BA_ "SystemSignalLongSymbol" SG_ 2147548719 Auxiliary_valve_15_measured_flow "Auxiliary_valve_15_measured_flow_RawPayload";
BA_ "SystemSignalLongSymbol" SG_ 2147548720 Auxiliary_valve_0_command_RawPay "Auxiliary_valve_0_command_RawPayload";
BA_ "SystemSignalLongSymbol" SG_ 2147548721 Auxiliary_valve_1_command_RawPay "Auxiliary_valve_1_command_RawPayload";
BA_ "SystemSignalLongSymbol" SG_ 2147548722 Auxiliary_valve_2_command_RawPay "Auxiliary_valve_2_command_RawPayload";
BA_ "SystemSignalLongSymbol" SG_ 2147548723 Auxiliary_valve_3_command_RawPay "Auxiliary_valve_3_command_RawPayload";
BA_ "SystemSignalLongSymbol" SG_ 2147548724 Auxiliary_valve_4_command_RawPay "Auxiliary_valve_4_command_RawPayload";
BA_ "SystemSignalLongSymbol" SG_ 2147548725 Auxiliary_valve_5_command_RawPay "Auxiliary_valve_5_command_RawPayload";
BA_ "SystemSignalLongSymbol" SG_ 2147548726 Auxiliary_valve_6_command_RawPay "Auxiliary_valve_6_command_RawPayload";
BA_ "SystemSignalLongSymbol" SG_ 2147548727 Auxiliary_valve_7_command_RawPay "Auxiliary_valve_7_command_RawPayload";
BA_ "SystemSignalLongSymbol" SG_ 2147548728 Auxiliary_valve_8_command_RawPay "Auxiliary_valve_8_command_RawPayload";
BA_ "SystemSignalLongSymbol" SG_ 2147548729 Auxiliary_valve_9_command_RawPay "Auxiliary_valve_9_command_RawPayload";
BA_ "SystemSignalLongSymbol" SG_ 2147548730 Auxiliary_valve_10_command_RawPa "Auxiliary_valve_10_command_RawPayload";
BA_ "SystemSignalLongSymbol" SG_ 2147548731 Auxiliary_valve_11_command_RawPa "Auxiliary_valve_11_command_RawPayload";
BA_ "SystemSignalLongSymbol" SG_ 2147548732 Auxiliary_valve_12_command_RawPa "Auxiliary_valve_12_command_RawPayload";
BA_ "SystemSignalLongSymbol" SG_ 2147548733 Auxiliary_valve_13_command_RawPa "Auxiliary_valve_13_command_RawPayload";
BA_ "SystemSignalLongSymbol" SG_ 2147548734 Auxiliary_valve_14_command_RawPa "Auxiliary_valve_14_command_RawPayload";
BA_ "SystemSignalLongSymbol" SG_ 2147548735 Auxiliary_valve_15_command_RawPa "Auxiliary_valve_15_command_RawPayload";
BA_ "SystemSignalLongSymbol" SG_ 2147548738 Hitch_and_PTO_commands_RawPayloa "Hitch_and_PTO_commands_RawPayload";
BA_ "SystemSignalLongSymbol" SG_ 2147548739 Primary_or_Rear_Power_Take_off_O "Primary_or_Rear_Power_Take_off_O_RawPayload";
BA_ "SystemSignalLongSymbol" SG_ 2147548740 Secondary_or_Front_Power_Take_of "Secondary_or_Front_Power_Take_of_RawPayload";
BA_ "SystemSignalLongSymbol" SG_ 2147548741 Primary_or_Rear_Hitch_Status_Raw "Primary_or_Rear_Hitch_Status_RawPayload";
BA_ "SystemSignalLongSymbol" SG_ 2147548742 Secondary_or_Front_Hitch_Status_ "Secondary_or_Front_Hitch_Status_RawPayload";
BA_ "SystemSignalLongSymbol" SG_ 2147548746 Electronic_Transmission_Controll "Electronic_Transmission_Controll_RawPayload";
BA_ "SystemSignalLongSymbol" SG_ 2147548747 Transmission_Configuration_2_Raw "Transmission_Configuration_2_RawPayload";
BA_ "SystemSignalLongSymbol" SG_ 2147548748 Military_Lighting_Command_RawPay "Military_Lighting_Command_RawPayload";
BA_ "SystemSignalLongSymbol" SG_ 2147548749 Total_Averaged_Information_RawPa "Total_Averaged_Information_RawPayload";
BA_ "SystemSignalLongSymbol" SG_ 2147548751 Vehicle_Dynamic_Stability_Contro "Vehicle_Dynamic_Stability_Contro_RawPayload";
BA_ "SystemSignalLongSymbol" SG_ 2147548753 Adaptive_Cruise_Control_Operator "Adaptive_Cruise_Control_Operator_RawPayload";
BA_ "SystemSignalLongSymbol" SG_ 2147548754 Vehicle_Electrical_Power_3_RawPa "Vehicle_Electrical_Power_3_RawPayload";
BA_ "SystemSignalLongSymbol" SG_ 2147548755 Retarder_Continuous_Torque_Speed "Retarder_Continuous_Torque_Speed_RawPayload";
BA_ "SystemSignalLongSymbol" SG_ 2147548756 Engine_Continuous_Torque_Speed_L "Engine_Continuous_Torque_Speed_L_RawPayload";
BA_ "SystemSignalLongSymbol" SG_ 2147548757 Gaseous_Fuel_Properties_RawPaylo "Gaseous_Fuel_Properties_RawPayload";
BA_ "SystemSignalLongSymbol" SG_ 2147548758 Aftertreatment_1_Diesel_Exhaust_ "Aftertreatment_1_Diesel_Exhaust__RawPayload";
BA_ "SystemSignalLongSymbol" SG_ 2147548759 Air_Suspension_Control_5_RawPayl "Air_Suspension_Control_5_RawPayload";
BA_ "SystemSignalLongSymbol" SG_ 2147548760 Air_Suspension_Control_4_RawPayl "Air_Suspension_Control_4_RawPayload";
BA_ "SystemSignalLongSymbol" SG_ 2147548761 Air_Suspension_Control_3_RawPayl "Air_Suspension_Control_3_RawPayload";
BA_ "SystemSignalLongSymbol" SG_ 2147548762 Air_Suspension_Control_1_RawPayl "Air_Suspension_Control_1_RawPayload";
BA_ "SystemSignalLongSymbol" SG_ 2147548764 Running_Gear_Equipment_2_2_RawPa "Running_Gear_Equipment_2_2_RawPayload";
BA_ "SystemSignalLongSymbol" SG_ 2147548765 General_Purpose_Message_1_2_RawP "General_Purpose_Message_1_2_RawPayload";
BA_ "SystemSignalLongSymbol" SG_ 2147548766 Running_Gear_Equipment_2_3_RawPa "Running_Gear_Equipment_2_3_RawPayload";
BA_ "SystemSignalLongSymbol" SG_ 2147548767 General_Purpose_Message_1_3_RawP "General_Purpose_Message_1_3_RawPayload";
BA_ "SystemSignalLongSymbol" SG_ 2147548768 General_Purpose_Message_2_3_RawP "General_Purpose_Message_2_3_RawPayload";
BA_ "SystemSignalLongSymbol" SG_ 2147548769 General_Purpose_Message_1_4_RawP "General_Purpose_Message_1_4_RawPayload";
BA_ "SystemSignalLongSymbol" SG_ 2147548770 General_Purpose_Message_2_4_RawP "General_Purpose_Message_2_4_RawPayload";
BA_ "SystemSignalLongSymbol" SG_ 2147548771 General_Purpose_Message_1_5_RawP "General_Purpose_Message_1_5_RawPayload";
BA_ "SystemSignalLongSymbol" SG_ 2147548772 General_Purpose_Message_2_5_RawP "General_Purpose_Message_2_5_RawPayload";
BA_ "SystemSignalLongSymbol" SG_ 2147548773 General_Purpose_Message_1_6_RawP "General_Purpose_Message_1_6_RawPayload";
BA_ "SystemSignalLongSymbol" SG_ 2147548774 Battery_Main_Switch_Information_ "Battery_Main_Switch_Information_RawPayload";
BA_ "SystemSignalLongSymbol" SG_ 2147548775 Climate_Control_Configuration_Ra "Climate_Control_Configuration_RawPayload";
BA_ "SystemSignalLongSymbol" SG_ 2147548778 Engine_Fuel_Lube_Systems_RawPayl "Engine_Fuel_Lube_Systems_RawPayload";
BA_ "SystemSignalLongSymbol" SG_ 2147548779 Driver_s_Identification_RawPaylo "Driver_s_Identification_RawPayload";
BA_ "SystemSignalLongSymbol" SG_ 2147548782 High_Resolution_Wheel_Speed_RawP "High_Resolution_Wheel_Speed_RawPayload";
BA_ "SystemSignalLongSymbol" SG_ 2147548783 Adaptive_Cruise_Control_1_RawPay "Adaptive_Cruise_Control_1_RawPayload";
BA_ "SystemSignalLongSymbol" SG_ 2147548784 Combination_Vehicle_Weight_RawPa "Combination_Vehicle_Weight_RawPayload";
BA_ "SystemSignalLongSymbol" SG_ 2147548786 Laser_Leveling_System_Blade_Cont "Laser_Leveling_System_Blade_Cont_RawPayload";
BA_ "SystemSignalLongSymbol" SG_ 2147548787 Laser_Receiver_Mast_Position_Raw "Laser_Receiver_Mast_Position_RawPayload";
BA_ "SystemSignalLongSymbol" SG_ 2147548788 Modify_Leveling_System_Control_S "Modify_Leveling_System_Control_S_RawPayload";
BA_ "SystemSignalLongSymbol" SG_ 2147548789 Laser_Leveling_System_Vertical_D "Laser_Leveling_System_Vertical_D_RawPayload";
BA_ "SystemSignalLongSymbol" SG_ 2147548790 Laser_Leveling_System_Vertical_P "Laser_Leveling_System_Vertical_P_RawPayload";
BA_ "SystemSignalLongSymbol" SG_ 2147548792 Tire_Pressure_Control_Unit_Mode_ "Tire_Pressure_Control_Unit_Mode__RawPayload";
BA_ "SystemSignalLongSymbol" SG_ 2147548793 Tire_Pressure_Control_Unit_Targe "Tire_Pressure_Control_Unit_Targe_RawPayload";
BA_ "SystemSignalLongSymbol" SG_ 2147548794 Tire_Pressure_Control_Unit_Curre "Tire_Pressure_Control_Unit_Curre_RawPayload";
BA_ "SystemSignalLongSymbol" SG_ 2147548801 Fuel_Information_2_Gaseous_RawPa "Fuel_Information_2_Gaseous_RawPayload";
BA_ "SystemSignalLongSymbol" SG_ 2147548808 Ignition_Transformer_Secondary_O "Ignition_Transformer_Secondary_O_RawPayload";
BA_ "SystemSignalLongSymbol" SG_ 2147548809 Ignition_Transformer_Secondary_O "Ignition_Transformer_Secondary_O_RawPayload";
BA_ "SystemSignalLongSymbol" SG_ 2147548810 Ignition_Transformer_Secondary_O "Ignition_Transformer_Secondary_O_RawPayload";
BA_ "SystemSignalLongSymbol" SG_ 2147548811 Gaseous_Fuel_Pressure_1_RawPaylo "Gaseous_Fuel_Pressure_1_RawPayload";
BA_ "SystemSignalLongSymbol" SG_ 2147548812 Auxiliary_Analog_Information_Raw "Auxiliary_Analog_Information_RawPayload";
BA_ "SystemSignalLongSymbol" SG_ 2147548813 Vehicle_Electrical_Power_2_RawPa "Vehicle_Electrical_Power_2_RawPayload";
BA_ "SystemSignalLongSymbol" SG_ 2147548819 Engine_Electrical_System_Module_ "Engine_Electrical_System_Module__RawPayload";
BA_ "SystemSignalLongSymbol" SG_ 2147548820 Engine_Auxiliary_Coolant_RawPayl "Engine_Auxiliary_Coolant_RawPayload";
BA_ "SystemSignalLongSymbol" SG_ 2147548822 Turbocharger_Wastegate_RawPayloa "Turbocharger_Wastegate_RawPayload";
BA_ "SystemSignalLongSymbol" SG_ 2147548823 Turbocharger_Information_5_RawPa "Turbocharger_Information_5_RawPayload";
BA_ "SystemSignalLongSymbol" SG_ 2147548824 Turbocharger_Information_4_RawPa "Turbocharger_Information_4_RawPayload";
BA_ "SystemSignalLongSymbol" SG_ 2147548825 Turbocharger_Information_3_RawPa "Turbocharger_Information_3_RawPayload";
BA_ "SystemSignalLongSymbol" SG_ 2147548826 Turbocharger_Information_2_RawPa "Turbocharger_Information_2_RawPayload";
BA_ "SystemSignalLongSymbol" SG_ 2147548827 Turbocharger_Information_1_RawPa "Turbocharger_Information_1_RawPayload";
BA_ "SystemSignalLongSymbol" SG_ 2147548828 Main_Bearing_Temperature_3_RawPa "Main_Bearing_Temperature_3_RawPayload";
BA_ "SystemSignalLongSymbol" SG_ 2147548829 Main_Bearing_Temperature_2_RawPa "Main_Bearing_Temperature_2_RawPayload";
BA_ "SystemSignalLongSymbol" SG_ 2147548830 Main_Bearing_Temperature_1_RawPa "Main_Bearing_Temperature_1_RawPayload";
BA_ "SystemSignalLongSymbol" SG_ 2147548831 Exhaust_Port_Temperature_5_RawPa "Exhaust_Port_Temperature_5_RawPayload";
BA_ "SystemSignalLongSymbol" SG_ 2147548832 Exhaust_Port_Temperature_4_RawPa "Exhaust_Port_Temperature_4_RawPayload";
BA_ "SystemSignalLongSymbol" SG_ 2147548833 Exhaust_Port_Temperature_3_RawPa "Exhaust_Port_Temperature_3_RawPayload";
BA_ "SystemSignalLongSymbol" SG_ 2147548834 Exhaust_Port_Temperature_2_RawPa "Exhaust_Port_Temperature_2_RawPayload";
BA_ "SystemSignalLongSymbol" SG_ 2147548835 Exhaust_Port_Temperature_1_RawPa "Exhaust_Port_Temperature_1_RawPayload";
BA_ "SystemSignalLongSymbol" SG_ 2147548837 Intake_Manifold_Information_2_Ra "Intake_Manifold_Information_2_RawPayload";
BA_ "SystemSignalLongSymbol" SG_ 2147548838 Intake_Manifold_Information_1_Ra "Intake_Manifold_Information_1_RawPayload";
BA_ "SystemSignalLongSymbol" SG_ 2147548839 Alternator_Temperature_1_RawPayl "Alternator_Temperature_1_RawPayload";
BA_ "SystemSignalLongSymbol" SG_ 2147548843 Electronic_Transmission_Controll "Electronic_Transmission_Controll_RawPayload";
BA_ "SystemSignalLongSymbol" SG_ 2147548844 Wheel_Brake_Lining_Remaining_Inf "Wheel_Brake_Lining_Remaining_Inf_RawPayload";
BA_ "SystemSignalLongSymbol" SG_ 2147548845 Wheel_Application_Pressure_High_ "Wheel_Application_Pressure_High__RawPayload";
BA_ "SystemSignalLongSymbol" SG_ 2147548847 Fuel_Consumption_Gaseous_RawPayl "Fuel_Consumption_Gaseous_RawPayload";
BA_ "SystemSignalLongSymbol" SG_ 2147548848 Trip_Time_Information_2_RawPaylo "Trip_Time_Information_2_RawPayload";
BA_ "SystemSignalLongSymbol" SG_ 2147548850 Fuel_Information_1_Gaseous_RawPa "Fuel_Information_1_Gaseous_RawPayload";
BA_ "SystemSignalLongSymbol" SG_ 2147548851 Fuel_Information_1_Liquid_RawPay "Fuel_Information_1_Liquid_RawPayload";
BA_ "SystemSignalLongSymbol" SG_ 2147548852 Trip_Time_Information_1_RawPaylo "Trip_Time_Information_1_RawPayload";
BA_ "SystemSignalLongSymbol" SG_ 2147548853 Trip_Shutdown_Information_RawPay "Trip_Shutdown_Information_RawPayload";
BA_ "SystemSignalLongSymbol" SG_ 2147548854 Trip_Vehicle_Speed_Cruise_Distan "Trip_Vehicle_Speed_Cruise_Distan_RawPayload";
BA_ "SystemSignalLongSymbol" SG_ 2147548855 Engine_Speed_Load_Factor_Informa "Engine_Speed_Load_Factor_Informa_RawPayload";
BA_ "SystemSignalLongSymbol" SG_ 2147548856 Trip_Fuel_Information_Gaseous_Ra "Trip_Fuel_Information_Gaseous_RawPayload";
BA_ "SystemSignalLongSymbol" SG_ 2147548857 Trip_Fuel_Information_Liquid_Raw "Trip_Fuel_Information_Liquid_RawPayload";
BA_ "SystemSignalLongSymbol" SG_ 2147548858 Trip_Distance_Information_RawPay "Trip_Distance_Information_RawPayload";
BA_ "SystemSignalLongSymbol" SG_ 2147548860 Compression_Service_Brake_Inform "Compression_Service_Brake_Inform_RawPayload";
BA_ "SystemSignalLongSymbol" SG_ 2147548862 Electronic_Engine_Controller_4_R "Electronic_Engine_Controller_4_RawPayload";
BA_ "SystemSignalLongSymbol" SG_ 2147548863 Wheel_Speed_Information_RawPaylo "Wheel_Speed_Information_RawPayload";
BA_ "SystemSignalLongSymbol" SG_ 2147548865 High_Resolution_Vehicle_Distance "High_Resolution_Vehicle_Distance_RawPayload";
BA_ "SystemSignalLongSymbol" SG_ 2147548866 Electronic_Retarder_Controller_2 "Electronic_Retarder_Controller_2_RawPayload";
BA_ "SystemSignalLongSymbol" SG_ 2147548867 Electronic_Transmission_Controll "Electronic_Transmission_Controll_RawPayload";
BA_ "SystemSignalLongSymbol" SG_ 2147548868 Electronic_Brake_System_2_2_RawP "Electronic_Brake_System_2_2_RawPayload";
BA_ "SystemSignalLongSymbol" SG_ 2147548869 Electronic_Transmission_Controll "Electronic_Transmission_Controll_RawPayload";
BA_ "SystemSignalLongSymbol" SG_ 2147548870 Electronic_Brake_System_2_3_RawP "Electronic_Brake_System_2_3_RawPayload";
BA_ "SystemSignalLongSymbol" SG_ 2147548871 Electronic_Transmission_Controll "Electronic_Transmission_Controll_RawPayload";
BA_ "SystemSignalLongSymbol" SG_ 2147548872 General_Purpose_Message_2_2_RawP "General_Purpose_Message_2_2_RawPayload";
BA_ "SystemSignalLongSymbol" SG_ 2147548873 Electronic_Brake_System_1_2_RawP "Electronic_Brake_System_1_2_RawPayload";
BA_ "SystemSignalLongSymbol" SG_ 2147548877 Freeze_Frame_Parameters_RawPaylo "Freeze_Frame_Parameters_RawPayload";
BA_ "SystemSignalLongSymbol" SG_ 2147548878 Diagnostic_Readiness_1_RawPayloa "Diagnostic_Readiness_1_RawPayload";
BA_ "SystemSignalLongSymbol" SG_ 2147548879 Emission_Related_Pending_Diagnos "Emission_Related_Pending_Diagnos_RawPayload";
BA_ "SystemSignalLongSymbol" SG_ 2147548880 Test_Results_for_Non_continuousl "Test_Results_for_Non_continuousl_RawPayload";
BA_ "SystemSignalLongSymbol" SG_ 2147548881 Oxygen_Sensor_Test_Results_RawPa "Oxygen_Sensor_Test_Results_RawPayload";
BA_ "SystemSignalLongSymbol" SG_ 2147548882 Non_Continuously_Monitored_Syste "Non_Continuously_Monitored_Syste_RawPayload";
BA_ "SystemSignalLongSymbol" SG_ 2147548884 Emission_Related_MIL_On_Diagnost "Emission_Related_MIL_On_Diagnost_RawPayload";
BA_ "SystemSignalLongSymbol" SG_ 2147548885 Alternator_Information_1_RawPayl "Alternator_Information_1_RawPayload";
BA_ "SystemSignalLongSymbol" SG_ 2147548886 Hybrid_or_EV_System_Inputs_1_Raw "Hybrid_or_EV_System_Inputs_1_RawPayload";
BA_ "SystemSignalLongSymbol" SG_ 2147548889 Auxiliary_Input_Output_Status_1_ "Auxiliary_Input_Output_Status_1_RawPayload";
BA_ "SystemSignalLongSymbol" SG_ 2147548891 Engine_Fluid_Level_Pressure_2_Ra "Engine_Fluid_Level_Pressure_2_RawPayload";
BA_ "SystemSignalLongSymbol" SG_ 2147548894 Engine_Air_Start_Pressure_RawPay "Engine_Air_Start_Pressure_RawPayload";
BA_ "SystemSignalLongSymbol" SG_ 2147548895 Electronic_Engine_Controller_3_R "Electronic_Engine_Controller_3_RawPayload";
BA_ "SystemSignalLongSymbol" SG_ 2147548897 Retarder_Configuration_RawPayloa "Retarder_Configuration_RawPayload";
BA_ "SystemSignalLongSymbol" SG_ 2147548898 Transmission_Configuration_RawPa "Transmission_Configuration_RawPayload";
BA_ "SystemSignalLongSymbol" SG_ 2147548899 Engine_Configuration_1_RawPayloa "Engine_Configuration_1_RawPayload";
BA_ "SystemSignalLongSymbol" SG_ 2147548901 Engine_Hours_Revolutions_RawPayl "Engine_Hours_Revolutions_RawPayload";
BA_ "SystemSignalLongSymbol" SG_ 2147548904 Vehicle_Direction_Speed_RawPaylo "Vehicle_Direction_Speed_RawPayload";
BA_ "SystemSignalLongSymbol" SG_ 2147548905 Fuel_Consumption_Liquid_1_RawPay "Fuel_Consumption_Liquid_1_RawPayload";
BA_ "SystemSignalLongSymbol" SG_ 2147548908 Vehicle_Identification_RawPayloa "Vehicle_Identification_RawPayload";
BA_ "SystemSignalLongSymbol" SG_ 2147548909 Cruise_Control_Vehicle_Speed_Set "Cruise_Control_Vehicle_Speed_Set_RawPayload";
BA_ "SystemSignalLongSymbol" SG_ 2147548911 Engine_Fluid_Level_Pressure_1_Ra "Engine_Fluid_Level_Pressure_1_RawPayload";
BA_ "SystemSignalLongSymbol" SG_ 2147548912 Power_Takeoff_Information_1_RawP "Power_Takeoff_Information_1_RawPayload";
BA_ "SystemSignalLongSymbol" SG_ 2147548913 Cruise_Control_Vehicle_Speed_1_R "Cruise_Control_Vehicle_Speed_1_RawPayload";
BA_ "SystemSignalLongSymbol" SG_ 2147548916 Tire_Condition_Message_1_RawPayl "Tire_Condition_Message_1_RawPayload";
BA_ "SystemSignalLongSymbol" SG_ 2147548918 Intake_Exhaust_Conditions_1_RawP "Intake_Exhaust_Conditions_1_RawPayload";
BA_ "SystemSignalLongSymbol" SG_ 2147548919 Vehicle_Electrical_Power_1_RawPa "Vehicle_Electrical_Power_1_RawPayload";
BA_ "SystemSignalLongSymbol" SG_ 2147548926 Auxiliary_Water_Pump_Pressure_Ra "Auxiliary_Water_Pump_Pressure_RawPayload";
BA_ "SystemSignalLongSymbol" SG_ 2147609856 NMEA_Request_Command_Acknowledge "NMEA_Request_Command_Acknowledge_RawPayload";
BA_ "SystemSignalLongSymbol" SG_ 2147610112 PGN_List_Transmit_Receive_PGN_s_ "PGN_List_Transmit_Receive_PGN_s__RawPayload";
BA_ "SystemSignalLongSymbol" SG_ 2147610646 Configuration_Information_RawPay "Configuration_Information_RawPayload";
BA_ "SystemSignalLongSymbol" SG_ 2147610649 Cyclic_Alert_List_IEC_61924_2_Ra "Cyclic_Alert_List_IEC_61924_2_RawPayload";
BA_ "SystemSignalLongSymbol" SG_ 2147610650 Responsibility_Transfer_Function "Responsibility_Transfer_Function_RawPayload";
BA_ "SystemSignalLongSymbol" SG_ 2147610881 Man_Overboard_Notification_MOB_R "Man_Overboard_Notification_MOB_RawPayload";
BA_ "SystemSignalLongSymbol" SG_ 2147611136 Engine_Parameters_Rapid_Update_R "Engine_Parameters_Rapid_Update_RawPayload";
BA_ "SystemSignalLongSymbol" SG_ 2147611137 Engine_Parameters_Dynamic_RawPay "Engine_Parameters_Dynamic_RawPayload";
BA_ "SystemSignalLongSymbol" SG_ 2147611138 Electric_Drive_Status_Dynamic_Ra "Electric_Drive_Status_Dynamic_RawPayload";
BA_ "SystemSignalLongSymbol" SG_ 2147611139 Electric_Energy_Storage_Status_D "Electric_Energy_Storage_Status_D_RawPayload";
BA_ "SystemSignalLongSymbol" SG_ 2147611141 Transmission_Parameters_Dynamic_ "Transmission_Parameters_Dynamic_RawPayload";
BA_ "SystemSignalLongSymbol" SG_ 2147611142 Electric_Drive_Information_RawPa "Electric_Drive_Information_RawPayload";
BA_ "SystemSignalLongSymbol" SG_ 2147611143 Electric_Energy_Storage_Informat "Electric_Energy_Storage_Informat_RawPayload";
BA_ "SystemSignalLongSymbol" SG_ 2147611144 Trip_Parameters_Vessel_RawPayloa "Trip_Parameters_Vessel_RawPayload";
BA_ "SystemSignalLongSymbol" SG_ 2147611145 Trip_Parameters_Small_Craft_RawP "Trip_Parameters_Small_Craft_RawPayload";
BA_ "SystemSignalLongSymbol" SG_ 2147611146 Engine_Parameters_Static_RawPayl "Engine_Parameters_Static_RawPayload";
BA_ "SystemSignalLongSymbol" SG_ 2147611148 Load_Controller_Connection_State "Load_Controller_Connection_State_RawPayload";
BA_ "SystemSignalLongSymbol" SG_ 2147611149 Binary_Switch_Bank_Status_RawPay "Binary_Switch_Bank_Status_RawPayload";
BA_ "SystemSignalLongSymbol" SG_ 2147611158 Charger_Configuration_Status_Raw "Charger_Configuration_Status_RawPayload";
BA_ "SystemSignalLongSymbol" SG_ 2147611159 Inverter_Configuration_Status_Ra "Inverter_Configuration_Status_RawPayload";
BA_ "SystemSignalLongSymbol" SG_ 2147611160 AGS_Configuration_Status_RawPayl "AGS_Configuration_Status_RawPayload";
BA_ "SystemSignalLongSymbol" SG_ 2147611161 Battery_Configuration_Status_Raw "Battery_Configuration_Status_RawPayload";
BA_ "SystemSignalLongSymbol" SG_ 2147611392 AC_Power_Current_Phase_A_RawPayl "AC_Power_Current_Phase_A_RawPayload";
BA_ "SystemSignalLongSymbol" SG_ 2147611393 AC_Power_Current_Phase_B_RawPayl "AC_Power_Current_Phase_B_RawPayload";
BA_ "SystemSignalLongSymbol" SG_ 2147611394 AC_Power_Current_Phase_C_RawPayl "AC_Power_Current_Phase_C_RawPayload";
BA_ "SystemSignalLongSymbol" SG_ 2147611395 AC_Voltage_Frequency_Phase_A_Raw "AC_Voltage_Frequency_Phase_A_RawPayload";
BA_ "SystemSignalLongSymbol" SG_ 2147611396 AC_Voltage_Frequency_Phase_B_Raw "AC_Voltage_Frequency_Phase_B_RawPayload";
BA_ "SystemSignalLongSymbol" SG_ 2147611397 AC_Voltage_Frequency_Phase_C_Raw "AC_Voltage_Frequency_Phase_C_RawPayload";
BA_ "SystemSignalLongSymbol" SG_ 2147611398 Converter_Inverter_Charger_Statu "Converter_Inverter_Charger_Statu_RawPayload";
BA_ "SystemSignalLongSymbol" SG_ 2147611650 Electric_Drive_Status_Rapid_Upda "Electric_Drive_Status_Rapid_Upda_RawPayload";
BA_ "SystemSignalLongSymbol" SG_ 2147611651 Electric_Energy_Storage_Status_R "Electric_Energy_Storage_Status_R_RawPayload";
BA_ "SystemSignalLongSymbol" SG_ 2147611654 Thruster_Control_Status_RawPaylo "Thruster_Control_Status_RawPayload";
BA_ "SystemSignalLongSymbol" SG_ 2147612416 Elevator_Motor_Control_RawPayloa "Elevator_Motor_Control_RawPayload";
BA_ "SystemSignalLongSymbol" SG_ 2147612417 Elevator_Deck_Push_Button_RawPay "Elevator_Deck_Push_Button_RawPayload";
BA_ "SystemSignalLongSymbol" SG_ 2147612424 Windlass_Control_Status_RawPaylo "Windlass_Control_Status_RawPayload";
BA_ "SystemSignalLongSymbol" SG_ 2147612425 Anchor_Windlass_Operating_Status "Anchor_Windlass_Operating_Status_RawPayload";
BA_ "SystemSignalLongSymbol" SG_ 2147612426 Anchor_Windlass_Monitoring_Statu "Anchor_Windlass_Monitoring_Statu_RawPayload";
BA_ "SystemSignalLongSymbol" SG_ 2147612428 Linear_Actuator_Control_Status_R "Linear_Actuator_Control_Status_RawPayload";
BA_ "SystemSignalLongSymbol" SG_ 2147612676 Altitude_Delta_High_Precision_Ra "Altitude_Delta_High_Precision_Ra_RawPayload";
