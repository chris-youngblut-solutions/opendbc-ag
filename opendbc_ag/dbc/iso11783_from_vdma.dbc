VERSION "created by canmatrix"

NS_ :

BS_:

BU_:

BO_ 2147548394 VDMA_FCEA_Vehicle_Electrical_Pow: 8 Vector__XXX
 SG_ Vehicle_Electrical_Power_4_obsol : 0|64@1+ (1,0) [0|18446744073709551615] "" Vector__XXX

BO_ 2147548395 VDMA_FCEB_Aftertreatment_2_NOx_A: 8 Vector__XXX
 SG_ Aftertreatment_2_NOx_Adsorber_In : 0|64@1+ (1,0) [0|18446744073709551615] "" Vector__XXX

BO_ 2147548396 VDMA_FCEC_Aftertreatment_1_NOx_A: 8 Vector__XXX
 SG_ Aftertreatment_1_NOx_Adsorber_In : 0|64@1+ (1,0) [0|18446744073709551615] "" Vector__XXX

BO_ 2147548397 VDMA_FCED_Aftertreatment_2_Warm_: 8 Vector__XXX
 SG_ Aftertreatment_2_Warm_Up_Diesel_ : 0|64@1+ (1,0) [0|18446744073709551615] "" Vector__XXX

BO_ 2147548398 VDMA_FCEE_Land_Leveling_System_R: 8 Vector__XXX
 SG_ Land_Leveling_System_Reference_E : 0|64@1+ (1,0) [0|18446744073709551615] "" Vector__XXX

BO_ 2147548399 VDMA_FCEF_Engine_Fluid_Level_Pre: 8 Vector__XXX
 SG_ Engine_Fluid_Level_Pressure_11_R : 0|64@1+ (1,0) [0|18446744073709551615] "" Vector__XXX

BO_ 2147548400 VDMA_FCF0_Engine_Fuel_Lube_x000D: 8 Vector__XXX
 SG_ Engine_Fuel_Lube_x000D_Systems_2 : 0|64@1+ (1,0) [0|18446744073709551615] "" Vector__XXX

BO_ 2147548401 VDMA_FCF1_Engine_Turbocharger_Wa: 8 Vector__XXX
 SG_ Engine_Turbocharger_Wastegate_Ac : 0|64@1+ (1,0) [0|18446744073709551615] "" Vector__XXX

BO_ 2147548402 VDMA_FCF2_Engine_Fuel_Throttle_V: 8 Vector__XXX
 SG_ Engine_Fuel_Throttle_Valve_Infor : 0|64@1+ (1,0) [0|18446744073709551615] "" Vector__XXX

BO_ 2147548403 VDMA_FCF3_Engine_Turbocharger_Co: 8 Vector__XXX
 SG_ Engine_Turbocharger_Compressor_B : 0|64@1+ (1,0) [0|18446744073709551615] "" Vector__XXX

BO_ 2147548404 VDMA_FCF4_Charge_Air_Cooler_2: 8 Vector__XXX
 SG_ Charge_Air_Cooler_2_RawPayload : 0|64@1+ (1,0) [0|18446744073709551615] "" Vector__XXX

BO_ 2147548405 VDMA_FCF5_Charge_Air_Cooler_2_Pr: 8 Vector__XXX
 SG_ Charge_Air_Cooler_2_Precooler_Ra : 0|64@1+ (1,0) [0|18446744073709551615] "" Vector__XXX

BO_ 2147548406 VDMA_FCF6_Charge_Air_Cooler_1: 8 Vector__XXX
 SG_ Charge_Air_Cooler_1_RawPayload : 0|64@1+ (1,0) [0|18446744073709551615] "" Vector__XXX

BO_ 2147548407 VDMA_FCF7_Charge_Air_Cooler_1_Pr: 8 Vector__XXX
 SG_ Charge_Air_Cooler_1_Precooler_Ra : 0|64@1+ (1,0) [0|18446744073709551615] "" Vector__XXX

BO_ 2147548408 VDMA_FCF8_Diesel_Particulate_Fil: 8 Vector__XXX
 SG_ Diesel_Particulate_Filter_2_Soot : 0|64@1+ (1,0) [0|18446744073709551615] "" Vector__XXX

BO_ 2147548409 VDMA_FCF9_Diesel_Particulate_Fil: 8 Vector__XXX
 SG_ Diesel_Particulate_Filter_1_Soot : 0|64@1+ (1,0) [0|18446744073709551615] "" Vector__XXX

BO_ 2147548410 VDMA_FCFA_Electronic_Engine_Cont: 8 Vector__XXX
 SG_ Electronic_Engine_Controller_11_ : 0|64@1+ (1,0) [0|18446744073709551615] "" Vector__XXX

BO_ 2147548411 VDMA_FCFB_Engine_Manifold_Actuat: 8 Vector__XXX
 SG_ Engine_Manifold_Actuator_Positio : 0|64@1+ (1,0) [0|18446744073709551615] "" Vector__XXX

BO_ 2147548412 VDMA_FCFC_Engine_Manifold_Actuat: 8 Vector__XXX
 SG_ Engine_Manifold_Actuator_Control : 0|64@1+ (1,0) [0|18446744073709551615] "" Vector__XXX

BO_ 2147548413 VDMA_FCFD_Electronic_Engine_Cont: 8 Vector__XXX
 SG_ Electronic_Engine_Controller_9_R : 0|64@1+ (1,0) [0|18446744073709551615] "" Vector__XXX

BO_ 2147548414 VDMA_FCFE_Electronic_Engine_Cont: 8 Vector__XXX
 SG_ Electronic_Engine_Controller_10_ : 0|64@1+ (1,0) [0|18446744073709551615] "" Vector__XXX

BO_ 2147548415 VDMA_FCFF_Engine_Temperature_5: 8 Vector__XXX
 SG_ Engine_Temperature_5_RawPayload : 0|64@1+ (1,0) [0|18446744073709551615] "" Vector__XXX

BO_ 2147548416 VDMA_FD00_Engine_Fluid_Level_Pre: 8 Vector__XXX
 SG_ Engine_Fluid_Level_Pressure_10_R : 0|64@1+ (1,0) [0|18446744073709551615] "" Vector__XXX

BO_ 2147548417 VDMA_FD01_Low_Voltage_Disconnect: 8 Vector__XXX
 SG_ Low_Voltage_Disconnect_Status_Ra : 0|64@1+ (1,0) [0|18446744073709551615] "" Vector__XXX

BO_ 2147548419 VDMA_FD03_Implement_Operating_st: 8 Vector__XXX
 SG_ Implement_Operating_state_comman : 0|64@1+ (1,0) [0|18446744073709551615] "" Vector__XXX

BO_ 2147548420 VDMA_FD04_Direct_Lamp_Control_Da: 8 Vector__XXX
 SG_ Direct_Lamp_Control_Data_2_RawPa : 0|64@1+ (1,0) [0|18446744073709551615] "" Vector__XXX

BO_ 2147548421 VDMA_FD05_Direct_Lamp_Control_Da: 8 Vector__XXX
 SG_ Direct_Lamp_Control_Data_1_RawPa : 0|64@1+ (1,0) [0|18446744073709551615] "" Vector__XXX

BO_ 2147548422 VDMA_FD06_Direct_Lamp_Control_Co: 8 Vector__XXX
 SG_ Direct_Lamp_Control_Command_2_Ra : 0|64@1+ (1,0) [0|18446744073709551615] "" Vector__XXX

BO_ 2147548423 VDMA_FD07_Direct_Lamp_Control_Co: 8 Vector__XXX
 SG_ Direct_Lamp_Control_Command_1_Ra : 0|64@1+ (1,0) [0|18446744073709551615] "" Vector__XXX

BO_ 2147548424 VDMA_FD08_Engine_oil_message: 8 Vector__XXX
 SG_ Engine_oil_message_RawPayload : 0|64@1+ (1,0) [0|18446744073709551615] "" Vector__XXX

BO_ 2147548425 VDMA_FD09_High_Resolution_Fuel_C: 8 Vector__XXX
 SG_ High_Resolution_Fuel_Consumption : 0|64@1+ (1,0) [0|18446744073709551615] "" Vector__XXX

BO_ 2147548426 VDMA_FD0A_Aftertreatment_2_Outle: 8 Vector__XXX
 SG_ Aftertreatment_2_Outlet_Gas_NOx_ : 0|64@1+ (1,0) [0|18446744073709551615] "" Vector__XXX

BO_ 2147548427 VDMA_FD0B_Aftertreatment_2_Outle: 8 Vector__XXX
 SG_ Aftertreatment_2_Outlet_Gas_NOx_ : 0|64@1+ (1,0) [0|18446744073709551615] "" Vector__XXX

BO_ 2147548428 VDMA_FD0C_Aftertreatment_2_Intak: 8 Vector__XXX
 SG_ Aftertreatment_2_Intake_Gas_NOx_ : 0|64@1+ (1,0) [0|18446744073709551615] "" Vector__XXX

BO_ 2147548429 VDMA_FD0D_Aftertreatment_2_Intak: 8 Vector__XXX
 SG_ Aftertreatment_2_Intake_Gas_NOx_ : 0|64@1+ (1,0) [0|18446744073709551615] "" Vector__XXX

BO_ 2147548430 VDMA_FD0E_Aftertreatment_1_Outle: 8 Vector__XXX
 SG_ Aftertreatment_1_Outlet_Gas_NOx_ : 0|64@1+ (1,0) [0|18446744073709551615] "" Vector__XXX

BO_ 2147548431 VDMA_FD0F_Aftertreatment_1_Outle: 8 Vector__XXX
 SG_ Aftertreatment_1_Outlet_Gas_NOx_ : 0|64@1+ (1,0) [0|18446744073709551615] "" Vector__XXX

BO_ 2147548432 VDMA_FD10_Aftertreatment_1_Intak: 8 Vector__XXX
 SG_ Aftertreatment_1_Intake_Gas_NOx_ : 0|64@1+ (1,0) [0|18446744073709551615] "" Vector__XXX

BO_ 2147548433 VDMA_FD11_Aftertreatment_1_Intak: 8 Vector__XXX
 SG_ Aftertreatment_1_Intake_Gas_NOx_ : 0|64@1+ (1,0) [0|18446744073709551615] "" Vector__XXX

BO_ 2147548434 VDMA_FD12_Magnet_Status_Informat: 8 Vector__XXX
 SG_ Magnet_Status_Information_1_RawP : 0|64@1+ (1,0) [0|18446744073709551615] "" Vector__XXX

BO_ 2147548435 VDMA_FD13_Magnet_System_Configur: 8 Vector__XXX
 SG_ Magnet_System_Configuration_Info : 0|64@1+ (1,0) [0|18446744073709551615] "" Vector__XXX

BO_ 2147548436 VDMA_FD14_Battery_Charger_2: 8 Vector__XXX
 SG_ Battery_Charger_2_RawPayload : 0|64@1+ (1,0) [0|18446744073709551615] "" Vector__XXX

BO_ 2147548437 VDMA_FD15_Battery_Charger_1: 8 Vector__XXX
 SG_ Battery_Charger_1_RawPayload : 0|64@1+ (1,0) [0|18446744073709551615] "" Vector__XXX

BO_ 2147548438 VDMA_FD16_Occupant_Classificatio: 8 Vector__XXX
 SG_ Occupant_Classification_System_I : 0|64@1+ (1,0) [0|18446744073709551615] "" Vector__XXX

BO_ 2147548439 VDMA_FD17_Beltlock_and_Airbag_De: 8 Vector__XXX
 SG_ Beltlock_and_Airbag_Deactivation : 0|64@1+ (1,0) [0|18446744073709551615] "" Vector__XXX

BO_ 2147548440 VDMA_FD18_Collision_Sensor_Infor: 8 Vector__XXX
 SG_ Collision_Sensor_Information_Raw : 0|64@1+ (1,0) [0|18446744073709551615] "" Vector__XXX

BO_ 2147548441 VDMA_FD19_Ignitor_Loop_Informati: 8 Vector__XXX
 SG_ Ignitor_Loop_Information_RawPayl : 0|64@1+ (1,0) [0|18446744073709551615] "" Vector__XXX

BO_ 2147548442 VDMA_FD1A_Aftertreatment_1_Warm_: 8 Vector__XXX
 SG_ Aftertreatment_1_Warm_Up_Diesel_ : 0|64@1+ (1,0) [0|18446744073709551615] "" Vector__XXX

BO_ 2147548443 VDMA_FD1B_Diesel_Particulate_Fil: 8 Vector__XXX
 SG_ Diesel_Particulate_Filter_2_Soot : 0|64@1+ (1,0) [0|18446744073709551615] "" Vector__XXX

BO_ 2147548444 VDMA_FD1C_Diesel_Particulate_Fil: 8 Vector__XXX
 SG_ Diesel_Particulate_Filter_1_Soot : 0|64@1+ (1,0) [0|18446744073709551615] "" Vector__XXX

BO_ 2147548445 VDMA_FD1D_Aftertreatment_Differe: 8 Vector__XXX
 SG_ Aftertreatment_Differential_Temp : 0|64@1+ (1,0) [0|18446744073709551615] "" Vector__XXX

BO_ 2147548446 VDMA_FD1E_Aftertreatment_Differe: 8 Vector__XXX
 SG_ Aftertreatment_Differential_Temp : 0|64@1+ (1,0) [0|18446744073709551615] "" Vector__XXX

BO_ 2147548447 VDMA_FD1F_Aftertreatment_2_Diese: 8 Vector__XXX
 SG_ Aftertreatment_2_Diesel_Oxidatio : 0|64@1+ (1,0) [0|18446744073709551615] "" Vector__XXX

BO_ 2147548448 VDMA_FD20_Aftertreatment_1_Diese: 8 Vector__XXX
 SG_ Aftertreatment_1_Diesel_Oxidatio : 0|64@1+ (1,0) [0|18446744073709551615] "" Vector__XXX

BO_ 2147548449 VDMA_FD21_Aftertreatment_2_Gas_O: 8 Vector__XXX
 SG_ Aftertreatment_2_Gas_Oxidation_C : 0|64@1+ (1,0) [0|18446744073709551615] "" Vector__XXX

BO_ 2147548450 VDMA_FD22_Aftertreatment_1_Gas_O: 8 Vector__XXX
 SG_ Aftertreatment_1_Gas_Oxidation_C : 0|64@1+ (1,0) [0|18446744073709551615] "" Vector__XXX

BO_ 2147548451 VDMA_FD23_Extended_Joystick_Mess: 8 Vector__XXX
 SG_ Extended_Joystick_Message_10_Raw : 0|64@1+ (1,0) [0|18446744073709551615] "" Vector__XXX

BO_ 2147548452 VDMA_FD24_Basic_Joystick_Message: 8 Vector__XXX
 SG_ Basic_Joystick_Message_10_RawPay : 0|64@1+ (1,0) [0|18446744073709551615] "" Vector__XXX

BO_ 2147548453 VDMA_FD25_Extended_Joystick_Mess: 8 Vector__XXX
 SG_ Extended_Joystick_Message_9_RawP : 0|64@1+ (1,0) [0|18446744073709551615] "" Vector__XXX

BO_ 2147548454 VDMA_FD26_Basic_Joystick_Message: 8 Vector__XXX
 SG_ Basic_Joystick_Message_9_RawPayl : 0|64@1+ (1,0) [0|18446744073709551615] "" Vector__XXX

BO_ 2147548455 VDMA_FD27_Extended_Joystick_Mess: 8 Vector__XXX
 SG_ Extended_Joystick_Message_8_RawP : 0|64@1+ (1,0) [0|18446744073709551615] "" Vector__XXX

BO_ 2147548456 VDMA_FD28_Basic_Joystick_Message: 8 Vector__XXX
 SG_ Basic_Joystick_Message_8_RawPayl : 0|64@1+ (1,0) [0|18446744073709551615] "" Vector__XXX

BO_ 2147548457 VDMA_FD29_Extended_Joystick_Mess: 8 Vector__XXX
 SG_ Extended_Joystick_Message_7_RawP : 0|64@1+ (1,0) [0|18446744073709551615] "" Vector__XXX

BO_ 2147548458 VDMA_FD2A_Basic_Joystick_Message: 8 Vector__XXX
 SG_ Basic_Joystick_Message_7_RawPayl : 0|64@1+ (1,0) [0|18446744073709551615] "" Vector__XXX

BO_ 2147548459 VDMA_FD2B_Extended_Joystick_Mess: 8 Vector__XXX
 SG_ Extended_Joystick_Message_6_RawP : 0|64@1+ (1,0) [0|18446744073709551615] "" Vector__XXX

BO_ 2147548460 VDMA_FD2C_Basic_Joystick_Message: 8 Vector__XXX
 SG_ Basic_Joystick_Message_6_RawPayl : 0|64@1+ (1,0) [0|18446744073709551615] "" Vector__XXX

BO_ 2147548461 VDMA_FD2D_Extended_Joystick_Mess: 8 Vector__XXX
 SG_ Extended_Joystick_Message_5_RawP : 0|64@1+ (1,0) [0|18446744073709551615] "" Vector__XXX

BO_ 2147548462 VDMA_FD2E_Basic_Joystick_Message: 8 Vector__XXX
 SG_ Basic_Joystick_Message_5_RawPayl : 0|64@1+ (1,0) [0|18446744073709551615] "" Vector__XXX

BO_ 2147548463 VDMA_FD2F_Extended_Joystick_Mess: 8 Vector__XXX
 SG_ Extended_Joystick_Message_4_RawP : 0|64@1+ (1,0) [0|18446744073709551615] "" Vector__XXX

BO_ 2147548464 VDMA_FD30_Basic_Joystick_Message: 8 Vector__XXX
 SG_ Basic_Joystick_Message_4_RawPayl : 0|64@1+ (1,0) [0|18446744073709551615] "" Vector__XXX

BO_ 2147548465 VDMA_FD31_Fan_Drive_2: 8 Vector__XXX
 SG_ Fan_Drive_2_RawPayload : 0|64@1+ (1,0) [0|18446744073709551615] "" Vector__XXX

BO_ 2147548467 VDMA_FD33_Aftertreatment_2_Diese: 8 Vector__XXX
 SG_ Aftertreatment_2_Diesel_Exhaust_ : 0|64@1+ (1,0) [0|18446744073709551615] "" Vector__XXX

BO_ 2147548468 VDMA_FD34_Aftertreatment_2_SCR_R: 8 Vector__XXX
 SG_ Aftertreatment_2_SCR_Reagant_Tan : 0|64@1+ (1,0) [0|18446744073709551615] "" Vector__XXX

BO_ 2147548469 VDMA_FD35_Aftertreatment_2_Diese: 8 Vector__XXX
 SG_ Aftertreatment_2_Diesel_Exhaust_ : 0|64@1+ (1,0) [0|18446744073709551615] "" Vector__XXX

BO_ 2147548470 VDMA_FD36_Aftertreatment_2_Diese: 8 Vector__XXX
 SG_ Aftertreatment_2_Diesel_Exhaust_ : 0|64@1+ (1,0) [0|18446744073709551615] "" Vector__XXX

BO_ 2147548471 VDMA_FD37_Aftertreatment_2_SCR_S: 8 Vector__XXX
 SG_ Aftertreatment_2_SCR_Service_Inf : 0|64@1+ (1,0) [0|18446744073709551615] "" Vector__XXX

BO_ 2147548472 VDMA_FD38_Aftertreatment_2_SCR_E: 8 Vector__XXX
 SG_ Aftertreatment_2_SCR_Exhaust_Gas : 0|64@1+ (1,0) [0|18446744073709551615] "" Vector__XXX

BO_ 2147548473 VDMA_FD39_Aftertreatment_2_SCR_E: 8 Vector__XXX
 SG_ Aftertreatment_2_SCR_Exhaust_Gas : 0|64@1+ (1,0) [0|18446744073709551615] "" Vector__XXX

BO_ 2147548474 VDMA_FD3A_Aftertreatment_2_SCR_D: 8 Vector__XXX
 SG_ Aftertreatment_2_SCR_Dosing_Syst : 0|64@1+ (1,0) [0|18446744073709551615] "" Vector__XXX

BO_ 2147548475 VDMA_FD3B_Aftertreatment_2_SCR_D: 8 Vector__XXX
 SG_ Aftertreatment_2_SCR_Dosing_Syst : 0|64@1+ (1,0) [0|18446744073709551615] "" Vector__XXX

BO_ 2147548476 VDMA_FD3C_Aftertreatment_1_Diese: 8 Vector__XXX
 SG_ Aftertreatment_1_Diesel_Exhaust_ : 0|64@1+ (1,0) [0|18446744073709551615] "" Vector__XXX

BO_ 2147548477 VDMA_FD3D_Aftertreatment_1_SCR_R: 8 Vector__XXX
 SG_ Aftertreatment_1_SCR_Reagant_Tan : 0|64@1+ (1,0) [0|18446744073709551615] "" Vector__XXX

BO_ 2147548478 VDMA_FD3E_Aftertreatment_1_SCR_E: 8 Vector__XXX
 SG_ Aftertreatment_1_SCR_Exhaust_Gas : 0|64@1+ (1,0) [0|18446744073709551615] "" Vector__XXX

BO_ 2147548479 VDMA_FD3F_Aftertreatment_1_SCR_E: 8 Vector__XXX
 SG_ Aftertreatment_1_SCR_Exhaust_Gas : 0|64@1+ (1,0) [0|18446744073709551615] "" Vector__XXX

BO_ 2147548480 VDMA_FD40_Aftertreatment_1_SCR_D: 8 Vector__XXX
 SG_ Aftertreatment_1_SCR_Dosing_Syst : 0|64@1+ (1,0) [0|18446744073709551615] "" Vector__XXX

BO_ 2147548481 VDMA_FD41_Aftertreatment_1_SCR_D: 8 Vector__XXX
 SG_ Aftertreatment_1_SCR_Dosing_Syst : 0|64@1+ (1,0) [0|18446744073709551615] "" Vector__XXX

BO_ 2147548482 VDMA_FD42_ISOBUS_compliance_cert: 8 Vector__XXX
 SG_ ISOBUS_compliance_certification_ : 0|64@1+ (1,0) [0|18446744073709551615] "" Vector__XXX

BO_ 2147548484 VDMA_FD44_Aftertreatment_2_Fuel_: 8 Vector__XXX
 SG_ Aftertreatment_2_Fuel_Control_2_ : 0|64@1+ (1,0) [0|18446744073709551615] "" Vector__XXX

BO_ 2147548485 VDMA_FD45_Aftertreatment_2_Three: 8 Vector__XXX
 SG_ Aftertreatment_2_Three_Way_Catal : 0|64@1+ (1,0) [0|18446744073709551615] "" Vector__XXX

BO_ 2147548486 VDMA_FD46_Aftertreatment_1_Three: 8 Vector__XXX
 SG_ Aftertreatment_1_Three_Way_Catal : 0|64@1+ (1,0) [0|18446744073709551615] "" Vector__XXX

BO_ 2147548487 VDMA_FD47_Transmission_Mode_Labe: 8 Vector__XXX
 SG_ Transmission_Mode_Labels_RawPayl : 0|64@1+ (1,0) [0|18446744073709551615] "" Vector__XXX

BO_ 2147548488 VDMA_FD48_Engine_Exhaust_Bank_2_: 8 Vector__XXX
 SG_ Engine_Exhaust_Bank_2_O2_Fuel_Tr : 0|64@1+ (1,0) [0|18446744073709551615] "" Vector__XXX

BO_ 2147548489 VDMA_FD49_Engine_Exhaust_Bank_1_: 8 Vector__XXX
 SG_ Engine_Exhaust_Bank_1_O2_Fuel_Tr : 0|64@1+ (1,0) [0|18446744073709551615] "" Vector__XXX

BO_ 2147548490 VDMA_FD4A_General_Purpose_Messag: 8 Vector__XXX
 SG_ General_Purpose_Message_2_11_Raw : 0|64@1+ (1,0) [0|18446744073709551615] "" Vector__XXX

BO_ 2147548491 VDMA_FD4B_General_Purpose_Messag: 8 Vector__XXX
 SG_ General_Purpose_Message_2_10_Raw : 0|64@1+ (1,0) [0|18446744073709551615] "" Vector__XXX

BO_ 2147548492 VDMA_FD4C_General_Purpose_Messag: 8 Vector__XXX
 SG_ General_Purpose_Message_2_9_RawP : 0|64@1+ (1,0) [0|18446744073709551615] "" Vector__XXX

BO_ 2147548493 VDMA_FD4D_General_Purpose_Messag: 8 Vector__XXX
 SG_ General_Purpose_Message_2_8_RawP : 0|64@1+ (1,0) [0|18446744073709551615] "" Vector__XXX

BO_ 2147548494 VDMA_FD4E_General_Purpose_Messag: 8 Vector__XXX
 SG_ General_Purpose_Message_2_7_RawP : 0|64@1+ (1,0) [0|18446744073709551615] "" Vector__XXX

BO_ 2147548495 VDMA_FD4F_General_Purpose_Messag: 8 Vector__XXX
 SG_ General_Purpose_Message_2_6_RawP : 0|64@1+ (1,0) [0|18446744073709551615] "" Vector__XXX

BO_ 2147548496 VDMA_FD50_General_Purpose_Messag: 8 Vector__XXX
 SG_ General_Purpose_Message_1_9_RawP : 0|64@1+ (1,0) [0|18446744073709551615] "" Vector__XXX

BO_ 2147548497 VDMA_FD51_Aftercooler_Coolant_Co: 8 Vector__XXX
 SG_ Aftercooler_Coolant_Control_Valv : 0|64@1+ (1,0) [0|18446744073709551615] "" Vector__XXX

BO_ 2147548498 VDMA_FD52_Engine_Coolant_Control: 8 Vector__XXX
 SG_ Engine_Coolant_Control_Valve_Com : 0|64@1+ (1,0) [0|18446744073709551615] "" Vector__XXX

BO_ 2147548499 VDMA_FD53_Engine_Average_Informa: 8 Vector__XXX
 SG_ Engine_Average_Information_RawPa : 0|64@1+ (1,0) [0|18446744073709551615] "" Vector__XXX

BO_ 2147548500 VDMA_FD54_DTCs_C_Previously_Acti: 8 Vector__XXX
 SG_ DTCs_C_Previously_Active_RawPayl : 0|64@1+ (1,0) [0|18446744073709551615] "" Vector__XXX

BO_ 2147548501 VDMA_FD55_DTCs_C_Confirmed_and_A: 8 Vector__XXX
 SG_ DTCs_C_Confirmed_and_Active_RawP : 0|64@1+ (1,0) [0|18446744073709551615] "" Vector__XXX

BO_ 2147548502 VDMA_FD56_DTCs_C_Pending: 8 Vector__XXX
 SG_ DTCs_C_Pending_RawPayload : 0|64@1+ (1,0) [0|18446744073709551615] "" Vector__XXX

BO_ 2147548503 VDMA_FD57_DTCs_B2_Previously_Act: 8 Vector__XXX
 SG_ DTCs_B2_Previously_Active_RawPay : 0|64@1+ (1,0) [0|18446744073709551615] "" Vector__XXX

BO_ 2147548504 VDMA_FD58_DTCs_B2_Confirmed_and_: 8 Vector__XXX
 SG_ DTCs_B2_Confirmed_and_Active_Raw : 0|64@1+ (1,0) [0|18446744073709551615] "" Vector__XXX

BO_ 2147548505 VDMA_FD59_DTCs_B2_Pending: 8 Vector__XXX
 SG_ DTCs_B2_Pending_RawPayload : 0|64@1+ (1,0) [0|18446744073709551615] "" Vector__XXX

BO_ 2147548506 VDMA_FD5A_DTCs_B1_Previously_Act: 8 Vector__XXX
 SG_ DTCs_B1_Previously_Active_RawPay : 0|64@1+ (1,0) [0|18446744073709551615] "" Vector__XXX

BO_ 2147548507 VDMA_FD5B_DTCs_B1_Confirmed_and_: 8 Vector__XXX
 SG_ DTCs_B1_Confirmed_and_Active_Raw : 0|64@1+ (1,0) [0|18446744073709551615] "" Vector__XXX

BO_ 2147548508 VDMA_FD5C_DTCs_B1_Pending: 8 Vector__XXX
 SG_ DTCs_B1_Pending_RawPayload : 0|64@1+ (1,0) [0|18446744073709551615] "" Vector__XXX

BO_ 2147548509 VDMA_FD5D_DTCs_A_Previously_Acti: 8 Vector__XXX
 SG_ DTCs_A_Previously_Active_RawPayl : 0|64@1+ (1,0) [0|18446744073709551615] "" Vector__XXX

BO_ 2147548510 VDMA_FD5E_DTCs_A_Confirmed_and_A: 8 Vector__XXX
 SG_ DTCs_A_Confirmed_and_Active_RawP : 0|64@1+ (1,0) [0|18446744073709551615] "" Vector__XXX

BO_ 2147548511 VDMA_FD5F_DTCs_A_Pending: 8 Vector__XXX
 SG_ DTCs_A_Pending_RawPayload : 0|64@1+ (1,0) [0|18446744073709551615] "" Vector__XXX

BO_ 2147548512 VDMA_FD60_Harmonized_B1_Failure_: 8 Vector__XXX
 SG_ Harmonized_B1_Failure_Counts_Raw : 0|64@1+ (1,0) [0|18446744073709551615] "" Vector__XXX

BO_ 2147548513 VDMA_FD61_Harmonized_Cumulative_: 8 Vector__XXX
 SG_ Harmonized_Cumulative_Continuous : 0|64@1+ (1,0) [0|18446744073709551615] "" Vector__XXX

BO_ 2147548514 VDMA_FD62_Harmonized_Global_Regu: 8 Vector__XXX
 SG_ Harmonized_Global_Regulation_Des : 0|64@1+ (1,0) [0|18446744073709551615] "" Vector__XXX

BO_ 2147548515 VDMA_FD63_Harmonized_Roadworthin: 8 Vector__XXX
 SG_ Harmonized_Roadworthiness_System : 0|64@1+ (1,0) [0|18446744073709551615] "" Vector__XXX

BO_ 2147548516 VDMA_FD64_Harmonized_Roadworthin: 8 Vector__XXX
 SG_ Harmonized_Roadworthiness_Vehicl : 0|64@1+ (1,0) [0|18446744073709551615] "" Vector__XXX

BO_ 2147548517 VDMA_FD65_Aftertreatment_1_Fuel_: 8 Vector__XXX
 SG_ Aftertreatment_1_Fuel_Control_2_ : 0|64@1+ (1,0) [0|18446744073709551615] "" Vector__XXX

BO_ 2147548518 VDMA_FD66_Engine_Temperature_4: 8 Vector__XXX
 SG_ Engine_Temperature_4_RawPayload : 0|64@1+ (1,0) [0|18446744073709551615] "" Vector__XXX

BO_ 2147548519 VDMA_FD67_Zero_Net_Vehicle_Weigh: 8 Vector__XXX
 SG_ Zero_Net_Vehicle_Weight_Change_R : 0|64@1+ (1,0) [0|18446744073709551615] "" Vector__XXX

BO_ 2147548520 VDMA_FD68_Gross_Combination_Vehi: 8 Vector__XXX
 SG_ Gross_Combination_Vehicle_Weight : 0|64@1+ (1,0) [0|18446744073709551615] "" Vector__XXX

BO_ 2147548521 VDMA_FD69_Axle_Group_Calibration: 8 Vector__XXX
 SG_ Axle_Group_Calibration_Weights_R : 0|64@1+ (1,0) [0|18446744073709551615] "" Vector__XXX

BO_ 2147548522 VDMA_FD6A_Axle_Group_Weight: 8 Vector__XXX
 SG_ Axle_Group_Weight_RawPayload : 0|64@1+ (1,0) [0|18446744073709551615] "" Vector__XXX

BO_ 2147548523 VDMA_FD6B_Available_Axle_Group_W: 8 Vector__XXX
 SG_ Available_Axle_Group_Weights_Raw : 0|64@1+ (1,0) [0|18446744073709551615] "" Vector__XXX

BO_ 2147548524 VDMA_FD6C_Aftertreatment_2_Air_C: 8 Vector__XXX
 SG_ Aftertreatment_2_Air_Control_2_R : 0|64@1+ (1,0) [0|18446744073709551615] "" Vector__XXX

BO_ 2147548525 VDMA_FD6D_Aftertreatment_1_Air_C: 8 Vector__XXX
 SG_ Aftertreatment_1_Air_Control_2_R : 0|64@1+ (1,0) [0|18446744073709551615] "" Vector__XXX

BO_ 2147548526 VDMA_FD6E_Aftertreatment_1_SCR_S: 8 Vector__XXX
 SG_ Aftertreatment_1_SCR_Service_Inf : 0|64@1+ (1,0) [0|18446744073709551615] "" Vector__XXX

BO_ 2147548527 VDMA_FD6F_Electronic_Engine_Cont: 8 Vector__XXX
 SG_ Electronic_Engine_Controller_8_R : 0|64@1+ (1,0) [0|18446744073709551615] "" Vector__XXX

BO_ 2147548528 VDMA_FD70_Door_ramp_control: 8 Vector__XXX
 SG_ Door_ramp_control_RawPayload : 0|64@1+ (1,0) [0|18446744073709551615] "" Vector__XXX

BO_ 2147548529 VDMA_FD71_Brake_actuator_stroke_: 8 Vector__XXX
 SG_ Brake_actuator_stroke_status_Raw : 0|64@1+ (1,0) [0|18446744073709551615] "" Vector__XXX

BO_ 2147548530 VDMA_FD72_Engine_Spark_Voltage_6: 8 Vector__XXX
 SG_ Engine_Spark_Voltage_6_RawPayloa : 0|64@1+ (1,0) [0|18446744073709551615] "" Vector__XXX

BO_ 2147548531 VDMA_FD73_Engine_Spark_Voltage_5: 8 Vector__XXX
 SG_ Engine_Spark_Voltage_5_RawPayloa : 0|64@1+ (1,0) [0|18446744073709551615] "" Vector__XXX

BO_ 2147548532 VDMA_FD74_Engine_Spark_Voltage_4: 8 Vector__XXX
 SG_ Engine_Spark_Voltage_4_RawPayloa : 0|64@1+ (1,0) [0|18446744073709551615] "" Vector__XXX

BO_ 2147548533 VDMA_FD75_Engine_Spark_Voltage_3: 8 Vector__XXX
 SG_ Engine_Spark_Voltage_3_RawPayloa : 0|64@1+ (1,0) [0|18446744073709551615] "" Vector__XXX

BO_ 2147548534 VDMA_FD76_Engine_Spark_Voltage_2: 8 Vector__XXX
 SG_ Engine_Spark_Voltage_2_RawPayloa : 0|64@1+ (1,0) [0|18446744073709551615] "" Vector__XXX

BO_ 2147548535 VDMA_FD77_Engine_Spark_Voltage_1: 8 Vector__XXX
 SG_ Engine_Spark_Voltage_1_RawPayloa : 0|64@1+ (1,0) [0|18446744073709551615] "" Vector__XXX

BO_ 2147548536 VDMA_FD78_Aftertreatment_2_Trip_: 8 Vector__XXX
 SG_ Aftertreatment_2_Trip_Informatio : 0|64@1+ (1,0) [0|18446744073709551615] "" Vector__XXX

BO_ 2147548537 VDMA_FD79_Aftertreatment_1_Trip_: 8 Vector__XXX
 SG_ Aftertreatment_1_Trip_Informatio : 0|64@1+ (1,0) [0|18446744073709551615] "" Vector__XXX

BO_ 2147548538 VDMA_FD7A_Aftertreatment_2_Servi: 8 Vector__XXX
 SG_ Aftertreatment_2_Service_1_RawPa : 0|64@1+ (1,0) [0|18446744073709551615] "" Vector__XXX

BO_ 2147548539 VDMA_FD7B_Aftertreatment_1_Servi: 8 Vector__XXX
 SG_ Aftertreatment_1_Service_1_RawPa : 0|64@1+ (1,0) [0|18446744073709551615] "" Vector__XXX

BO_ 2147548540 VDMA_FD7C_Diesel_Particulate_Fil: 8 Vector__XXX
 SG_ Diesel_Particulate_Filter_Contro : 0|64@1+ (1,0) [0|18446744073709551615] "" Vector__XXX

BO_ 2147548541 VDMA_FD7D_Reserved_for_FMS_Tellt: 8 Vector__XXX
 SG_ Reserved_for_FMS_Telltale_status : 0|64@1+ (1,0) [0|18446744073709551615] "" Vector__XXX

BO_ 2147548542 VDMA_FD7E_Adaptive_Front_Lightin: 8 Vector__XXX
 SG_ Adaptive_Front_Lighting_System_S : 0|64@1+ (1,0) [0|18446744073709551615] "" Vector__XXX

BO_ 2147548543 VDMA_FD7F_Engine_Configuration_2: 8 Vector__XXX
 SG_ Engine_Configuration_2_RawPayloa : 0|64@1+ (1,0) [0|18446744073709551615] "" Vector__XXX

BO_ 2147548544 VDMA_FD80_Emission_Related_Perma: 8 Vector__XXX
 SG_ Emission_Related_Permanent_Diagn : 0|64@1+ (1,0) [0|18446744073709551615] "" Vector__XXX

BO_ 2147548545 VDMA_FD81_EGR_Cooler_Bypass: 8 Vector__XXX
 SG_ EGR_Cooler_Bypass_RawPayload : 0|64@1+ (1,0) [0|18446744073709551615] "" Vector__XXX

BO_ 2147548546 VDMA_FD82_All_Pending_DTCs: 8 Vector__XXX
 SG_ All_Pending_DTCs_RawPayload : 0|64@1+ (1,0) [0|18446744073709551615] "" Vector__XXX

BO_ 2147548547 VDMA_FD83_Transfer_Case_Informat: 8 Vector__XXX
 SG_ Transfer_Case_Information_RawPay : 0|64@1+ (1,0) [0|18446744073709551615] "" Vector__XXX

BO_ 2147548548 VDMA_FD84_Engine_Fluid_Level_Pre: 8 Vector__XXX
 SG_ Engine_Fluid_Level_Pressure_9_Ra : 0|64@1+ (1,0) [0|18446744073709551615] "" Vector__XXX

BO_ 2147548549 VDMA_FD85_Engine_Fluid_Level_Pre: 8 Vector__XXX
 SG_ Engine_Fluid_Level_Pressure_8_Ra : 0|64@1+ (1,0) [0|18446744073709551615] "" Vector__XXX

BO_ 2147548550 VDMA_FD86_Engine_Fluid_Level_Pre: 8 Vector__XXX
 SG_ Engine_Fluid_Level_Pressure_7_Ra : 0|64@1+ (1,0) [0|18446744073709551615] "" Vector__XXX

BO_ 2147548551 VDMA_FD87_Engine_Fluid_Level_Pre: 8 Vector__XXX
 SG_ Engine_Fluid_Level_Pressure_6_Ra : 0|64@1+ (1,0) [0|18446744073709551615] "" Vector__XXX

BO_ 2147548552 VDMA_FD88_Engine_Fluid_Level_Pre: 8 Vector__XXX
 SG_ Engine_Fluid_Level_Pressure_5_Ra : 0|64@1+ (1,0) [0|18446744073709551615] "" Vector__XXX

BO_ 2147548553 VDMA_FD89_Vehicle_Direction_Spee: 8 Vector__XXX
 SG_ Vehicle_Direction_Speed_2_RawPay : 0|64@1+ (1,0) [0|18446744073709551615] "" Vector__XXX

BO_ 2147548554 VDMA_FD8A_SAE_J2012_2_Byte_DTC_D: 8 Vector__XXX
 SG_ SAE_J2012_2_Byte_DTC_Display_Raw : 0|64@1+ (1,0) [0|18446744073709551615] "" Vector__XXX

BO_ 2147548555 VDMA_FD8B_Aftertreatment_2_Gas_P: 8 Vector__XXX
 SG_ Aftertreatment_2_Gas_Parameters_ : 0|64@1+ (1,0) [0|18446744073709551615] "" Vector__XXX

BO_ 2147548556 VDMA_FD8C_Aftertreatment_1_Gas_P: 8 Vector__XXX
 SG_ Aftertreatment_1_Gas_Parameters_ : 0|64@1+ (1,0) [0|18446744073709551615] "" Vector__XXX

BO_ 2147548557 VDMA_FD8D_Utility_Total_AC_React: 8 Vector__XXX
 SG_ Utility_Total_AC_Reactive_Energy : 0|64@1+ (1,0) [0|18446744073709551615] "" Vector__XXX

BO_ 2147548558 VDMA_FD8E_Generator_Total_AC_Rea: 8 Vector__XXX
 SG_ Generator_Total_AC_Reactive_Ener : 0|64@1+ (1,0) [0|18446744073709551615] "" Vector__XXX

BO_ 2147548559 VDMA_FD8F_Generator_Total_AC_Per: 8 Vector__XXX
 SG_ Generator_Total_AC_Percent_Power : 0|64@1+ (1,0) [0|18446744073709551615] "" Vector__XXX

BO_ 2147548560 VDMA_FD90_Advertised_Engine_Torq: 8 Vector__XXX
 SG_ Advertised_Engine_Torque_Curve_R : 0|64@1+ (1,0) [0|18446744073709551615] "" Vector__XXX

BO_ 2147548561 VDMA_FD91_AC_Switching_Device_St: 8 Vector__XXX
 SG_ AC_Switching_Device_Status_RawPa : 0|64@1+ (1,0) [0|18446744073709551615] "" Vector__XXX

BO_ 2147548562 VDMA_FD92_Engine_Operating_Infor: 8 Vector__XXX
 SG_ Engine_Operating_Information_Raw : 0|64@1+ (1,0) [0|18446744073709551615] "" Vector__XXX

BO_ 2147548563 VDMA_FD93_Generator_Control_1: 8 Vector__XXX
 SG_ Generator_Control_1_RawPayload : 0|64@1+ (1,0) [0|18446744073709551615] "" Vector__XXX

BO_ 2147548564 VDMA_FD94_Electronic_Engine_Cont: 8 Vector__XXX
 SG_ Electronic_Engine_Controller_7_R : 0|64@1+ (1,0) [0|18446744073709551615] "" Vector__XXX

BO_ 2147548565 VDMA_FD95_Transmission_Fluids_2: 8 Vector__XXX
 SG_ Transmission_Fluids_2_RawPayload : 0|64@1+ (1,0) [0|18446744073709551615] "" Vector__XXX

BO_ 2147548566 VDMA_FD96_Fuel_Information_2_Liq: 8 Vector__XXX
 SG_ Fuel_Information_2_Liquid_RawPay : 0|64@1+ (1,0) [0|18446744073709551615] "" Vector__XXX

BO_ 2147548567 VDMA_FD97_Fuel_Information_3_Liq: 8 Vector__XXX
 SG_ Fuel_Information_3_Liquid_RawPay : 0|64@1+ (1,0) [0|18446744073709551615] "" Vector__XXX

BO_ 2147548568 VDMA_FD98_Aftertreatment_1_Histo: 8 Vector__XXX
 SG_ Aftertreatment_1_Historical_Info : 0|64@1+ (1,0) [0|18446744073709551615] "" Vector__XXX

BO_ 2147548569 VDMA_FD99_Aftertreatment_2_Histo: 8 Vector__XXX
 SG_ Aftertreatment_2_Historical_info : 0|64@1+ (1,0) [0|18446744073709551615] "" Vector__XXX

BO_ 2147548570 VDMA_FD9A_Electronic_Brake_Syste: 8 Vector__XXX
 SG_ Electronic_Brake_System_2_4_RawP : 0|64@1+ (1,0) [0|18446744073709551615] "" Vector__XXX

BO_ 2147548571 VDMA_FD9B_Aftertreatment_1_Diese: 8 Vector__XXX
 SG_ Aftertreatment_1_Diesel_Exhaust_ : 0|64@1+ (1,0) [0|18446744073709551615] "" Vector__XXX

BO_ 2147548572 VDMA_FD9C_Sensor_Electrical_Powe: 8 Vector__XXX
 SG_ Sensor_Electrical_Power_2_RawPay : 0|64@1+ (1,0) [0|18446744073709551615] "" Vector__XXX

BO_ 2147548573 VDMA_FD9D_Sensor_Electrical_Powe: 8 Vector__XXX
 SG_ Sensor_Electrical_Power_1_RawPay : 0|64@1+ (1,0) [0|18446744073709551615] "" Vector__XXX

BO_ 2147548574 VDMA_FD9E_Aftertreatment_2_Air_C: 8 Vector__XXX
 SG_ Aftertreatment_2_Air_Control_1_R : 0|64@1+ (1,0) [0|18446744073709551615] "" Vector__XXX

BO_ 2147548575 VDMA_FD9F_Aftertreatment_1_Air_C: 8 Vector__XXX
 SG_ Aftertreatment_1_Air_Control_1_R : 0|64@1+ (1,0) [0|18446744073709551615] "" Vector__XXX

BO_ 2147548576 VDMA_FDA0_Aftertreatment_2_Fuel_: 8 Vector__XXX
 SG_ Aftertreatment_2_Fuel_Control_1_ : 0|64@1+ (1,0) [0|18446744073709551615] "" Vector__XXX

BO_ 2147548577 VDMA_FDA1_Aftertreatment_1_Fuel_: 8 Vector__XXX
 SG_ Aftertreatment_1_Fuel_Control_1_ : 0|64@1+ (1,0) [0|18446744073709551615] "" Vector__XXX

BO_ 2147548578 VDMA_FDA2_Fuel_Information_3_Gas: 8 Vector__XXX
 SG_ Fuel_Information_3_Gaseous_RawPa : 0|64@1+ (1,0) [0|18446744073709551615] "" Vector__XXX

BO_ 2147548579 VDMA_FDA3_Electronic_Engine_Cont: 8 Vector__XXX
 SG_ Electronic_Engine_Controller_6_R : 0|64@1+ (1,0) [0|18446744073709551615] "" Vector__XXX

BO_ 2147548580 VDMA_FDA4_PTO_Drive_Engagement_1: 8 Vector__XXX
 SG_ PTO_Drive_Engagement_1_RawPayloa : 0|64@1+ (1,0) [0|18446744073709551615] "" Vector__XXX

BO_ 2147548581 VDMA_FDA5_Door_Control_2: 8 Vector__XXX
 SG_ Door_Control_2_RawPayload : 0|64@1+ (1,0) [0|18446744073709551615] "" Vector__XXX

BO_ 2147548582 VDMA_FDA6_Voltage_Regulator_Exci: 8 Vector__XXX
 SG_ Voltage_Regulator_Excitation_Sta : 0|64@1+ (1,0) [0|18446744073709551615] "" Vector__XXX

BO_ 2147548583 VDMA_FDA7_Voltage_Regulator_Oper: 8 Vector__XXX
 SG_ Voltage_Regulator_Operating_Mode : 0|64@1+ (1,0) [0|18446744073709551615] "" Vector__XXX

BO_ 2147548584 VDMA_FDA8_Wireless_Communication: 8 Vector__XXX
 SG_ Wireless_Communications_Message_ : 0|64@1+ (1,0) [0|18446744073709551615] "" Vector__XXX

BO_ 2147548585 VDMA_FDA9_Wireless_Communication: 8 Vector__XXX
 SG_ Wireless_Communications_Message_ : 0|64@1+ (1,0) [0|18446744073709551615] "" Vector__XXX

BO_ 2147548586 VDMA_FDAA_Engine_Fluid_Level_Pre: 8 Vector__XXX
 SG_ Engine_Fluid_Level_Pressure_4_Ra : 0|64@1+ (1,0) [0|18446744073709551615] "" Vector__XXX

BO_ 2147548587 VDMA_FDAB_Request_For_Complete_C: 8 Vector__XXX
 SG_ Request_For_Complete_Configurabl : 0|64@1+ (1,0) [0|18446744073709551615] "" Vector__XXX

BO_ 2147548588 VDMA_FDAC_Engine_Fuel_Informatio: 8 Vector__XXX
 SG_ Engine_Fuel_Information_RawPaylo : 0|64@1+ (1,0) [0|18446744073709551615] "" Vector__XXX

BO_ 2147548589 VDMA_FDAD_Request_For_Complete_C: 8 Vector__XXX
 SG_ Request_For_Complete_Configurabl : 0|64@1+ (1,0) [0|18446744073709551615] "" Vector__XXX

BO_ 2147548590 VDMA_FDAE_Fifth_Wheel_Smart_Syst: 8 Vector__XXX
 SG_ Fifth_Wheel_Smart_Systems_2_RawP : 0|64@1+ (1,0) [0|18446744073709551615] "" Vector__XXX

BO_ 2147548591 VDMA_FDAF_Aftertreatment_2_Inter: 8 Vector__XXX
 SG_ Aftertreatment_2_Intermediate_Ga : 0|64@1+ (1,0) [0|18446744073709551615] "" Vector__XXX

BO_ 2147548592 VDMA_FDB0_Aftertreatment_2_Outle: 8 Vector__XXX
 SG_ Aftertreatment_2_Outlet_Gas_2_Ra : 0|64@1+ (1,0) [0|18446744073709551615] "" Vector__XXX

BO_ 2147548593 VDMA_FDB1_Aftertreatment_2_Intak: 8 Vector__XXX
 SG_ Aftertreatment_2_Intake_Gas_2_Ra : 0|64@1+ (1,0) [0|18446744073709551615] "" Vector__XXX

BO_ 2147548594 VDMA_FDB2_Aftertreatment_1_Inter: 8 Vector__XXX
 SG_ Aftertreatment_1_Intermediate_Ga : 0|64@1+ (1,0) [0|18446744073709551615] "" Vector__XXX

BO_ 2147548595 VDMA_FDB3_Aftertreatment_1_Outle: 8 Vector__XXX
 SG_ Aftertreatment_1_Outlet_Gas_2_Ra : 0|64@1+ (1,0) [0|18446744073709551615] "" Vector__XXX

BO_ 2147548596 VDMA_FDB4_Aftertreatment_1_Intak: 8 Vector__XXX
 SG_ Aftertreatment_1_Intake_Gas_2_Ra : 0|64@1+ (1,0) [0|18446744073709551615] "" Vector__XXX

BO_ 2147548597 VDMA_FDB5_Emission_Related_Previ: 8 Vector__XXX
 SG_ Emission_Related_Previously_MIL_ : 0|64@1+ (1,0) [0|18446744073709551615] "" Vector__XXX

BO_ 2147548598 VDMA_FDB6_SPN_Support: 8 Vector__XXX
 SG_ SPN_Support_RawPayload : 0|64@1+ (1,0) [0|18446744073709551615] "" Vector__XXX

BO_ 2147548599 VDMA_FDB7_Expanded_Freeze_Frame: 8 Vector__XXX
 SG_ Expanded_Freeze_Frame_RawPayload : 0|64@1+ (1,0) [0|18446744073709551615] "" Vector__XXX

BO_ 2147548600 VDMA_FDB8_Diagnostic_Readiness_3: 8 Vector__XXX
 SG_ Diagnostic_Readiness_3_RawPayloa : 0|64@1+ (1,0) [0|18446744073709551615] "" Vector__XXX

BO_ 2147548601 VDMA_FDB9_Tire_Pressure_Referenc: 8 Vector__XXX
 SG_ Tire_Pressure_Reference_Informat : 0|64@1+ (1,0) [0|18446744073709551615] "" Vector__XXX

BO_ 2147548602 VDMA_FDBA_Farebox_Status: 8 Vector__XXX
 SG_ Farebox_Status_RawPayload : 0|64@1+ (1,0) [0|18446744073709551615] "" Vector__XXX

BO_ 2147548603 VDMA_FDBB_Farebox_Point_of_Sale: 8 Vector__XXX
 SG_ Farebox_Point_of_Sale_RawPayload : 0|64@1+ (1,0) [0|18446744073709551615] "" Vector__XXX

BO_ 2147548604 VDMA_FDBC_Farebox_Service_Detail: 8 Vector__XXX
 SG_ Farebox_Service_Detail_RawPayloa : 0|64@1+ (1,0) [0|18446744073709551615] "" Vector__XXX

BO_ 2147548605 VDMA_FDBD_Signal_Preemption: 8 Vector__XXX
 SG_ Signal_Preemption_RawPayload : 0|64@1+ (1,0) [0|18446744073709551615] "" Vector__XXX

BO_ 2147548606 VDMA_FDBE_Transit_Route: 8 Vector__XXX
 SG_ Transit_Route_RawPayload : 0|64@1+ (1,0) [0|18446744073709551615] "" Vector__XXX

BO_ 2147548607 VDMA_FDBF_Transit_Milepost: 8 Vector__XXX
 SG_ Transit_Milepost_RawPayload : 0|64@1+ (1,0) [0|18446744073709551615] "" Vector__XXX

BO_ 2147548608 VDMA_FDC0_Passenger_Counter: 8 Vector__XXX
 SG_ Passenger_Counter_RawPayload : 0|64@1+ (1,0) [0|18446744073709551615] "" Vector__XXX

BO_ 2147548609 VDMA_FDC1_Engine_Fluid_Level_Pre: 8 Vector__XXX
 SG_ Engine_Fluid_Level_Pressure_3_Ra : 0|64@1+ (1,0) [0|18446744073709551615] "" Vector__XXX

BO_ 2147548610 VDMA_FDC2_Electronic_Engine_Cont: 8 Vector__XXX
 SG_ Electronic_Engine_Controller_14_ : 0|64@1+ (1,0) [0|18446744073709551615] "" Vector__XXX

BO_ 2147548611 VDMA_FDC3_Electronic_Engine_Cont: 8 Vector__XXX
 SG_ Electronic_Engine_Controller_15_ : 0|64@1+ (1,0) [0|18446744073709551615] "" Vector__XXX

BO_ 2147548612 VDMA_FDC4_Electronic_Brake_Contr: 8 Vector__XXX
 SG_ Electronic_Brake_Controller_5_Ra : 0|64@1+ (1,0) [0|18446744073709551615] "" Vector__XXX

BO_ 2147548614 VDMA_FDC6_Cold_Start_Aids: 8 Vector__XXX
 SG_ Cold_Start_Aids_RawPayload : 0|64@1+ (1,0) [0|18446744073709551615] "" Vector__XXX

BO_ 2147548615 VDMA_FDC7_Off_Highway_Engine_Con: 8 Vector__XXX
 SG_ Off_Highway_Engine_Control_Selec : 0|64@1+ (1,0) [0|18446744073709551615] "" Vector__XXX

BO_ 2147548616 VDMA_FDC8_Operator_Primary_Inter: 8 Vector__XXX
 SG_ Operator_Primary_Intermediate_Sp : 0|64@1+ (1,0) [0|18446744073709551615] "" Vector__XXX

BO_ 2147548617 VDMA_FDC9_Electronic_Control_Mod: 8 Vector__XXX
 SG_ Electronic_Control_Module_Inform : 0|64@1+ (1,0) [0|18446744073709551615] "" Vector__XXX

BO_ 2147548618 VDMA_FDCA_Intermediate_Speed_Con: 8 Vector__XXX
 SG_ Intermediate_Speed_Control_RawPa : 0|64@1+ (1,0) [0|18446744073709551615] "" Vector__XXX

BO_ 2147548619 VDMA_FDCB_Off_Highway_Engine_Con: 8 Vector__XXX
 SG_ Off_Highway_Engine_Control_Selec : 0|64@1+ (1,0) [0|18446744073709551615] "" Vector__XXX

BO_ 2147548620 VDMA_FDCC_Operators_External_Lig: 8 Vector__XXX
 SG_ Operators_External_Light_Control : 0|64@1+ (1,0) [0|18446744073709551615] "" Vector__XXX

BO_ 2147548621 VDMA_FDCD_Operator_Wiper_and_Was: 8 Vector__XXX
 SG_ Operator_Wiper_and_Washer_Contro : 0|64@1+ (1,0) [0|18446744073709551615] "" Vector__XXX

BO_ 2147548622 VDMA_FDCE_Working_Set_Member_Mes: 8 Vector__XXX
 SG_ Working_Set_Member_Message_Obsol : 0|64@1+ (1,0) [0|18446744073709551615] "" Vector__XXX

BO_ 2147548623 VDMA_FDCF_Working_Set_Master_Mes: 8 Vector__XXX
 SG_ Working_Set_Master_Message_Obsol : 0|64@1+ (1,0) [0|18446744073709551615] "" Vector__XXX

BO_ 2147548624 VDMA_FDD0_Intake_Exhaust_Conditi: 8 Vector__XXX
 SG_ Intake_Exhaust_Conditions_2_RawP : 0|64@1+ (1,0) [0|18446744073709551615] "" Vector__XXX

BO_ 2147548625 VDMA_FDD1_FMS_standard_Interface: 8 Vector__XXX
 SG_ FMS_standard_Interface_Identity_ : 0|64@1+ (1,0) [0|18446744073709551615] "" Vector__XXX

BO_ 2147548626 VDMA_FDD2_ECU_Performance: 8 Vector__XXX
 SG_ ECU_Performance_RawPayload : 0|64@1+ (1,0) [0|18446744073709551615] "" Vector__XXX

BO_ 2147548627 VDMA_FDD3_Turbocharger_Informati: 8 Vector__XXX
 SG_ Turbocharger_Information_6_RawPa : 0|64@1+ (1,0) [0|18446744073709551615] "" Vector__XXX

BO_ 2147548628 VDMA_FDD4_Cab_Message_3: 8 Vector__XXX
 SG_ Cab_Message_3_RawPayload : 0|64@1+ (1,0) [0|18446744073709551615] "" Vector__XXX

BO_ 2147548629 VDMA_FDD5_Electronic_Engine_Cont: 8 Vector__XXX
 SG_ Electronic_Engine_Controller_5_R : 0|64@1+ (1,0) [0|18446744073709551615] "" Vector__XXX

BO_ 2147548630 VDMA_FDD6_Basic_Joystick_Message: 8 Vector__XXX
 SG_ Basic_Joystick_Message_1_RawPayl : 0|64@1+ (1,0) [0|18446744073709551615] "" Vector__XXX

BO_ 2147548631 VDMA_FDD7_Extended_Joystick_Mess: 8 Vector__XXX
 SG_ Extended_Joystick_Message_1_RawP : 0|64@1+ (1,0) [0|18446744073709551615] "" Vector__XXX

BO_ 2147548632 VDMA_FDD8_Basic_Joystick_Message: 8 Vector__XXX
 SG_ Basic_Joystick_Message_2_RawPayl : 0|64@1+ (1,0) [0|18446744073709551615] "" Vector__XXX

BO_ 2147548633 VDMA_FDD9_Extended_Joystick_Mess: 8 Vector__XXX
 SG_ Extended_Joystick_Message_2_RawP : 0|64@1+ (1,0) [0|18446744073709551615] "" Vector__XXX

BO_ 2147548634 VDMA_FDDA_Basic_Joystick_Message: 8 Vector__XXX
 SG_ Basic_Joystick_Message_3_RawPayl : 0|64@1+ (1,0) [0|18446744073709551615] "" Vector__XXX

BO_ 2147548635 VDMA_FDDB_Extended_Joystick_Mess: 8 Vector__XXX
 SG_ Extended_Joystick_Message_3_RawP : 0|64@1+ (1,0) [0|18446744073709551615] "" Vector__XXX

BO_ 2147548636 VDMA_FDDC_Marine_Control_Informa: 8 Vector__XXX
 SG_ Marine_Control_Information_RawPa : 0|64@1+ (1,0) [0|18446744073709551615] "" Vector__XXX

BO_ 2147548637 VDMA_FDDD_Military_Application_M: 8 Vector__XXX
 SG_ Military_Application_Message_1_1 : 0|64@1+ (1,0) [0|18446744073709551615] "" Vector__XXX

BO_ 2147548638 VDMA_FDDE_Military_Application_M: 8 Vector__XXX
 SG_ Military_Application_Message_2_1 : 0|64@1+ (1,0) [0|18446744073709551615] "" Vector__XXX

BO_ 2147548639 VDMA_FDDF_Front_Wheel_Drive_Stat: 8 Vector__XXX
 SG_ Front_Wheel_Drive_Status_RawPayl : 0|64@1+ (1,0) [0|18446744073709551615] "" Vector__XXX

BO_ 2147548640 VDMA_FDE0_Ambient_Conditions_2: 8 Vector__XXX
 SG_ Ambient_Conditions_2_RawPayload : 0|64@1+ (1,0) [0|18446744073709551615] "" Vector__XXX

BO_ 2147548641 VDMA_FDE1_Cab_Climate_System_Inf: 8 Vector__XXX
 SG_ Cab_Climate_System_Information_1 : 0|64@1+ (1,0) [0|18446744073709551615] "" Vector__XXX

BO_ 2147548642 VDMA_FDE2_Supply_Pressure_Demand: 8 Vector__XXX
 SG_ Supply_Pressure_Demand_RawPayloa : 0|64@1+ (1,0) [0|18446744073709551615] "" Vector__XXX

BO_ 2147548643 VDMA_FDE3_Equipment_Operation_an: 8 Vector__XXX
 SG_ Equipment_Operation_and_Control_ : 0|64@1+ (1,0) [0|18446744073709551615] "" Vector__XXX

BO_ 2147548644 VDMA_FDE4_Equipment_Performance_: 8 Vector__XXX
 SG_ Equipment_Performance_Data_RawPa : 0|64@1+ (1,0) [0|18446744073709551615] "" Vector__XXX

BO_ 2147548645 VDMA_FDE5_Maximum_Vehicle_Speed_: 8 Vector__XXX
 SG_ Maximum_Vehicle_Speed_Limit_Stat : 0|64@1+ (1,0) [0|18446744073709551615] "" Vector__XXX

BO_ 2147548646 VDMA_FDE6_Hydraulic_Braking_Syst: 8 Vector__XXX
 SG_ Hydraulic_Braking_System_RawPayl : 0|64@1+ (1,0) [0|18446744073709551615] "" Vector__XXX

BO_ 2147548647 VDMA_FDE7_Bus_1_Utility_Sync_Che: 8 Vector__XXX
 SG_ Bus_1_Utility_Sync_Check_Status_ : 0|64@1+ (1,0) [0|18446744073709551615] "" Vector__XXX

BO_ 2147548648 VDMA_FDE8_Bus_1_Generator_Sync_C: 8 Vector__XXX
 SG_ Bus_1_Generator_Sync_Check_Statu : 0|64@1+ (1,0) [0|18446744073709551615] "" Vector__XXX

BO_ 2147548649 VDMA_FDE9_Bus_1_Phase_C_Basic_AC: 8 Vector__XXX
 SG_ Bus_1_Phase_C_Basic_AC_Quantitie : 0|64@1+ (1,0) [0|18446744073709551615] "" Vector__XXX

BO_ 2147548650 VDMA_FDEA_Bus_1_Phase_B_Basic_AC: 8 Vector__XXX
 SG_ Bus_1_Phase_B_Basic_AC_Quantitie : 0|64@1+ (1,0) [0|18446744073709551615] "" Vector__XXX

BO_ 2147548651 VDMA_FDEB_Bus_1_Phase_A_Basic_AC: 8 Vector__XXX
 SG_ Bus_1_Phase_A_Basic_AC_Quantitie : 0|64@1+ (1,0) [0|18446744073709551615] "" Vector__XXX

BO_ 2147548652 VDMA_FDEC_Bus_1_Average_Basic_AC: 8 Vector__XXX
 SG_ Bus_1_Average_Basic_AC_Quantitie : 0|64@1+ (1,0) [0|18446744073709551615] "" Vector__XXX

BO_ 2147548653 VDMA_FDED_Utility_Total_AC_Energ: 8 Vector__XXX
 SG_ Utility_Total_AC_Energy_RawPaylo : 0|64@1+ (1,0) [0|18446744073709551615] "" Vector__XXX

BO_ 2147548654 VDMA_FDEE_Utility_Phase_C_AC_Rea: 8 Vector__XXX
 SG_ Utility_Phase_C_AC_Reactive_Powe : 0|64@1+ (1,0) [0|18446744073709551615] "" Vector__XXX

BO_ 2147548655 VDMA_FDEF_Utility_Phase_C_AC_Pow: 8 Vector__XXX
 SG_ Utility_Phase_C_AC_Power_RawPayl : 0|64@1+ (1,0) [0|18446744073709551615] "" Vector__XXX

BO_ 2147548656 VDMA_FDF0_Utility_Phase_C_AC_Bas: 8 Vector__XXX
 SG_ Utility_Phase_C_AC_Basic_Quantit : 0|64@1+ (1,0) [0|18446744073709551615] "" Vector__XXX

BO_ 2147548657 VDMA_FDF1_Utility_Phase_B_AC_Rea: 8 Vector__XXX
 SG_ Utility_Phase_B_AC_Reactive_Powe : 0|64@1+ (1,0) [0|18446744073709551615] "" Vector__XXX

BO_ 2147548658 VDMA_FDF2_Utility_Phase_B_AC_Pow: 8 Vector__XXX
 SG_ Utility_Phase_B_AC_Power_RawPayl : 0|64@1+ (1,0) [0|18446744073709551615] "" Vector__XXX

BO_ 2147548659 VDMA_FDF3_Utility_Phase_B_AC_Bas: 8 Vector__XXX
 SG_ Utility_Phase_B_AC_Basic_Quantit : 0|64@1+ (1,0) [0|18446744073709551615] "" Vector__XXX

BO_ 2147548660 VDMA_FDF4_Utility_Phase_A_AC_Rea: 8 Vector__XXX
 SG_ Utility_Phase_A_AC_Reactive_Powe : 0|64@1+ (1,0) [0|18446744073709551615] "" Vector__XXX

BO_ 2147548661 VDMA_FDF5_Utility_Phase_A_AC_Pow: 8 Vector__XXX
 SG_ Utility_Phase_A_AC_Power_RawPayl : 0|64@1+ (1,0) [0|18446744073709551615] "" Vector__XXX

BO_ 2147548662 VDMA_FDF6_Utility_Phase_A_Basic_: 8 Vector__XXX
 SG_ Utility_Phase_A_Basic_AC_Quantit : 0|64@1+ (1,0) [0|18446744073709551615] "" Vector__XXX

BO_ 2147548663 VDMA_FDF7_Utility_Total_AC_React: 8 Vector__XXX
 SG_ Utility_Total_AC_Reactive_Power_ : 0|64@1+ (1,0) [0|18446744073709551615] "" Vector__XXX

BO_ 2147548664 VDMA_FDF8_Utility_Total_AC_Power: 8 Vector__XXX
 SG_ Utility_Total_AC_Power_RawPayloa : 0|64@1+ (1,0) [0|18446744073709551615] "" Vector__XXX

BO_ 2147548665 VDMA_FDF9_Utility_Average_Basic_: 8 Vector__XXX
 SG_ Utility_Average_Basic_AC_Quantit : 0|64@1+ (1,0) [0|18446744073709551615] "" Vector__XXX

BO_ 2147548666 VDMA_FDFA_Generator_Total_AC_Ene: 8 Vector__XXX
 SG_ Generator_Total_AC_Energy_RawPay : 0|64@1+ (1,0) [0|18446744073709551615] "" Vector__XXX

BO_ 2147548667 VDMA_FDFB_Generator_Phase_C_AC_R: 8 Vector__XXX
 SG_ Generator_Phase_C_AC_Reactive_Po : 0|64@1+ (1,0) [0|18446744073709551615] "" Vector__XXX

BO_ 2147548668 VDMA_FDFC_Generator_Phase_C_AC_P: 8 Vector__XXX
 SG_ Generator_Phase_C_AC_Power_RawPa : 0|64@1+ (1,0) [0|18446744073709551615] "" Vector__XXX

BO_ 2147548669 VDMA_FDFD_Generator_Phase_C_Basi: 8 Vector__XXX
 SG_ Generator_Phase_C_Basic_AC_Quant : 0|64@1+ (1,0) [0|18446744073709551615] "" Vector__XXX

BO_ 2147548670 VDMA_FDFE_Generator_Phase_B_AC_R: 8 Vector__XXX
 SG_ Generator_Phase_B_AC_Reactive_Po : 0|64@1+ (1,0) [0|18446744073709551615] "" Vector__XXX

BO_ 2147548671 VDMA_FDFF_Generator_Phase_B_AC_P: 8 Vector__XXX
 SG_ Generator_Phase_B_AC_Power_RawPa : 0|64@1+ (1,0) [0|18446744073709551615] "" Vector__XXX

BO_ 2147548672 VDMA_FE00_Generator_Phase_B_Basi: 8 Vector__XXX
 SG_ Generator_Phase_B_Basic_AC_Quant : 0|64@1+ (1,0) [0|18446744073709551615] "" Vector__XXX

BO_ 2147548673 VDMA_FE01_Generator_Phase_A_AC_R: 8 Vector__XXX
 SG_ Generator_Phase_A_AC_Reactive_Po : 0|64@1+ (1,0) [0|18446744073709551615] "" Vector__XXX

BO_ 2147548674 VDMA_FE02_Generator_Phase_A_AC_P: 8 Vector__XXX
 SG_ Generator_Phase_A_AC_Power_RawPa : 0|64@1+ (1,0) [0|18446744073709551615] "" Vector__XXX

BO_ 2147548675 VDMA_FE03_Generator_Phase_A_Basi: 8 Vector__XXX
 SG_ Generator_Phase_A_Basic_AC_Quant : 0|64@1+ (1,0) [0|18446744073709551615] "" Vector__XXX

BO_ 2147548676 VDMA_FE04_Generator_Total_AC_Rea: 8 Vector__XXX
 SG_ Generator_Total_AC_Reactive_Powe : 0|64@1+ (1,0) [0|18446744073709551615] "" Vector__XXX

BO_ 2147548677 VDMA_FE05_Generator_Total_AC_Pow: 8 Vector__XXX
 SG_ Generator_Total_AC_Power_RawPayl : 0|64@1+ (1,0) [0|18446744073709551615] "" Vector__XXX

BO_ 2147548678 VDMA_FE06_Generator_Average_Basi: 8 Vector__XXX
 SG_ Generator_Average_Basic_AC_Quant : 0|64@1+ (1,0) [0|18446744073709551615] "" Vector__XXX

BO_ 2147548679 VDMA_FE07_Exhaust_Temperature: 8 Vector__XXX
 SG_ Exhaust_Temperature_RawPayload : 0|64@1+ (1,0) [0|18446744073709551615] "" Vector__XXX

BO_ 2147548680 VDMA_FE08_Required_Tractor_Facil: 8 Vector__XXX
 SG_ Required_Tractor_Facilities_mess : 0|64@1+ (1,0) [0|18446744073709551615] "" Vector__XXX

BO_ 2147548681 VDMA_FE09_Tractor_Facilities_res: 8 Vector__XXX
 SG_ Tractor_Facilities_response_mess : 0|64@1+ (1,0) [0|18446744073709551615] "" Vector__XXX

BO_ 2147548682 VDMA_FE0A_Tractor_control_comman: 8 Vector__XXX
 SG_ Tractor_control_command_tractor_ : 0|64@1+ (1,0) [0|18446744073709551615] "" Vector__XXX

CM_ BO_ 2147548394  "Source: isobus.net VDMA Data Dictionary (https://www.isobus.net/isobus/pGNAndSPN/13645?type=PGN)";
CM_ BO_ 2147548395  "Source: isobus.net VDMA Data Dictionary (https://www.isobus.net/isobus/pGNAndSPN/13647?type=PGN)";
CM_ BO_ 2147548396  "Source: isobus.net VDMA Data Dictionary (https://www.isobus.net/isobus/pGNAndSPN/13649?type=PGN)";
CM_ BO_ 2147548397  "Source: isobus.net VDMA Data Dictionary (https://www.isobus.net/isobus/pGNAndSPN/13651?type=PGN)";
CM_ BO_ 2147548398  "Source: isobus.net VDMA Data Dictionary (https://www.isobus.net/isobus/pGNAndSPN/13655?type=PGN)";
CM_ BO_ 2147548399  "Source: isobus.net VDMA Data Dictionary (https://www.isobus.net/isobus/pGNAndSPN/13659?type=PGN)";
CM_ BO_ 2147548400  "Source: isobus.net VDMA Data Dictionary (https://www.isobus.net/isobus/pGNAndSPN/13664?type=PGN)";
CM_ BO_ 2147548401  "Source: isobus.net VDMA Data Dictionary (https://www.isobus.net/isobus/pGNAndSPN/13676?type=PGN)";
CM_ BO_ 2147548402  "Source: isobus.net VDMA Data Dictionary (https://www.isobus.net/isobus/pGNAndSPN/13690?type=PGN)";
CM_ BO_ 2147548403  "Source: isobus.net VDMA Data Dictionary (https://www.isobus.net/isobus/pGNAndSPN/13698?type=PGN)";
CM_ BO_ 2147548404  "Source: isobus.net VDMA Data Dictionary (https://www.isobus.net/isobus/pGNAndSPN/13702?type=PGN)";
CM_ BO_ 2147548405  "Source: isobus.net VDMA Data Dictionary (https://www.isobus.net/isobus/pGNAndSPN/13705?type=PGN)";
CM_ BO_ 2147548406  "Source: isobus.net VDMA Data Dictionary (https://www.isobus.net/isobus/pGNAndSPN/13709?type=PGN)";
CM_ BO_ 2147548407  "Source: isobus.net VDMA Data Dictionary (https://www.isobus.net/isobus/pGNAndSPN/13712?type=PGN)";
CM_ BO_ 2147548408  "Source: isobus.net VDMA Data Dictionary (https://www.isobus.net/isobus/pGNAndSPN/13715?type=PGN)";
CM_ BO_ 2147548409  "Source: isobus.net VDMA Data Dictionary (https://www.isobus.net/isobus/pGNAndSPN/13718?type=PGN)";
CM_ BO_ 2147548410  "Source: isobus.net VDMA Data Dictionary (https://www.isobus.net/isobus/pGNAndSPN/13722?type=PGN)";
CM_ BO_ 2147548411  "Source: isobus.net VDMA Data Dictionary (https://www.isobus.net/isobus/pGNAndSPN/13724?type=PGN)";
CM_ BO_ 2147548412  "Source: isobus.net VDMA Data Dictionary (https://www.isobus.net/isobus/pGNAndSPN/13726?type=PGN)";
CM_ BO_ 2147548413  "Source: isobus.net VDMA Data Dictionary (https://www.isobus.net/isobus/pGNAndSPN/13730?type=PGN)";
CM_ BO_ 2147548414  "Source: isobus.net VDMA Data Dictionary (https://www.isobus.net/isobus/pGNAndSPN/13735?type=PGN)";
CM_ BO_ 2147548415  "Source: isobus.net VDMA Data Dictionary (https://www.isobus.net/isobus/pGNAndSPN/13738?type=PGN)";
CM_ BO_ 2147548416  "Source: isobus.net VDMA Data Dictionary (https://www.isobus.net/isobus/pGNAndSPN/13743?type=PGN)";
CM_ BO_ 2147548417  "Source: isobus.net VDMA Data Dictionary (https://www.isobus.net/isobus/pGNAndSPN/13751?type=PGN)";
CM_ BO_ 2147548419  "Source: isobus.net VDMA Data Dictionary (https://www.isobus.net/isobus/pGNAndSPN/13754?type=PGN)";
CM_ BO_ 2147548420  "Source: isobus.net VDMA Data Dictionary (https://www.isobus.net/isobus/pGNAndSPN/13769?type=PGN)";
CM_ BO_ 2147548421  "Source: isobus.net VDMA Data Dictionary (https://www.isobus.net/isobus/pGNAndSPN/13796?type=PGN)";
CM_ BO_ 2147548422  "Source: isobus.net VDMA Data Dictionary (https://www.isobus.net/isobus/pGNAndSPN/13811?type=PGN)";
CM_ BO_ 2147548423  "Source: isobus.net VDMA Data Dictionary (https://www.isobus.net/isobus/pGNAndSPN/13838?type=PGN)";
CM_ BO_ 2147548424  "Source: isobus.net VDMA Data Dictionary (https://www.isobus.net/isobus/pGNAndSPN/13842?type=PGN)";
CM_ BO_ 2147548425  "Source: isobus.net VDMA Data Dictionary (https://www.isobus.net/isobus/pGNAndSPN/13844?type=PGN)";
CM_ BO_ 2147548426  "Source: isobus.net VDMA Data Dictionary (https://www.isobus.net/isobus/pGNAndSPN/13850?type=PGN)";
CM_ BO_ 2147548427  "Source: isobus.net VDMA Data Dictionary (https://www.isobus.net/isobus/pGNAndSPN/13854?type=PGN)";
CM_ BO_ 2147548428  "Source: isobus.net VDMA Data Dictionary (https://www.isobus.net/isobus/pGNAndSPN/13860?type=PGN)";
CM_ BO_ 2147548429  "Source: isobus.net VDMA Data Dictionary (https://www.isobus.net/isobus/pGNAndSPN/13864?type=PGN)";
CM_ BO_ 2147548430  "Source: isobus.net VDMA Data Dictionary (https://www.isobus.net/isobus/pGNAndSPN/13870?type=PGN)";
CM_ BO_ 2147548431  "Source: isobus.net VDMA Data Dictionary (https://www.isobus.net/isobus/pGNAndSPN/13874?type=PGN)";
CM_ BO_ 2147548432  "Source: isobus.net VDMA Data Dictionary (https://www.isobus.net/isobus/pGNAndSPN/13880?type=PGN)";
CM_ BO_ 2147548433  "Source: isobus.net VDMA Data Dictionary (https://www.isobus.net/isobus/pGNAndSPN/13884?type=PGN)";
CM_ BO_ 2147548434  "Source: isobus.net VDMA Data Dictionary (https://www.isobus.net/isobus/pGNAndSPN/13892?type=PGN)";
CM_ BO_ 2147548435  "Source: isobus.net VDMA Data Dictionary (https://www.isobus.net/isobus/pGNAndSPN/13894?type=PGN)";
CM_ BO_ 2147548436  "Source: isobus.net VDMA Data Dictionary (https://www.isobus.net/isobus/pGNAndSPN/13901?type=PGN)";
CM_ BO_ 2147548437  "Source: isobus.net VDMA Data Dictionary (https://www.isobus.net/isobus/pGNAndSPN/13908?type=PGN)";
CM_ BO_ 2147548438  "Source: isobus.net VDMA Data Dictionary (https://www.isobus.net/isobus/pGNAndSPN/13918?type=PGN)";
CM_ BO_ 2147548439  "Source: isobus.net VDMA Data Dictionary (https://www.isobus.net/isobus/pGNAndSPN/13930?type=PGN)";
CM_ BO_ 2147548440  "Source: isobus.net VDMA Data Dictionary (https://www.isobus.net/isobus/pGNAndSPN/13964?type=PGN)";
CM_ BO_ 2147548441  "Source: isobus.net VDMA Data Dictionary (https://www.isobus.net/isobus/pGNAndSPN/14064?type=PGN)";
CM_ BO_ 2147548442  "Source: isobus.net VDMA Data Dictionary (https://www.isobus.net/isobus/pGNAndSPN/14066?type=PGN)";
CM_ BO_ 2147548443  "Source: isobus.net VDMA Data Dictionary (https://www.isobus.net/isobus/pGNAndSPN/14072?type=PGN)";
CM_ BO_ 2147548444  "Source: isobus.net VDMA Data Dictionary (https://www.isobus.net/isobus/pGNAndSPN/14078?type=PGN)";
CM_ BO_ 2147548445  "Source: isobus.net VDMA Data Dictionary (https://www.isobus.net/isobus/pGNAndSPN/14080?type=PGN)";
CM_ BO_ 2147548446  "Source: isobus.net VDMA Data Dictionary (https://www.isobus.net/isobus/pGNAndSPN/14082?type=PGN)";
CM_ BO_ 2147548447  "Source: isobus.net VDMA Data Dictionary (https://www.isobus.net/isobus/pGNAndSPN/14088?type=PGN)";
CM_ BO_ 2147548448  "Source: isobus.net VDMA Data Dictionary (https://www.isobus.net/isobus/pGNAndSPN/14094?type=PGN)";
CM_ BO_ 2147548449  "Source: isobus.net VDMA Data Dictionary (https://www.isobus.net/isobus/pGNAndSPN/14100?type=PGN)";
CM_ BO_ 2147548450  "Source: isobus.net VDMA Data Dictionary (https://www.isobus.net/isobus/pGNAndSPN/14106?type=PGN)";
CM_ BO_ 2147548451  "Source: isobus.net VDMA Data Dictionary (https://www.isobus.net/isobus/pGNAndSPN/14125?type=PGN)";
CM_ BO_ 2147548452  "Source: isobus.net VDMA Data Dictionary (https://www.isobus.net/isobus/pGNAndSPN/14147?type=PGN)";
CM_ BO_ 2147548453  "Source: isobus.net VDMA Data Dictionary (https://www.isobus.net/isobus/pGNAndSPN/14166?type=PGN)";
CM_ BO_ 2147548454  "Source: isobus.net VDMA Data Dictionary (https://www.isobus.net/isobus/pGNAndSPN/14188?type=PGN)";
CM_ BO_ 2147548455  "Source: isobus.net VDMA Data Dictionary (https://www.isobus.net/isobus/pGNAndSPN/14207?type=PGN)";
CM_ BO_ 2147548456  "Source: isobus.net VDMA Data Dictionary (https://www.isobus.net/isobus/pGNAndSPN/14229?type=PGN)";
CM_ BO_ 2147548457  "Source: isobus.net VDMA Data Dictionary (https://www.isobus.net/isobus/pGNAndSPN/14248?type=PGN)";
CM_ BO_ 2147548458  "Source: isobus.net VDMA Data Dictionary (https://www.isobus.net/isobus/pGNAndSPN/14270?type=PGN)";
CM_ BO_ 2147548459  "Source: isobus.net VDMA Data Dictionary (https://www.isobus.net/isobus/pGNAndSPN/14289?type=PGN)";
CM_ BO_ 2147548460  "Source: isobus.net VDMA Data Dictionary (https://www.isobus.net/isobus/pGNAndSPN/14311?type=PGN)";
CM_ BO_ 2147548461  "Source: isobus.net VDMA Data Dictionary (https://www.isobus.net/isobus/pGNAndSPN/14330?type=PGN)";
CM_ BO_ 2147548462  "Source: isobus.net VDMA Data Dictionary (https://www.isobus.net/isobus/pGNAndSPN/14352?type=PGN)";
CM_ BO_ 2147548463  "Source: isobus.net VDMA Data Dictionary (https://www.isobus.net/isobus/pGNAndSPN/14371?type=PGN)";
CM_ BO_ 2147548464  "Source: isobus.net VDMA Data Dictionary (https://www.isobus.net/isobus/pGNAndSPN/14393?type=PGN)";
CM_ BO_ 2147548465  "Source: isobus.net VDMA Data Dictionary (https://www.isobus.net/isobus/pGNAndSPN/14398?type=PGN)";
CM_ BO_ 2147548467  "Source: isobus.net VDMA Data Dictionary (https://www.isobus.net/isobus/pGNAndSPN/14408?type=PGN)";
CM_ BO_ 2147548468  "Source: isobus.net VDMA Data Dictionary (https://www.isobus.net/isobus/pGNAndSPN/14415?type=PGN)";
CM_ BO_ 2147548469  "Source: isobus.net VDMA Data Dictionary (https://www.isobus.net/isobus/pGNAndSPN/14422?type=PGN)";
CM_ BO_ 2147548470  "Source: isobus.net VDMA Data Dictionary (https://www.isobus.net/isobus/pGNAndSPN/14428?type=PGN)";
CM_ BO_ 2147548471  "Source: isobus.net VDMA Data Dictionary (https://www.isobus.net/isobus/pGNAndSPN/14433?type=PGN)";
CM_ BO_ 2147548472  "Source: isobus.net VDMA Data Dictionary (https://www.isobus.net/isobus/pGNAndSPN/14437?type=PGN)";
CM_ BO_ 2147548473  "Source: isobus.net VDMA Data Dictionary (https://www.isobus.net/isobus/pGNAndSPN/14441?type=PGN)";
CM_ BO_ 2147548474  "Source: isobus.net VDMA Data Dictionary (https://www.isobus.net/isobus/pGNAndSPN/14458?type=PGN)";
CM_ BO_ 2147548475  "Source: isobus.net VDMA Data Dictionary (https://www.isobus.net/isobus/pGNAndSPN/14471?type=PGN)";
CM_ BO_ 2147548476  "Source: isobus.net VDMA Data Dictionary (https://www.isobus.net/isobus/pGNAndSPN/14480?type=PGN)";
CM_ BO_ 2147548477  "Source: isobus.net VDMA Data Dictionary (https://www.isobus.net/isobus/pGNAndSPN/14487?type=PGN)";
CM_ BO_ 2147548478  "Source: isobus.net VDMA Data Dictionary (https://www.isobus.net/isobus/pGNAndSPN/14491?type=PGN)";
CM_ BO_ 2147548479  "Source: isobus.net VDMA Data Dictionary (https://www.isobus.net/isobus/pGNAndSPN/14495?type=PGN)";
CM_ BO_ 2147548480  "Source: isobus.net VDMA Data Dictionary (https://www.isobus.net/isobus/pGNAndSPN/14513?type=PGN)";
CM_ BO_ 2147548481  "Source: isobus.net VDMA Data Dictionary (https://www.isobus.net/isobus/pGNAndSPN/14526?type=PGN)";
CM_ BO_ 2147548482  "Source: isobus.net VDMA Data Dictionary (https://www.isobus.net/isobus/pGNAndSPN/14545?type=PGN)";
CM_ BO_ 2147548484  "Source: isobus.net VDMA Data Dictionary (https://www.isobus.net/isobus/pGNAndSPN/14552?type=PGN)";
CM_ BO_ 2147548485  "Source: isobus.net VDMA Data Dictionary (https://www.isobus.net/isobus/pGNAndSPN/14558?type=PGN)";
CM_ BO_ 2147548486  "Source: isobus.net VDMA Data Dictionary (https://www.isobus.net/isobus/pGNAndSPN/14564?type=PGN)";
CM_ BO_ 2147548487  "Source: isobus.net VDMA Data Dictionary (https://www.isobus.net/isobus/pGNAndSPN/14565?type=PGN)";
CM_ BO_ 2147548488  "Source: isobus.net VDMA Data Dictionary (https://www.isobus.net/isobus/pGNAndSPN/14568?type=PGN)";
CM_ BO_ 2147548489  "Source: isobus.net VDMA Data Dictionary (https://www.isobus.net/isobus/pGNAndSPN/14571?type=PGN)";
CM_ BO_ 2147548490  "Source: isobus.net VDMA Data Dictionary (https://www.isobus.net/isobus/pGNAndSPN/14572?type=PGN)";
CM_ BO_ 2147548491  "Source: isobus.net VDMA Data Dictionary (https://www.isobus.net/isobus/pGNAndSPN/14573?type=PGN)";
CM_ BO_ 2147548492  "Source: isobus.net VDMA Data Dictionary (https://www.isobus.net/isobus/pGNAndSPN/14574?type=PGN)";
CM_ BO_ 2147548493  "Source: isobus.net VDMA Data Dictionary (https://www.isobus.net/isobus/pGNAndSPN/14575?type=PGN)";
CM_ BO_ 2147548494  "Source: isobus.net VDMA Data Dictionary (https://www.isobus.net/isobus/pGNAndSPN/14576?type=PGN)";
CM_ BO_ 2147548495  "Source: isobus.net VDMA Data Dictionary (https://www.isobus.net/isobus/pGNAndSPN/14577?type=PGN)";
CM_ BO_ 2147548496  "Source: isobus.net VDMA Data Dictionary (https://www.isobus.net/isobus/pGNAndSPN/14578?type=PGN)";
CM_ BO_ 2147548497  "Source: isobus.net VDMA Data Dictionary (https://www.isobus.net/isobus/pGNAndSPN/14584?type=PGN)";
CM_ BO_ 2147548498  "Source: isobus.net VDMA Data Dictionary (https://www.isobus.net/isobus/pGNAndSPN/14592?type=PGN)";
CM_ BO_ 2147548499  "Source: isobus.net VDMA Data Dictionary (https://www.isobus.net/isobus/pGNAndSPN/14595?type=PGN)";
CM_ BO_ 2147548500  "Source: isobus.net VDMA Data Dictionary (https://www.isobus.net/isobus/pGNAndSPN/14607?type=PGN)";
CM_ BO_ 2147548501  "Source: isobus.net VDMA Data Dictionary (https://www.isobus.net/isobus/pGNAndSPN/14619?type=PGN)";
CM_ BO_ 2147548502  "Source: isobus.net VDMA Data Dictionary (https://www.isobus.net/isobus/pGNAndSPN/14631?type=PGN)";
CM_ BO_ 2147548503  "Source: isobus.net VDMA Data Dictionary (https://www.isobus.net/isobus/pGNAndSPN/14643?type=PGN)";
CM_ BO_ 2147548504  "Source: isobus.net VDMA Data Dictionary (https://www.isobus.net/isobus/pGNAndSPN/14655?type=PGN)";
CM_ BO_ 2147548505  "Source: isobus.net VDMA Data Dictionary (https://www.isobus.net/isobus/pGNAndSPN/14667?type=PGN)";
CM_ BO_ 2147548506  "Source: isobus.net VDMA Data Dictionary (https://www.isobus.net/isobus/pGNAndSPN/14679?type=PGN)";
CM_ BO_ 2147548507  "Source: isobus.net VDMA Data Dictionary (https://www.isobus.net/isobus/pGNAndSPN/14691?type=PGN)";
CM_ BO_ 2147548508  "Source: isobus.net VDMA Data Dictionary (https://www.isobus.net/isobus/pGNAndSPN/14703?type=PGN)";
CM_ BO_ 2147548509  "Source: isobus.net VDMA Data Dictionary (https://www.isobus.net/isobus/pGNAndSPN/14715?type=PGN)";
CM_ BO_ 2147548510  "Source: isobus.net VDMA Data Dictionary (https://www.isobus.net/isobus/pGNAndSPN/14727?type=PGN)";
CM_ BO_ 2147548511  "Source: isobus.net VDMA Data Dictionary (https://www.isobus.net/isobus/pGNAndSPN/14739?type=PGN)";
CM_ BO_ 2147548512  "Source: isobus.net VDMA Data Dictionary (https://www.isobus.net/isobus/pGNAndSPN/14742?type=PGN)";
CM_ BO_ 2147548513  "Source: isobus.net VDMA Data Dictionary (https://www.isobus.net/isobus/pGNAndSPN/14744?type=PGN)";
CM_ BO_ 2147548514  "Source: isobus.net VDMA Data Dictionary (https://www.isobus.net/isobus/pGNAndSPN/14745?type=PGN)";
CM_ BO_ 2147548515  "Source: isobus.net VDMA Data Dictionary (https://www.isobus.net/isobus/pGNAndSPN/14750?type=PGN)";
CM_ BO_ 2147548516  "Source: isobus.net VDMA Data Dictionary (https://www.isobus.net/isobus/pGNAndSPN/14751?type=PGN)";
CM_ BO_ 2147548517  "Source: isobus.net VDMA Data Dictionary (https://www.isobus.net/isobus/pGNAndSPN/14756?type=PGN)";
CM_ BO_ 2147548518  "Source: isobus.net VDMA Data Dictionary (https://www.isobus.net/isobus/pGNAndSPN/14762?type=PGN)";
CM_ BO_ 2147548519  "Source: isobus.net VDMA Data Dictionary (https://www.isobus.net/isobus/pGNAndSPN/14763?type=PGN)";
CM_ BO_ 2147548520  "Source: isobus.net VDMA Data Dictionary (https://www.isobus.net/isobus/pGNAndSPN/14765?type=PGN)";
CM_ BO_ 2147548521  "Source: isobus.net VDMA Data Dictionary (https://www.isobus.net/isobus/pGNAndSPN/14769?type=PGN)";
CM_ BO_ 2147548522  "Source: isobus.net VDMA Data Dictionary (https://www.isobus.net/isobus/pGNAndSPN/14772?type=PGN)";
CM_ BO_ 2147548523  "Source: isobus.net VDMA Data Dictionary (https://www.isobus.net/isobus/pGNAndSPN/14788?type=PGN)";
CM_ BO_ 2147548524  "Source: isobus.net VDMA Data Dictionary (https://www.isobus.net/isobus/pGNAndSPN/14792?type=PGN)";
CM_ BO_ 2147548525  "Source: isobus.net VDMA Data Dictionary (https://www.isobus.net/isobus/pGNAndSPN/14796?type=PGN)";
CM_ BO_ 2147548526  "Source: isobus.net VDMA Data Dictionary (https://www.isobus.net/isobus/pGNAndSPN/14801?type=PGN)";
CM_ BO_ 2147548527  "Source: isobus.net VDMA Data Dictionary (https://www.isobus.net/isobus/pGNAndSPN/14806?type=PGN)";
CM_ BO_ 2147548528  "Source: isobus.net VDMA Data Dictionary (https://www.isobus.net/isobus/pGNAndSPN/14821?type=PGN)";
CM_ BO_ 2147548529  "Source: isobus.net VDMA Data Dictionary (https://www.isobus.net/isobus/pGNAndSPN/14841?type=PGN)";
CM_ BO_ 2147548530  "Source: isobus.net VDMA Data Dictionary (https://www.isobus.net/isobus/pGNAndSPN/14845?type=PGN)";
CM_ BO_ 2147548531  "Source: isobus.net VDMA Data Dictionary (https://www.isobus.net/isobus/pGNAndSPN/14849?type=PGN)";
CM_ BO_ 2147548532  "Source: isobus.net VDMA Data Dictionary (https://www.isobus.net/isobus/pGNAndSPN/14853?type=PGN)";
CM_ BO_ 2147548533  "Source: isobus.net VDMA Data Dictionary (https://www.isobus.net/isobus/pGNAndSPN/14857?type=PGN)";
CM_ BO_ 2147548534  "Source: isobus.net VDMA Data Dictionary (https://www.isobus.net/isobus/pGNAndSPN/14861?type=PGN)";
CM_ BO_ 2147548535  "Source: isobus.net VDMA Data Dictionary (https://www.isobus.net/isobus/pGNAndSPN/14865?type=PGN)";
CM_ BO_ 2147548536  "Source: isobus.net VDMA Data Dictionary (https://www.isobus.net/isobus/pGNAndSPN/14873?type=PGN)";
CM_ BO_ 2147548537  "Source: isobus.net VDMA Data Dictionary (https://www.isobus.net/isobus/pGNAndSPN/14881?type=PGN)";
CM_ BO_ 2147548538  "Source: isobus.net VDMA Data Dictionary (https://www.isobus.net/isobus/pGNAndSPN/14885?type=PGN)";
CM_ BO_ 2147548539  "Source: isobus.net VDMA Data Dictionary (https://www.isobus.net/isobus/pGNAndSPN/14889?type=PGN)";
CM_ BO_ 2147548540  "Source: isobus.net VDMA Data Dictionary (https://www.isobus.net/isobus/pGNAndSPN/14917?type=PGN)";
CM_ BO_ 2147548541  "Source: isobus.net VDMA Data Dictionary (https://www.isobus.net/isobus/pGNAndSPN/14918?type=PGN)";
CM_ BO_ 2147548542  "Source: isobus.net VDMA Data Dictionary (https://www.isobus.net/isobus/pGNAndSPN/14922?type=PGN)";
CM_ BO_ 2147548543  "Source: isobus.net VDMA Data Dictionary (https://www.isobus.net/isobus/pGNAndSPN/14926?type=PGN)";
CM_ BO_ 2147548544  "Source: isobus.net VDMA Data Dictionary (https://www.isobus.net/isobus/pGNAndSPN/14938?type=PGN)";
CM_ BO_ 2147548545  "Source: isobus.net VDMA Data Dictionary (https://www.isobus.net/isobus/pGNAndSPN/14939?type=PGN)";
CM_ BO_ 2147548546  "Source: isobus.net VDMA Data Dictionary (https://www.isobus.net/isobus/pGNAndSPN/14951?type=PGN)";
CM_ BO_ 2147548547  "Source: isobus.net VDMA Data Dictionary (https://www.isobus.net/isobus/pGNAndSPN/14956?type=PGN)";
CM_ BO_ 2147548548  "Source: isobus.net VDMA Data Dictionary (https://www.isobus.net/isobus/pGNAndSPN/14960?type=PGN)";
CM_ BO_ 2147548549  "Source: isobus.net VDMA Data Dictionary (https://www.isobus.net/isobus/pGNAndSPN/14964?type=PGN)";
CM_ BO_ 2147548550  "Source: isobus.net VDMA Data Dictionary (https://www.isobus.net/isobus/pGNAndSPN/14968?type=PGN)";
CM_ BO_ 2147548551  "Source: isobus.net VDMA Data Dictionary (https://www.isobus.net/isobus/pGNAndSPN/14972?type=PGN)";
CM_ BO_ 2147548552  "Source: isobus.net VDMA Data Dictionary (https://www.isobus.net/isobus/pGNAndSPN/14976?type=PGN)";
CM_ BO_ 2147548553  "Source: isobus.net VDMA Data Dictionary (https://www.isobus.net/isobus/pGNAndSPN/14977?type=PGN)";
CM_ BO_ 2147548554  "Source: isobus.net VDMA Data Dictionary (https://www.isobus.net/isobus/pGNAndSPN/14981?type=PGN)";
CM_ BO_ 2147548555  "Source: isobus.net VDMA Data Dictionary (https://www.isobus.net/isobus/pGNAndSPN/14983?type=PGN)";
CM_ BO_ 2147548556  "Source: isobus.net VDMA Data Dictionary (https://www.isobus.net/isobus/pGNAndSPN/14985?type=PGN)";
CM_ BO_ 2147548557  "Source: isobus.net VDMA Data Dictionary (https://www.isobus.net/isobus/pGNAndSPN/14987?type=PGN)";
CM_ BO_ 2147548558  "Source: isobus.net VDMA Data Dictionary (https://www.isobus.net/isobus/pGNAndSPN/14989?type=PGN)";
CM_ BO_ 2147548559  "Source: isobus.net VDMA Data Dictionary (https://www.isobus.net/isobus/pGNAndSPN/14992?type=PGN)";
CM_ BO_ 2147548560  "Source: isobus.net VDMA Data Dictionary (https://www.isobus.net/isobus/pGNAndSPN/14996?type=PGN)";
CM_ BO_ 2147548561  "Source: isobus.net VDMA Data Dictionary (https://www.isobus.net/isobus/pGNAndSPN/15007?type=PGN)";
CM_ BO_ 2147548562  "Source: isobus.net VDMA Data Dictionary (https://www.isobus.net/isobus/pGNAndSPN/15025?type=PGN)";
CM_ BO_ 2147548563  "Source: isobus.net VDMA Data Dictionary (https://www.isobus.net/isobus/pGNAndSPN/15033?type=PGN)";
CM_ BO_ 2147548564  "Source: isobus.net VDMA Data Dictionary (https://www.isobus.net/isobus/pGNAndSPN/15037?type=PGN)";
CM_ BO_ 2147548565  "Source: isobus.net VDMA Data Dictionary (https://www.isobus.net/isobus/pGNAndSPN/15047?type=PGN)";
CM_ BO_ 2147548566  "Source: isobus.net VDMA Data Dictionary (https://www.isobus.net/isobus/pGNAndSPN/15049?type=PGN)";
CM_ BO_ 2147548567  "Source: isobus.net VDMA Data Dictionary (https://www.isobus.net/isobus/pGNAndSPN/15051?type=PGN)";
CM_ BO_ 2147548568  "Source: isobus.net VDMA Data Dictionary (https://www.isobus.net/isobus/pGNAndSPN/15062?type=PGN)";
CM_ BO_ 2147548569  "Source: isobus.net VDMA Data Dictionary (https://www.isobus.net/isobus/pGNAndSPN/15073?type=PGN)";
CM_ BO_ 2147548570  "Source: isobus.net VDMA Data Dictionary (https://www.isobus.net/isobus/pGNAndSPN/15074?type=PGN)";
CM_ BO_ 2147548571  "Source: isobus.net VDMA Data Dictionary (https://www.isobus.net/isobus/pGNAndSPN/15081?type=PGN)";
CM_ BO_ 2147548572  "Source: isobus.net VDMA Data Dictionary (https://www.isobus.net/isobus/pGNAndSPN/15085?type=PGN)";
CM_ BO_ 2147548573  "Source: isobus.net VDMA Data Dictionary (https://www.isobus.net/isobus/pGNAndSPN/15089?type=PGN)";
CM_ BO_ 2147548574  "Source: isobus.net VDMA Data Dictionary (https://www.isobus.net/isobus/pGNAndSPN/15097?type=PGN)";
CM_ BO_ 2147548575  "Source: isobus.net VDMA Data Dictionary (https://www.isobus.net/isobus/pGNAndSPN/15105?type=PGN)";
CM_ BO_ 2147548576  "Source: isobus.net VDMA Data Dictionary (https://www.isobus.net/isobus/pGNAndSPN/15113?type=PGN)";
CM_ BO_ 2147548577  "Source: isobus.net VDMA Data Dictionary (https://www.isobus.net/isobus/pGNAndSPN/15121?type=PGN)";
CM_ BO_ 2147548578  "Source: isobus.net VDMA Data Dictionary (https://www.isobus.net/isobus/pGNAndSPN/15125?type=PGN)";
CM_ BO_ 2147548579  "Source: isobus.net VDMA Data Dictionary (https://www.isobus.net/isobus/pGNAndSPN/15132?type=PGN)";
CM_ BO_ 2147548580  "Source: isobus.net VDMA Data Dictionary (https://www.isobus.net/isobus/pGNAndSPN/15160?type=PGN)";
CM_ BO_ 2147548581  "Source: isobus.net VDMA Data Dictionary (https://www.isobus.net/isobus/pGNAndSPN/15190?type=PGN)";
CM_ BO_ 2147548582  "Source: isobus.net VDMA Data Dictionary (https://www.isobus.net/isobus/pGNAndSPN/15193?type=PGN)";
CM_ BO_ 2147548583  "Source: isobus.net VDMA Data Dictionary (https://www.isobus.net/isobus/pGNAndSPN/15198?type=PGN)";
CM_ BO_ 2147548584  "Source: isobus.net VDMA Data Dictionary (https://www.isobus.net/isobus/pGNAndSPN/15203?type=PGN)";
CM_ BO_ 2147548585  "Source: isobus.net VDMA Data Dictionary (https://www.isobus.net/isobus/pGNAndSPN/15208?type=PGN)";
CM_ BO_ 2147548586  "Source: isobus.net VDMA Data Dictionary (https://www.isobus.net/isobus/pGNAndSPN/15215?type=PGN)";
CM_ BO_ 2147548587  "Source: isobus.net VDMA Data Dictionary (https://www.isobus.net/isobus/pGNAndSPN/15216?type=PGN)";
CM_ BO_ 2147548588  "Source: isobus.net VDMA Data Dictionary (https://www.isobus.net/isobus/pGNAndSPN/15218?type=PGN)";
CM_ BO_ 2147548589  "Source: isobus.net VDMA Data Dictionary (https://www.isobus.net/isobus/pGNAndSPN/15220?type=PGN)";
CM_ BO_ 2147548590  "Source: isobus.net VDMA Data Dictionary (https://www.isobus.net/isobus/pGNAndSPN/15225?type=PGN)";
CM_ BO_ 2147548591  "Source: isobus.net VDMA Data Dictionary (https://www.isobus.net/isobus/pGNAndSPN/15231?type=PGN)";
CM_ BO_ 2147548592  "Source: isobus.net VDMA Data Dictionary (https://www.isobus.net/isobus/pGNAndSPN/15236?type=PGN)";
CM_ BO_ 2147548593  "Source: isobus.net VDMA Data Dictionary (https://www.isobus.net/isobus/pGNAndSPN/15241?type=PGN)";
CM_ BO_ 2147548594  "Source: isobus.net VDMA Data Dictionary (https://www.isobus.net/isobus/pGNAndSPN/15247?type=PGN)";
CM_ BO_ 2147548595  "Source: isobus.net VDMA Data Dictionary (https://www.isobus.net/isobus/pGNAndSPN/15252?type=PGN)";
CM_ BO_ 2147548596  "Source: isobus.net VDMA Data Dictionary (https://www.isobus.net/isobus/pGNAndSPN/15257?type=PGN)";
CM_ BO_ 2147548597  "Source: isobus.net VDMA Data Dictionary (https://www.isobus.net/isobus/pGNAndSPN/15269?type=PGN)";
CM_ BO_ 2147548598  "Source: isobus.net VDMA Data Dictionary (https://www.isobus.net/isobus/pGNAndSPN/15275?type=PGN)";
CM_ BO_ 2147548599  "Source: isobus.net VDMA Data Dictionary (https://www.isobus.net/isobus/pGNAndSPN/15281?type=PGN)";
CM_ BO_ 2147548600  "Source: isobus.net VDMA Data Dictionary (https://www.isobus.net/isobus/pGNAndSPN/15286?type=PGN)";
CM_ BO_ 2147548601  "Source: isobus.net VDMA Data Dictionary (https://www.isobus.net/isobus/pGNAndSPN/15288?type=PGN)";
CM_ BO_ 2147548602  "Source: isobus.net VDMA Data Dictionary (https://www.isobus.net/isobus/pGNAndSPN/15290?type=PGN)";
CM_ BO_ 2147548603  "Source: isobus.net VDMA Data Dictionary (https://www.isobus.net/isobus/pGNAndSPN/15301?type=PGN)";
CM_ BO_ 2147548604  "Source: isobus.net VDMA Data Dictionary (https://www.isobus.net/isobus/pGNAndSPN/15311?type=PGN)";
CM_ BO_ 2147548605  "Source: isobus.net VDMA Data Dictionary (https://www.isobus.net/isobus/pGNAndSPN/15318?type=PGN)";
CM_ BO_ 2147548606  "Source: isobus.net VDMA Data Dictionary (https://www.isobus.net/isobus/pGNAndSPN/15325?type=PGN)";
CM_ BO_ 2147548607  "Source: isobus.net VDMA Data Dictionary (https://www.isobus.net/isobus/pGNAndSPN/15327?type=PGN)";
CM_ BO_ 2147548608  "Source: isobus.net VDMA Data Dictionary (https://www.isobus.net/isobus/pGNAndSPN/15332?type=PGN)";
CM_ BO_ 2147548609  "Source: isobus.net VDMA Data Dictionary (https://www.isobus.net/isobus/pGNAndSPN/15337?type=PGN)";
CM_ BO_ 2147548610  "Source: isobus.net VDMA Data Dictionary (https://www.isobus.net/isobus/pGNAndSPN/15342?type=PGN)";
CM_ BO_ 2147548611  "Source: isobus.net VDMA Data Dictionary (https://www.isobus.net/isobus/pGNAndSPN/15347?type=PGN)";
CM_ BO_ 2147548612  "Source: isobus.net VDMA Data Dictionary (https://www.isobus.net/isobus/pGNAndSPN/15360?type=PGN)";
CM_ BO_ 2147548614  "Source: isobus.net VDMA Data Dictionary (https://www.isobus.net/isobus/pGNAndSPN/15373?type=PGN)";
CM_ BO_ 2147548615  "Source: isobus.net VDMA Data Dictionary (https://www.isobus.net/isobus/pGNAndSPN/15383?type=PGN)";
CM_ BO_ 2147548616  "Source: isobus.net VDMA Data Dictionary (https://www.isobus.net/isobus/pGNAndSPN/15384?type=PGN)";
CM_ BO_ 2147548617  "Source: isobus.net VDMA Data Dictionary (https://www.isobus.net/isobus/pGNAndSPN/15385?type=PGN)";
CM_ BO_ 2147548618  "Source: isobus.net VDMA Data Dictionary (https://www.isobus.net/isobus/pGNAndSPN/15386?type=PGN)";
CM_ BO_ 2147548619  "Source: isobus.net VDMA Data Dictionary (https://www.isobus.net/isobus/pGNAndSPN/15396?type=PGN)";
CM_ BO_ 2147548620  "Source: isobus.net VDMA Data Dictionary (https://www.isobus.net/isobus/pGNAndSPN/15407?type=PGN)";
CM_ BO_ 2147548621  "Source: isobus.net VDMA Data Dictionary (https://www.isobus.net/isobus/pGNAndSPN/15416?type=PGN)";
CM_ BO_ 2147548622  "Source: isobus.net VDMA Data Dictionary (https://www.isobus.net/isobus/pGNAndSPN/15417?type=PGN)";
CM_ BO_ 2147548623  "Source: isobus.net VDMA Data Dictionary (https://www.isobus.net/isobus/pGNAndSPN/15418?type=PGN)";
CM_ BO_ 2147548624  "Source: isobus.net VDMA Data Dictionary (https://www.isobus.net/isobus/pGNAndSPN/15425?type=PGN)";
CM_ BO_ 2147548625  "Source: isobus.net VDMA Data Dictionary (https://www.isobus.net/isobus/pGNAndSPN/15428?type=PGN)";
CM_ BO_ 2147548626  "Source: isobus.net VDMA Data Dictionary (https://www.isobus.net/isobus/pGNAndSPN/15430?type=PGN)";
CM_ BO_ 2147548627  "Source: isobus.net VDMA Data Dictionary (https://www.isobus.net/isobus/pGNAndSPN/15434?type=PGN)";
CM_ BO_ 2147548628  "Source: isobus.net VDMA Data Dictionary (https://www.isobus.net/isobus/pGNAndSPN/15452?type=PGN)";
CM_ BO_ 2147548629  "Source: isobus.net VDMA Data Dictionary (https://www.isobus.net/isobus/pGNAndSPN/15459?type=PGN)";
CM_ BO_ 2147548630  "Source: isobus.net VDMA Data Dictionary (https://www.isobus.net/isobus/pGNAndSPN/15481?type=PGN)";
CM_ BO_ 2147548631  "Source: isobus.net VDMA Data Dictionary (https://www.isobus.net/isobus/pGNAndSPN/15500?type=PGN)";
CM_ BO_ 2147548632  "Source: isobus.net VDMA Data Dictionary (https://www.isobus.net/isobus/pGNAndSPN/15522?type=PGN)";
CM_ BO_ 2147548633  "Source: isobus.net VDMA Data Dictionary (https://www.isobus.net/isobus/pGNAndSPN/15541?type=PGN)";
CM_ BO_ 2147548634  "Source: isobus.net VDMA Data Dictionary (https://www.isobus.net/isobus/pGNAndSPN/15563?type=PGN)";
CM_ BO_ 2147548635  "Source: isobus.net VDMA Data Dictionary (https://www.isobus.net/isobus/pGNAndSPN/15582?type=PGN)";
CM_ BO_ 2147548636  "Source: isobus.net VDMA Data Dictionary (https://www.isobus.net/isobus/pGNAndSPN/15586?type=PGN)";
CM_ BO_ 2147548637  "Source: isobus.net VDMA Data Dictionary (https://www.isobus.net/isobus/pGNAndSPN/15587?type=PGN)";
CM_ BO_ 2147548638  "Source: isobus.net VDMA Data Dictionary (https://www.isobus.net/isobus/pGNAndSPN/15588?type=PGN)";
CM_ BO_ 2147548639  "Source: isobus.net VDMA Data Dictionary (https://www.isobus.net/isobus/pGNAndSPN/15589?type=PGN)";
CM_ BO_ 2147548640  "Source: isobus.net VDMA Data Dictionary (https://www.isobus.net/isobus/pGNAndSPN/15594?type=PGN)";
CM_ BO_ 2147548641  "Source: isobus.net VDMA Data Dictionary (https://www.isobus.net/isobus/pGNAndSPN/15603?type=PGN)";
CM_ BO_ 2147548642  "Source: isobus.net VDMA Data Dictionary (https://www.isobus.net/isobus/pGNAndSPN/15610?type=PGN)";
CM_ BO_ 2147548643  "Source: isobus.net VDMA Data Dictionary (https://www.isobus.net/isobus/pGNAndSPN/15611?type=PGN)";
CM_ BO_ 2147548644  "Source: isobus.net VDMA Data Dictionary (https://www.isobus.net/isobus/pGNAndSPN/15616?type=PGN)";
CM_ BO_ 2147548645  "Source: isobus.net VDMA Data Dictionary (https://www.isobus.net/isobus/pGNAndSPN/15624?type=PGN)";
CM_ BO_ 2147548646  "Source: isobus.net VDMA Data Dictionary (https://www.isobus.net/isobus/pGNAndSPN/15632?type=PGN)";
CM_ BO_ 2147548647  "Source: isobus.net VDMA Data Dictionary (https://www.isobus.net/isobus/pGNAndSPN/15638?type=PGN)";
CM_ BO_ 2147548648  "Source: isobus.net VDMA Data Dictionary (https://www.isobus.net/isobus/pGNAndSPN/15644?type=PGN)";
CM_ BO_ 2147548649  "Source: isobus.net VDMA Data Dictionary (https://www.isobus.net/isobus/pGNAndSPN/15647?type=PGN)";
CM_ BO_ 2147548650  "Source: isobus.net VDMA Data Dictionary (https://www.isobus.net/isobus/pGNAndSPN/15650?type=PGN)";
CM_ BO_ 2147548651  "Source: isobus.net VDMA Data Dictionary (https://www.isobus.net/isobus/pGNAndSPN/15653?type=PGN)";
CM_ BO_ 2147548652  "Source: isobus.net VDMA Data Dictionary (https://www.isobus.net/isobus/pGNAndSPN/15656?type=PGN)";
CM_ BO_ 2147548653  "Source: isobus.net VDMA Data Dictionary (https://www.isobus.net/isobus/pGNAndSPN/15658?type=PGN)";
CM_ BO_ 2147548654  "Source: isobus.net VDMA Data Dictionary (https://www.isobus.net/isobus/pGNAndSPN/15661?type=PGN)";
CM_ BO_ 2147548655  "Source: isobus.net VDMA Data Dictionary (https://www.isobus.net/isobus/pGNAndSPN/15663?type=PGN)";
CM_ BO_ 2147548656  "Source: isobus.net VDMA Data Dictionary (https://www.isobus.net/isobus/pGNAndSPN/15667?type=PGN)";
CM_ BO_ 2147548657  "Source: isobus.net VDMA Data Dictionary (https://www.isobus.net/isobus/pGNAndSPN/15670?type=PGN)";
CM_ BO_ 2147548658  "Source: isobus.net VDMA Data Dictionary (https://www.isobus.net/isobus/pGNAndSPN/15672?type=PGN)";
CM_ BO_ 2147548659  "Source: isobus.net VDMA Data Dictionary (https://www.isobus.net/isobus/pGNAndSPN/15676?type=PGN)";
CM_ BO_ 2147548660  "Source: isobus.net VDMA Data Dictionary (https://www.isobus.net/isobus/pGNAndSPN/15679?type=PGN)";
CM_ BO_ 2147548661  "Source: isobus.net VDMA Data Dictionary (https://www.isobus.net/isobus/pGNAndSPN/15681?type=PGN)";
CM_ BO_ 2147548662  "Source: isobus.net VDMA Data Dictionary (https://www.isobus.net/isobus/pGNAndSPN/15685?type=PGN)";
CM_ BO_ 2147548663  "Source: isobus.net VDMA Data Dictionary (https://www.isobus.net/isobus/pGNAndSPN/15688?type=PGN)";
CM_ BO_ 2147548664  "Source: isobus.net VDMA Data Dictionary (https://www.isobus.net/isobus/pGNAndSPN/15690?type=PGN)";
CM_ BO_ 2147548665  "Source: isobus.net VDMA Data Dictionary (https://www.isobus.net/isobus/pGNAndSPN/15694?type=PGN)";
CM_ BO_ 2147548666  "Source: isobus.net VDMA Data Dictionary (https://www.isobus.net/isobus/pGNAndSPN/15696?type=PGN)";
CM_ BO_ 2147548667  "Source: isobus.net VDMA Data Dictionary (https://www.isobus.net/isobus/pGNAndSPN/15699?type=PGN)";
CM_ BO_ 2147548668  "Source: isobus.net VDMA Data Dictionary (https://www.isobus.net/isobus/pGNAndSPN/15701?type=PGN)";
CM_ BO_ 2147548669  "Source: isobus.net VDMA Data Dictionary (https://www.isobus.net/isobus/pGNAndSPN/15705?type=PGN)";
CM_ BO_ 2147548670  "Source: isobus.net VDMA Data Dictionary (https://www.isobus.net/isobus/pGNAndSPN/15708?type=PGN)";
CM_ BO_ 2147548671  "Source: isobus.net VDMA Data Dictionary (https://www.isobus.net/isobus/pGNAndSPN/15710?type=PGN)";
CM_ BO_ 2147548672  "Source: isobus.net VDMA Data Dictionary (https://www.isobus.net/isobus/pGNAndSPN/15714?type=PGN)";
CM_ BO_ 2147548673  "Source: isobus.net VDMA Data Dictionary (https://www.isobus.net/isobus/pGNAndSPN/15717?type=PGN)";
CM_ BO_ 2147548674  "Source: isobus.net VDMA Data Dictionary (https://www.isobus.net/isobus/pGNAndSPN/15719?type=PGN)";
CM_ BO_ 2147548675  "Source: isobus.net VDMA Data Dictionary (https://www.isobus.net/isobus/pGNAndSPN/15723?type=PGN)";
CM_ BO_ 2147548676  "Source: isobus.net VDMA Data Dictionary (https://www.isobus.net/isobus/pGNAndSPN/15726?type=PGN)";
CM_ BO_ 2147548677  "Source: isobus.net VDMA Data Dictionary (https://www.isobus.net/isobus/pGNAndSPN/15728?type=PGN)";
CM_ BO_ 2147548678  "Source: isobus.net VDMA Data Dictionary (https://www.isobus.net/isobus/pGNAndSPN/15732?type=PGN)";
CM_ BO_ 2147548679  "Source: isobus.net VDMA Data Dictionary (https://www.isobus.net/isobus/pGNAndSPN/15736?type=PGN)";
CM_ BO_ 2147548680  "Source: isobus.net VDMA Data Dictionary (https://www.isobus.net/isobus/pGNAndSPN/15782?type=PGN)";
CM_ BO_ 2147548681  "Source: isobus.net VDMA Data Dictionary (https://www.isobus.net/isobus/pGNAndSPN/15828?type=PGN)";
CM_ BO_ 2147548682  "Source: isobus.net VDMA Data Dictionary (https://www.isobus.net/isobus/pGNAndSPN/15829?type=PGN)";
CM_ SG_ 2147548394 Vehicle_Electrical_Power_4_obsol "Generic 8-byte raw payload. Detail page: https://www.isobus.net/isobus/pGNAndSPN/13645?type=PGN. Signal-level enrichment via PR welcome  see CONTRIBUTING.md.";
CM_ SG_ 2147548395 Aftertreatment_2_NOx_Adsorber_In "Generic 8-byte raw payload. Detail page: https://www.isobus.net/isobus/pGNAndSPN/13647?type=PGN. Signal-level enrichment via PR welcome  see CONTRIBUTING.md.";
CM_ SG_ 2147548396 Aftertreatment_1_NOx_Adsorber_In "Generic 8-byte raw payload. Detail page: https://www.isobus.net/isobus/pGNAndSPN/13649?type=PGN. Signal-level enrichment via PR welcome  see CONTRIBUTING.md.";
CM_ SG_ 2147548397 Aftertreatment_2_Warm_Up_Diesel_ "Generic 8-byte raw payload. Detail page: https://www.isobus.net/isobus/pGNAndSPN/13651?type=PGN. Signal-level enrichment via PR welcome  see CONTRIBUTING.md.";
CM_ SG_ 2147548398 Land_Leveling_System_Reference_E "Generic 8-byte raw payload. Detail page: https://www.isobus.net/isobus/pGNAndSPN/13655?type=PGN. Signal-level enrichment via PR welcome  see CONTRIBUTING.md.";
CM_ SG_ 2147548399 Engine_Fluid_Level_Pressure_11_R "Generic 8-byte raw payload. Detail page: https://www.isobus.net/isobus/pGNAndSPN/13659?type=PGN. Signal-level enrichment via PR welcome  see CONTRIBUTING.md.";
CM_ SG_ 2147548400 Engine_Fuel_Lube_x000D_Systems_2 "Generic 8-byte raw payload. Detail page: https://www.isobus.net/isobus/pGNAndSPN/13664?type=PGN. Signal-level enrichment via PR welcome  see CONTRIBUTING.md.";
CM_ SG_ 2147548401 Engine_Turbocharger_Wastegate_Ac "Generic 8-byte raw payload. Detail page: https://www.isobus.net/isobus/pGNAndSPN/13676?type=PGN. Signal-level enrichment via PR welcome  see CONTRIBUTING.md.";
CM_ SG_ 2147548402 Engine_Fuel_Throttle_Valve_Infor "Generic 8-byte raw payload. Detail page: https://www.isobus.net/isobus/pGNAndSPN/13690?type=PGN. Signal-level enrichment via PR welcome  see CONTRIBUTING.md.";
CM_ SG_ 2147548403 Engine_Turbocharger_Compressor_B "Generic 8-byte raw payload. Detail page: https://www.isobus.net/isobus/pGNAndSPN/13698?type=PGN. Signal-level enrichment via PR welcome  see CONTRIBUTING.md.";
CM_ SG_ 2147548404 Charge_Air_Cooler_2_RawPayload "Generic 8-byte raw payload. Detail page: https://www.isobus.net/isobus/pGNAndSPN/13702?type=PGN. Signal-level enrichment via PR welcome  see CONTRIBUTING.md.";
CM_ SG_ 2147548405 Charge_Air_Cooler_2_Precooler_Ra "Generic 8-byte raw payload. Detail page: https://www.isobus.net/isobus/pGNAndSPN/13705?type=PGN. Signal-level enrichment via PR welcome  see CONTRIBUTING.md.";
CM_ SG_ 2147548406 Charge_Air_Cooler_1_RawPayload "Generic 8-byte raw payload. Detail page: https://www.isobus.net/isobus/pGNAndSPN/13709?type=PGN. Signal-level enrichment via PR welcome  see CONTRIBUTING.md.";
CM_ SG_ 2147548407 Charge_Air_Cooler_1_Precooler_Ra "Generic 8-byte raw payload. Detail page: https://www.isobus.net/isobus/pGNAndSPN/13712?type=PGN. Signal-level enrichment via PR welcome  see CONTRIBUTING.md.";
CM_ SG_ 2147548408 Diesel_Particulate_Filter_2_Soot "Generic 8-byte raw payload. Detail page: https://www.isobus.net/isobus/pGNAndSPN/13715?type=PGN. Signal-level enrichment via PR welcome  see CONTRIBUTING.md.";
CM_ SG_ 2147548409 Diesel_Particulate_Filter_1_Soot "Generic 8-byte raw payload. Detail page: https://www.isobus.net/isobus/pGNAndSPN/13718?type=PGN. Signal-level enrichment via PR welcome  see CONTRIBUTING.md.";
CM_ SG_ 2147548410 Electronic_Engine_Controller_11_ "Generic 8-byte raw payload. Detail page: https://www.isobus.net/isobus/pGNAndSPN/13722?type=PGN. Signal-level enrichment via PR welcome  see CONTRIBUTING.md.";
CM_ SG_ 2147548411 Engine_Manifold_Actuator_Positio "Generic 8-byte raw payload. Detail page: https://www.isobus.net/isobus/pGNAndSPN/13724?type=PGN. Signal-level enrichment via PR welcome  see CONTRIBUTING.md.";
CM_ SG_ 2147548412 Engine_Manifold_Actuator_Control "Generic 8-byte raw payload. Detail page: https://www.isobus.net/isobus/pGNAndSPN/13726?type=PGN. Signal-level enrichment via PR welcome  see CONTRIBUTING.md.";
CM_ SG_ 2147548413 Electronic_Engine_Controller_9_R "Generic 8-byte raw payload. Detail page: https://www.isobus.net/isobus/pGNAndSPN/13730?type=PGN. Signal-level enrichment via PR welcome  see CONTRIBUTING.md.";
CM_ SG_ 2147548414 Electronic_Engine_Controller_10_ "Generic 8-byte raw payload. Detail page: https://www.isobus.net/isobus/pGNAndSPN/13735?type=PGN. Signal-level enrichment via PR welcome  see CONTRIBUTING.md.";
CM_ SG_ 2147548415 Engine_Temperature_5_RawPayload "Generic 8-byte raw payload. Detail page: https://www.isobus.net/isobus/pGNAndSPN/13738?type=PGN. Signal-level enrichment via PR welcome  see CONTRIBUTING.md.";
CM_ SG_ 2147548416 Engine_Fluid_Level_Pressure_10_R "Generic 8-byte raw payload. Detail page: https://www.isobus.net/isobus/pGNAndSPN/13743?type=PGN. Signal-level enrichment via PR welcome  see CONTRIBUTING.md.";
CM_ SG_ 2147548417 Low_Voltage_Disconnect_Status_Ra "Generic 8-byte raw payload. Detail page: https://www.isobus.net/isobus/pGNAndSPN/13751?type=PGN. Signal-level enrichment via PR welcome  see CONTRIBUTING.md.";
CM_ SG_ 2147548419 Implement_Operating_state_comman "Generic 8-byte raw payload. Detail page: https://www.isobus.net/isobus/pGNAndSPN/13754?type=PGN. Signal-level enrichment via PR welcome  see CONTRIBUTING.md.";
CM_ SG_ 2147548420 Direct_Lamp_Control_Data_2_RawPa "Generic 8-byte raw payload. Detail page: https://www.isobus.net/isobus/pGNAndSPN/13769?type=PGN. Signal-level enrichment via PR welcome  see CONTRIBUTING.md.";
CM_ SG_ 2147548421 Direct_Lamp_Control_Data_1_RawPa "Generic 8-byte raw payload. Detail page: https://www.isobus.net/isobus/pGNAndSPN/13796?type=PGN. Signal-level enrichment via PR welcome  see CONTRIBUTING.md.";
CM_ SG_ 2147548422 Direct_Lamp_Control_Command_2_Ra "Generic 8-byte raw payload. Detail page: https://www.isobus.net/isobus/pGNAndSPN/13811?type=PGN. Signal-level enrichment via PR welcome  see CONTRIBUTING.md.";
CM_ SG_ 2147548423 Direct_Lamp_Control_Command_1_Ra "Generic 8-byte raw payload. Detail page: https://www.isobus.net/isobus/pGNAndSPN/13838?type=PGN. Signal-level enrichment via PR welcome  see CONTRIBUTING.md.";
CM_ SG_ 2147548424 Engine_oil_message_RawPayload "Generic 8-byte raw payload. Detail page: https://www.isobus.net/isobus/pGNAndSPN/13842?type=PGN. Signal-level enrichment via PR welcome  see CONTRIBUTING.md.";
CM_ SG_ 2147548425 High_Resolution_Fuel_Consumption "Generic 8-byte raw payload. Detail page: https://www.isobus.net/isobus/pGNAndSPN/13844?type=PGN. Signal-level enrichment via PR welcome  see CONTRIBUTING.md.";
CM_ SG_ 2147548426 Aftertreatment_2_Outlet_Gas_NOx_ "Generic 8-byte raw payload. Detail page: https://www.isobus.net/isobus/pGNAndSPN/13850?type=PGN. Signal-level enrichment via PR welcome  see CONTRIBUTING.md.";
CM_ SG_ 2147548427 Aftertreatment_2_Outlet_Gas_NOx_ "Generic 8-byte raw payload. Detail page: https://www.isobus.net/isobus/pGNAndSPN/13854?type=PGN. Signal-level enrichment via PR welcome  see CONTRIBUTING.md.";
CM_ SG_ 2147548428 Aftertreatment_2_Intake_Gas_NOx_ "Generic 8-byte raw payload. Detail page: https://www.isobus.net/isobus/pGNAndSPN/13860?type=PGN. Signal-level enrichment via PR welcome  see CONTRIBUTING.md.";
CM_ SG_ 2147548429 Aftertreatment_2_Intake_Gas_NOx_ "Generic 8-byte raw payload. Detail page: https://www.isobus.net/isobus/pGNAndSPN/13864?type=PGN. Signal-level enrichment via PR welcome  see CONTRIBUTING.md.";
CM_ SG_ 2147548430 Aftertreatment_1_Outlet_Gas_NOx_ "Generic 8-byte raw payload. Detail page: https://www.isobus.net/isobus/pGNAndSPN/13870?type=PGN. Signal-level enrichment via PR welcome  see CONTRIBUTING.md.";
CM_ SG_ 2147548431 Aftertreatment_1_Outlet_Gas_NOx_ "Generic 8-byte raw payload. Detail page: https://www.isobus.net/isobus/pGNAndSPN/13874?type=PGN. Signal-level enrichment via PR welcome  see CONTRIBUTING.md.";
CM_ SG_ 2147548432 Aftertreatment_1_Intake_Gas_NOx_ "Generic 8-byte raw payload. Detail page: https://www.isobus.net/isobus/pGNAndSPN/13880?type=PGN. Signal-level enrichment via PR welcome  see CONTRIBUTING.md.";
CM_ SG_ 2147548433 Aftertreatment_1_Intake_Gas_NOx_ "Generic 8-byte raw payload. Detail page: https://www.isobus.net/isobus/pGNAndSPN/13884?type=PGN. Signal-level enrichment via PR welcome  see CONTRIBUTING.md.";
CM_ SG_ 2147548434 Magnet_Status_Information_1_RawP "Generic 8-byte raw payload. Detail page: https://www.isobus.net/isobus/pGNAndSPN/13892?type=PGN. Signal-level enrichment via PR welcome  see CONTRIBUTING.md.";
CM_ SG_ 2147548435 Magnet_System_Configuration_Info "Generic 8-byte raw payload. Detail page: https://www.isobus.net/isobus/pGNAndSPN/13894?type=PGN. Signal-level enrichment via PR welcome  see CONTRIBUTING.md.";
CM_ SG_ 2147548436 Battery_Charger_2_RawPayload "Generic 8-byte raw payload. Detail page: https://www.isobus.net/isobus/pGNAndSPN/13901?type=PGN. Signal-level enrichment via PR welcome  see CONTRIBUTING.md.";
CM_ SG_ 2147548437 Battery_Charger_1_RawPayload "Generic 8-byte raw payload. Detail page: https://www.isobus.net/isobus/pGNAndSPN/13908?type=PGN. Signal-level enrichment via PR welcome  see CONTRIBUTING.md.";
CM_ SG_ 2147548438 Occupant_Classification_System_I "Generic 8-byte raw payload. Detail page: https://www.isobus.net/isobus/pGNAndSPN/13918?type=PGN. Signal-level enrichment via PR welcome  see CONTRIBUTING.md.";
CM_ SG_ 2147548439 Beltlock_and_Airbag_Deactivation "Generic 8-byte raw payload. Detail page: https://www.isobus.net/isobus/pGNAndSPN/13930?type=PGN. Signal-level enrichment via PR welcome  see CONTRIBUTING.md.";
CM_ SG_ 2147548440 Collision_Sensor_Information_Raw "Generic 8-byte raw payload. Detail page: https://www.isobus.net/isobus/pGNAndSPN/13964?type=PGN. Signal-level enrichment via PR welcome  see CONTRIBUTING.md.";
CM_ SG_ 2147548441 Ignitor_Loop_Information_RawPayl "Generic 8-byte raw payload. Detail page: https://www.isobus.net/isobus/pGNAndSPN/14064?type=PGN. Signal-level enrichment via PR welcome  see CONTRIBUTING.md.";
CM_ SG_ 2147548442 Aftertreatment_1_Warm_Up_Diesel_ "Generic 8-byte raw payload. Detail page: https://www.isobus.net/isobus/pGNAndSPN/14066?type=PGN. Signal-level enrichment via PR welcome  see CONTRIBUTING.md.";
CM_ SG_ 2147548443 Diesel_Particulate_Filter_2_Soot "Generic 8-byte raw payload. Detail page: https://www.isobus.net/isobus/pGNAndSPN/14072?type=PGN. Signal-level enrichment via PR welcome  see CONTRIBUTING.md.";
CM_ SG_ 2147548444 Diesel_Particulate_Filter_1_Soot "Generic 8-byte raw payload. Detail page: https://www.isobus.net/isobus/pGNAndSPN/14078?type=PGN. Signal-level enrichment via PR welcome  see CONTRIBUTING.md.";
CM_ SG_ 2147548445 Aftertreatment_Differential_Temp "Generic 8-byte raw payload. Detail page: https://www.isobus.net/isobus/pGNAndSPN/14080?type=PGN. Signal-level enrichment via PR welcome  see CONTRIBUTING.md.";
CM_ SG_ 2147548446 Aftertreatment_Differential_Temp "Generic 8-byte raw payload. Detail page: https://www.isobus.net/isobus/pGNAndSPN/14082?type=PGN. Signal-level enrichment via PR welcome  see CONTRIBUTING.md.";
CM_ SG_ 2147548447 Aftertreatment_2_Diesel_Oxidatio "Generic 8-byte raw payload. Detail page: https://www.isobus.net/isobus/pGNAndSPN/14088?type=PGN. Signal-level enrichment via PR welcome  see CONTRIBUTING.md.";
CM_ SG_ 2147548448 Aftertreatment_1_Diesel_Oxidatio "Generic 8-byte raw payload. Detail page: https://www.isobus.net/isobus/pGNAndSPN/14094?type=PGN. Signal-level enrichment via PR welcome  see CONTRIBUTING.md.";
CM_ SG_ 2147548449 Aftertreatment_2_Gas_Oxidation_C "Generic 8-byte raw payload. Detail page: https://www.isobus.net/isobus/pGNAndSPN/14100?type=PGN. Signal-level enrichment via PR welcome  see CONTRIBUTING.md.";
CM_ SG_ 2147548450 Aftertreatment_1_Gas_Oxidation_C "Generic 8-byte raw payload. Detail page: https://www.isobus.net/isobus/pGNAndSPN/14106?type=PGN. Signal-level enrichment via PR welcome  see CONTRIBUTING.md.";
CM_ SG_ 2147548451 Extended_Joystick_Message_10_Raw "Generic 8-byte raw payload. Detail page: https://www.isobus.net/isobus/pGNAndSPN/14125?type=PGN. Signal-level enrichment via PR welcome  see CONTRIBUTING.md.";
CM_ SG_ 2147548452 Basic_Joystick_Message_10_RawPay "Generic 8-byte raw payload. Detail page: https://www.isobus.net/isobus/pGNAndSPN/14147?type=PGN. Signal-level enrichment via PR welcome  see CONTRIBUTING.md.";
CM_ SG_ 2147548453 Extended_Joystick_Message_9_RawP "Generic 8-byte raw payload. Detail page: https://www.isobus.net/isobus/pGNAndSPN/14166?type=PGN. Signal-level enrichment via PR welcome  see CONTRIBUTING.md.";
CM_ SG_ 2147548454 Basic_Joystick_Message_9_RawPayl "Generic 8-byte raw payload. Detail page: https://www.isobus.net/isobus/pGNAndSPN/14188?type=PGN. Signal-level enrichment via PR welcome  see CONTRIBUTING.md.";
CM_ SG_ 2147548455 Extended_Joystick_Message_8_RawP "Generic 8-byte raw payload. Detail page: https://www.isobus.net/isobus/pGNAndSPN/14207?type=PGN. Signal-level enrichment via PR welcome  see CONTRIBUTING.md.";
CM_ SG_ 2147548456 Basic_Joystick_Message_8_RawPayl "Generic 8-byte raw payload. Detail page: https://www.isobus.net/isobus/pGNAndSPN/14229?type=PGN. Signal-level enrichment via PR welcome  see CONTRIBUTING.md.";
CM_ SG_ 2147548457 Extended_Joystick_Message_7_RawP "Generic 8-byte raw payload. Detail page: https://www.isobus.net/isobus/pGNAndSPN/14248?type=PGN. Signal-level enrichment via PR welcome  see CONTRIBUTING.md.";
CM_ SG_ 2147548458 Basic_Joystick_Message_7_RawPayl "Generic 8-byte raw payload. Detail page: https://www.isobus.net/isobus/pGNAndSPN/14270?type=PGN. Signal-level enrichment via PR welcome  see CONTRIBUTING.md.";
CM_ SG_ 2147548459 Extended_Joystick_Message_6_RawP "Generic 8-byte raw payload. Detail page: https://www.isobus.net/isobus/pGNAndSPN/14289?type=PGN. Signal-level enrichment via PR welcome  see CONTRIBUTING.md.";
CM_ SG_ 2147548460 Basic_Joystick_Message_6_RawPayl "Generic 8-byte raw payload. Detail page: https://www.isobus.net/isobus/pGNAndSPN/14311?type=PGN. Signal-level enrichment via PR welcome  see CONTRIBUTING.md.";
CM_ SG_ 2147548461 Extended_Joystick_Message_5_RawP "Generic 8-byte raw payload. Detail page: https://www.isobus.net/isobus/pGNAndSPN/14330?type=PGN. Signal-level enrichment via PR welcome  see CONTRIBUTING.md.";
CM_ SG_ 2147548462 Basic_Joystick_Message_5_RawPayl "Generic 8-byte raw payload. Detail page: https://www.isobus.net/isobus/pGNAndSPN/14352?type=PGN. Signal-level enrichment via PR welcome  see CONTRIBUTING.md.";
CM_ SG_ 2147548463 Extended_Joystick_Message_4_RawP "Generic 8-byte raw payload. Detail page: https://www.isobus.net/isobus/pGNAndSPN/14371?type=PGN. Signal-level enrichment via PR welcome  see CONTRIBUTING.md.";
CM_ SG_ 2147548464 Basic_Joystick_Message_4_RawPayl "Generic 8-byte raw payload. Detail page: https://www.isobus.net/isobus/pGNAndSPN/14393?type=PGN. Signal-level enrichment via PR welcome  see CONTRIBUTING.md.";
CM_ SG_ 2147548465 Fan_Drive_2_RawPayload "Generic 8-byte raw payload. Detail page: https://www.isobus.net/isobus/pGNAndSPN/14398?type=PGN. Signal-level enrichment via PR welcome  see CONTRIBUTING.md.";
CM_ SG_ 2147548467 Aftertreatment_2_Diesel_Exhaust_ "Generic 8-byte raw payload. Detail page: https://www.isobus.net/isobus/pGNAndSPN/14408?type=PGN. Signal-level enrichment via PR welcome  see CONTRIBUTING.md.";
CM_ SG_ 2147548468 Aftertreatment_2_SCR_Reagant_Tan "Generic 8-byte raw payload. Detail page: https://www.isobus.net/isobus/pGNAndSPN/14415?type=PGN. Signal-level enrichment via PR welcome  see CONTRIBUTING.md.";
CM_ SG_ 2147548469 Aftertreatment_2_Diesel_Exhaust_ "Generic 8-byte raw payload. Detail page: https://www.isobus.net/isobus/pGNAndSPN/14422?type=PGN. Signal-level enrichment via PR welcome  see CONTRIBUTING.md.";
CM_ SG_ 2147548470 Aftertreatment_2_Diesel_Exhaust_ "Generic 8-byte raw payload. Detail page: https://www.isobus.net/isobus/pGNAndSPN/14428?type=PGN. Signal-level enrichment via PR welcome  see CONTRIBUTING.md.";
CM_ SG_ 2147548471 Aftertreatment_2_SCR_Service_Inf "Generic 8-byte raw payload. Detail page: https://www.isobus.net/isobus/pGNAndSPN/14433?type=PGN. Signal-level enrichment via PR welcome  see CONTRIBUTING.md.";
CM_ SG_ 2147548472 Aftertreatment_2_SCR_Exhaust_Gas "Generic 8-byte raw payload. Detail page: https://www.isobus.net/isobus/pGNAndSPN/14437?type=PGN. Signal-level enrichment via PR welcome  see CONTRIBUTING.md.";
CM_ SG_ 2147548473 Aftertreatment_2_SCR_Exhaust_Gas "Generic 8-byte raw payload. Detail page: https://www.isobus.net/isobus/pGNAndSPN/14441?type=PGN. Signal-level enrichment via PR welcome  see CONTRIBUTING.md.";
CM_ SG_ 2147548474 Aftertreatment_2_SCR_Dosing_Syst "Generic 8-byte raw payload. Detail page: https://www.isobus.net/isobus/pGNAndSPN/14458?type=PGN. Signal-level enrichment via PR welcome  see CONTRIBUTING.md.";
CM_ SG_ 2147548475 Aftertreatment_2_SCR_Dosing_Syst "Generic 8-byte raw payload. Detail page: https://www.isobus.net/isobus/pGNAndSPN/14471?type=PGN. Signal-level enrichment via PR welcome  see CONTRIBUTING.md.";
CM_ SG_ 2147548476 Aftertreatment_1_Diesel_Exhaust_ "Generic 8-byte raw payload. Detail page: https://www.isobus.net/isobus/pGNAndSPN/14480?type=PGN. Signal-level enrichment via PR welcome  see CONTRIBUTING.md.";
CM_ SG_ 2147548477 Aftertreatment_1_SCR_Reagant_Tan "Generic 8-byte raw payload. Detail page: https://www.isobus.net/isobus/pGNAndSPN/14487?type=PGN. Signal-level enrichment via PR welcome  see CONTRIBUTING.md.";
CM_ SG_ 2147548478 Aftertreatment_1_SCR_Exhaust_Gas "Generic 8-byte raw payload. Detail page: https://www.isobus.net/isobus/pGNAndSPN/14491?type=PGN. Signal-level enrichment via PR welcome  see CONTRIBUTING.md.";
CM_ SG_ 2147548479 Aftertreatment_1_SCR_Exhaust_Gas "Generic 8-byte raw payload. Detail page: https://www.isobus.net/isobus/pGNAndSPN/14495?type=PGN. Signal-level enrichment via PR welcome  see CONTRIBUTING.md.";
CM_ SG_ 2147548480 Aftertreatment_1_SCR_Dosing_Syst "Generic 8-byte raw payload. Detail page: https://www.isobus.net/isobus/pGNAndSPN/14513?type=PGN. Signal-level enrichment via PR welcome  see CONTRIBUTING.md.";
CM_ SG_ 2147548481 Aftertreatment_1_SCR_Dosing_Syst "Generic 8-byte raw payload. Detail page: https://www.isobus.net/isobus/pGNAndSPN/14526?type=PGN. Signal-level enrichment via PR welcome  see CONTRIBUTING.md.";
CM_ SG_ 2147548482 ISOBUS_compliance_certification_ "Generic 8-byte raw payload. Detail page: https://www.isobus.net/isobus/pGNAndSPN/14545?type=PGN. Signal-level enrichment via PR welcome  see CONTRIBUTING.md.";
CM_ SG_ 2147548484 Aftertreatment_2_Fuel_Control_2_ "Generic 8-byte raw payload. Detail page: https://www.isobus.net/isobus/pGNAndSPN/14552?type=PGN. Signal-level enrichment via PR welcome  see CONTRIBUTING.md.";
CM_ SG_ 2147548485 Aftertreatment_2_Three_Way_Catal "Generic 8-byte raw payload. Detail page: https://www.isobus.net/isobus/pGNAndSPN/14558?type=PGN. Signal-level enrichment via PR welcome  see CONTRIBUTING.md.";
CM_ SG_ 2147548486 Aftertreatment_1_Three_Way_Catal "Generic 8-byte raw payload. Detail page: https://www.isobus.net/isobus/pGNAndSPN/14564?type=PGN. Signal-level enrichment via PR welcome  see CONTRIBUTING.md.";
CM_ SG_ 2147548487 Transmission_Mode_Labels_RawPayl "Generic 8-byte raw payload. Detail page: https://www.isobus.net/isobus/pGNAndSPN/14565?type=PGN. Signal-level enrichment via PR welcome  see CONTRIBUTING.md.";
CM_ SG_ 2147548488 Engine_Exhaust_Bank_2_O2_Fuel_Tr "Generic 8-byte raw payload. Detail page: https://www.isobus.net/isobus/pGNAndSPN/14568?type=PGN. Signal-level enrichment via PR welcome  see CONTRIBUTING.md.";
CM_ SG_ 2147548489 Engine_Exhaust_Bank_1_O2_Fuel_Tr "Generic 8-byte raw payload. Detail page: https://www.isobus.net/isobus/pGNAndSPN/14571?type=PGN. Signal-level enrichment via PR welcome  see CONTRIBUTING.md.";
CM_ SG_ 2147548490 General_Purpose_Message_2_11_Raw "Generic 8-byte raw payload. Detail page: https://www.isobus.net/isobus/pGNAndSPN/14572?type=PGN. Signal-level enrichment via PR welcome  see CONTRIBUTING.md.";
CM_ SG_ 2147548491 General_Purpose_Message_2_10_Raw "Generic 8-byte raw payload. Detail page: https://www.isobus.net/isobus/pGNAndSPN/14573?type=PGN. Signal-level enrichment via PR welcome  see CONTRIBUTING.md.";
CM_ SG_ 2147548492 General_Purpose_Message_2_9_RawP "Generic 8-byte raw payload. Detail page: https://www.isobus.net/isobus/pGNAndSPN/14574?type=PGN. Signal-level enrichment via PR welcome  see CONTRIBUTING.md.";
CM_ SG_ 2147548493 General_Purpose_Message_2_8_RawP "Generic 8-byte raw payload. Detail page: https://www.isobus.net/isobus/pGNAndSPN/14575?type=PGN. Signal-level enrichment via PR welcome  see CONTRIBUTING.md.";
CM_ SG_ 2147548494 General_Purpose_Message_2_7_RawP "Generic 8-byte raw payload. Detail page: https://www.isobus.net/isobus/pGNAndSPN/14576?type=PGN. Signal-level enrichment via PR welcome  see CONTRIBUTING.md.";
CM_ SG_ 2147548495 General_Purpose_Message_2_6_RawP "Generic 8-byte raw payload. Detail page: https://www.isobus.net/isobus/pGNAndSPN/14577?type=PGN. Signal-level enrichment via PR welcome  see CONTRIBUTING.md.";
CM_ SG_ 2147548496 General_Purpose_Message_1_9_RawP "Generic 8-byte raw payload. Detail page: https://www.isobus.net/isobus/pGNAndSPN/14578?type=PGN. Signal-level enrichment via PR welcome  see CONTRIBUTING.md.";
CM_ SG_ 2147548497 Aftercooler_Coolant_Control_Valv "Generic 8-byte raw payload. Detail page: https://www.isobus.net/isobus/pGNAndSPN/14584?type=PGN. Signal-level enrichment via PR welcome  see CONTRIBUTING.md.";
CM_ SG_ 2147548498 Engine_Coolant_Control_Valve_Com "Generic 8-byte raw payload. Detail page: https://www.isobus.net/isobus/pGNAndSPN/14592?type=PGN. Signal-level enrichment via PR welcome  see CONTRIBUTING.md.";
CM_ SG_ 2147548499 Engine_Average_Information_RawPa "Generic 8-byte raw payload. Detail page: https://www.isobus.net/isobus/pGNAndSPN/14595?type=PGN. Signal-level enrichment via PR welcome  see CONTRIBUTING.md.";
CM_ SG_ 2147548500 DTCs_C_Previously_Active_RawPayl "Generic 8-byte raw payload. Detail page: https://www.isobus.net/isobus/pGNAndSPN/14607?type=PGN. Signal-level enrichment via PR welcome  see CONTRIBUTING.md.";
CM_ SG_ 2147548501 DTCs_C_Confirmed_and_Active_RawP "Generic 8-byte raw payload. Detail page: https://www.isobus.net/isobus/pGNAndSPN/14619?type=PGN. Signal-level enrichment via PR welcome  see CONTRIBUTING.md.";
CM_ SG_ 2147548502 DTCs_C_Pending_RawPayload "Generic 8-byte raw payload. Detail page: https://www.isobus.net/isobus/pGNAndSPN/14631?type=PGN. Signal-level enrichment via PR welcome  see CONTRIBUTING.md.";
CM_ SG_ 2147548503 DTCs_B2_Previously_Active_RawPay "Generic 8-byte raw payload. Detail page: https://www.isobus.net/isobus/pGNAndSPN/14643?type=PGN. Signal-level enrichment via PR welcome  see CONTRIBUTING.md.";
CM_ SG_ 2147548504 DTCs_B2_Confirmed_and_Active_Raw "Generic 8-byte raw payload. Detail page: https://www.isobus.net/isobus/pGNAndSPN/14655?type=PGN. Signal-level enrichment via PR welcome  see CONTRIBUTING.md.";
CM_ SG_ 2147548505 DTCs_B2_Pending_RawPayload "Generic 8-byte raw payload. Detail page: https://www.isobus.net/isobus/pGNAndSPN/14667?type=PGN. Signal-level enrichment via PR welcome  see CONTRIBUTING.md.";
CM_ SG_ 2147548506 DTCs_B1_Previously_Active_RawPay "Generic 8-byte raw payload. Detail page: https://www.isobus.net/isobus/pGNAndSPN/14679?type=PGN. Signal-level enrichment via PR welcome  see CONTRIBUTING.md.";
CM_ SG_ 2147548507 DTCs_B1_Confirmed_and_Active_Raw "Generic 8-byte raw payload. Detail page: https://www.isobus.net/isobus/pGNAndSPN/14691?type=PGN. Signal-level enrichment via PR welcome  see CONTRIBUTING.md.";
CM_ SG_ 2147548508 DTCs_B1_Pending_RawPayload "Generic 8-byte raw payload. Detail page: https://www.isobus.net/isobus/pGNAndSPN/14703?type=PGN. Signal-level enrichment via PR welcome  see CONTRIBUTING.md.";
CM_ SG_ 2147548509 DTCs_A_Previously_Active_RawPayl "Generic 8-byte raw payload. Detail page: https://www.isobus.net/isobus/pGNAndSPN/14715?type=PGN. Signal-level enrichment via PR welcome  see CONTRIBUTING.md.";
CM_ SG_ 2147548510 DTCs_A_Confirmed_and_Active_RawP "Generic 8-byte raw payload. Detail page: https://www.isobus.net/isobus/pGNAndSPN/14727?type=PGN. Signal-level enrichment via PR welcome  see CONTRIBUTING.md.";
CM_ SG_ 2147548511 DTCs_A_Pending_RawPayload "Generic 8-byte raw payload. Detail page: https://www.isobus.net/isobus/pGNAndSPN/14739?type=PGN. Signal-level enrichment via PR welcome  see CONTRIBUTING.md.";
CM_ SG_ 2147548512 Harmonized_B1_Failure_Counts_Raw "Generic 8-byte raw payload. Detail page: https://www.isobus.net/isobus/pGNAndSPN/14742?type=PGN. Signal-level enrichment via PR welcome  see CONTRIBUTING.md.";
CM_ SG_ 2147548513 Harmonized_Cumulative_Continuous "Generic 8-byte raw payload. Detail page: https://www.isobus.net/isobus/pGNAndSPN/14744?type=PGN. Signal-level enrichment via PR welcome  see CONTRIBUTING.md.";
CM_ SG_ 2147548514 Harmonized_Global_Regulation_Des "Generic 8-byte raw payload. Detail page: https://www.isobus.net/isobus/pGNAndSPN/14745?type=PGN. Signal-level enrichment via PR welcome  see CONTRIBUTING.md.";
CM_ SG_ 2147548515 Harmonized_Roadworthiness_System "Generic 8-byte raw payload. Detail page: https://www.isobus.net/isobus/pGNAndSPN/14750?type=PGN. Signal-level enrichment via PR welcome  see CONTRIBUTING.md.";
CM_ SG_ 2147548516 Harmonized_Roadworthiness_Vehicl "Generic 8-byte raw payload. Detail page: https://www.isobus.net/isobus/pGNAndSPN/14751?type=PGN. Signal-level enrichment via PR welcome  see CONTRIBUTING.md.";
CM_ SG_ 2147548517 Aftertreatment_1_Fuel_Control_2_ "Generic 8-byte raw payload. Detail page: https://www.isobus.net/isobus/pGNAndSPN/14756?type=PGN. Signal-level enrichment via PR welcome  see CONTRIBUTING.md.";
CM_ SG_ 2147548518 Engine_Temperature_4_RawPayload "Generic 8-byte raw payload. Detail page: https://www.isobus.net/isobus/pGNAndSPN/14762?type=PGN. Signal-level enrichment via PR welcome  see CONTRIBUTING.md.";
CM_ SG_ 2147548519 Zero_Net_Vehicle_Weight_Change_R "Generic 8-byte raw payload. Detail page: https://www.isobus.net/isobus/pGNAndSPN/14763?type=PGN. Signal-level enrichment via PR welcome  see CONTRIBUTING.md.";
CM_ SG_ 2147548520 Gross_Combination_Vehicle_Weight "Generic 8-byte raw payload. Detail page: https://www.isobus.net/isobus/pGNAndSPN/14765?type=PGN. Signal-level enrichment via PR welcome  see CONTRIBUTING.md.";
CM_ SG_ 2147548521 Axle_Group_Calibration_Weights_R "Generic 8-byte raw payload. Detail page: https://www.isobus.net/isobus/pGNAndSPN/14769?type=PGN. Signal-level enrichment via PR welcome  see CONTRIBUTING.md.";
CM_ SG_ 2147548522 Axle_Group_Weight_RawPayload "Generic 8-byte raw payload. Detail page: https://www.isobus.net/isobus/pGNAndSPN/14772?type=PGN. Signal-level enrichment via PR welcome  see CONTRIBUTING.md.";
CM_ SG_ 2147548523 Available_Axle_Group_Weights_Raw "Generic 8-byte raw payload. Detail page: https://www.isobus.net/isobus/pGNAndSPN/14788?type=PGN. Signal-level enrichment via PR welcome  see CONTRIBUTING.md.";
CM_ SG_ 2147548524 Aftertreatment_2_Air_Control_2_R "Generic 8-byte raw payload. Detail page: https://www.isobus.net/isobus/pGNAndSPN/14792?type=PGN. Signal-level enrichment via PR welcome  see CONTRIBUTING.md.";
CM_ SG_ 2147548525 Aftertreatment_1_Air_Control_2_R "Generic 8-byte raw payload. Detail page: https://www.isobus.net/isobus/pGNAndSPN/14796?type=PGN. Signal-level enrichment via PR welcome  see CONTRIBUTING.md.";
CM_ SG_ 2147548526 Aftertreatment_1_SCR_Service_Inf "Generic 8-byte raw payload. Detail page: https://www.isobus.net/isobus/pGNAndSPN/14801?type=PGN. Signal-level enrichment via PR welcome  see CONTRIBUTING.md.";
CM_ SG_ 2147548527 Electronic_Engine_Controller_8_R "Generic 8-byte raw payload. Detail page: https://www.isobus.net/isobus/pGNAndSPN/14806?type=PGN. Signal-level enrichment via PR welcome  see CONTRIBUTING.md.";
CM_ SG_ 2147548528 Door_ramp_control_RawPayload "Generic 8-byte raw payload. Detail page: https://www.isobus.net/isobus/pGNAndSPN/14821?type=PGN. Signal-level enrichment via PR welcome  see CONTRIBUTING.md.";
CM_ SG_ 2147548529 Brake_actuator_stroke_status_Raw "Generic 8-byte raw payload. Detail page: https://www.isobus.net/isobus/pGNAndSPN/14841?type=PGN. Signal-level enrichment via PR welcome  see CONTRIBUTING.md.";
CM_ SG_ 2147548530 Engine_Spark_Voltage_6_RawPayloa "Generic 8-byte raw payload. Detail page: https://www.isobus.net/isobus/pGNAndSPN/14845?type=PGN. Signal-level enrichment via PR welcome  see CONTRIBUTING.md.";
CM_ SG_ 2147548531 Engine_Spark_Voltage_5_RawPayloa "Generic 8-byte raw payload. Detail page: https://www.isobus.net/isobus/pGNAndSPN/14849?type=PGN. Signal-level enrichment via PR welcome  see CONTRIBUTING.md.";
CM_ SG_ 2147548532 Engine_Spark_Voltage_4_RawPayloa "Generic 8-byte raw payload. Detail page: https://www.isobus.net/isobus/pGNAndSPN/14853?type=PGN. Signal-level enrichment via PR welcome  see CONTRIBUTING.md.";
CM_ SG_ 2147548533 Engine_Spark_Voltage_3_RawPayloa "Generic 8-byte raw payload. Detail page: https://www.isobus.net/isobus/pGNAndSPN/14857?type=PGN. Signal-level enrichment via PR welcome  see CONTRIBUTING.md.";
CM_ SG_ 2147548534 Engine_Spark_Voltage_2_RawPayloa "Generic 8-byte raw payload. Detail page: https://www.isobus.net/isobus/pGNAndSPN/14861?type=PGN. Signal-level enrichment via PR welcome  see CONTRIBUTING.md.";
CM_ SG_ 2147548535 Engine_Spark_Voltage_1_RawPayloa "Generic 8-byte raw payload. Detail page: https://www.isobus.net/isobus/pGNAndSPN/14865?type=PGN. Signal-level enrichment via PR welcome  see CONTRIBUTING.md.";
CM_ SG_ 2147548536 Aftertreatment_2_Trip_Informatio "Generic 8-byte raw payload. Detail page: https://www.isobus.net/isobus/pGNAndSPN/14873?type=PGN. Signal-level enrichment via PR welcome  see CONTRIBUTING.md.";
CM_ SG_ 2147548537 Aftertreatment_1_Trip_Informatio "Generic 8-byte raw payload. Detail page: https://www.isobus.net/isobus/pGNAndSPN/14881?type=PGN. Signal-level enrichment via PR welcome  see CONTRIBUTING.md.";
CM_ SG_ 2147548538 Aftertreatment_2_Service_1_RawPa "Generic 8-byte raw payload. Detail page: https://www.isobus.net/isobus/pGNAndSPN/14885?type=PGN. Signal-level enrichment via PR welcome  see CONTRIBUTING.md.";
CM_ SG_ 2147548539 Aftertreatment_1_Service_1_RawPa "Generic 8-byte raw payload. Detail page: https://www.isobus.net/isobus/pGNAndSPN/14889?type=PGN. Signal-level enrichment via PR welcome  see CONTRIBUTING.md.";
CM_ SG_ 2147548540 Diesel_Particulate_Filter_Contro "Generic 8-byte raw payload. Detail page: https://www.isobus.net/isobus/pGNAndSPN/14917?type=PGN. Signal-level enrichment via PR welcome  see CONTRIBUTING.md.";
CM_ SG_ 2147548541 Reserved_for_FMS_Telltale_status "Generic 8-byte raw payload. Detail page: https://www.isobus.net/isobus/pGNAndSPN/14918?type=PGN. Signal-level enrichment via PR welcome  see CONTRIBUTING.md.";
CM_ SG_ 2147548542 Adaptive_Front_Lighting_System_S "Generic 8-byte raw payload. Detail page: https://www.isobus.net/isobus/pGNAndSPN/14922?type=PGN. Signal-level enrichment via PR welcome  see CONTRIBUTING.md.";
CM_ SG_ 2147548543 Engine_Configuration_2_RawPayloa "Generic 8-byte raw payload. Detail page: https://www.isobus.net/isobus/pGNAndSPN/14926?type=PGN. Signal-level enrichment via PR welcome  see CONTRIBUTING.md.";
CM_ SG_ 2147548544 Emission_Related_Permanent_Diagn "Generic 8-byte raw payload. Detail page: https://www.isobus.net/isobus/pGNAndSPN/14938?type=PGN. Signal-level enrichment via PR welcome  see CONTRIBUTING.md.";
CM_ SG_ 2147548545 EGR_Cooler_Bypass_RawPayload "Generic 8-byte raw payload. Detail page: https://www.isobus.net/isobus/pGNAndSPN/14939?type=PGN. Signal-level enrichment via PR welcome  see CONTRIBUTING.md.";
CM_ SG_ 2147548546 All_Pending_DTCs_RawPayload "Generic 8-byte raw payload. Detail page: https://www.isobus.net/isobus/pGNAndSPN/14951?type=PGN. Signal-level enrichment via PR welcome  see CONTRIBUTING.md.";
CM_ SG_ 2147548547 Transfer_Case_Information_RawPay "Generic 8-byte raw payload. Detail page: https://www.isobus.net/isobus/pGNAndSPN/14956?type=PGN. Signal-level enrichment via PR welcome  see CONTRIBUTING.md.";
CM_ SG_ 2147548548 Engine_Fluid_Level_Pressure_9_Ra "Generic 8-byte raw payload. Detail page: https://www.isobus.net/isobus/pGNAndSPN/14960?type=PGN. Signal-level enrichment via PR welcome  see CONTRIBUTING.md.";
CM_ SG_ 2147548549 Engine_Fluid_Level_Pressure_8_Ra "Generic 8-byte raw payload. Detail page: https://www.isobus.net/isobus/pGNAndSPN/14964?type=PGN. Signal-level enrichment via PR welcome  see CONTRIBUTING.md.";
CM_ SG_ 2147548550 Engine_Fluid_Level_Pressure_7_Ra "Generic 8-byte raw payload. Detail page: https://www.isobus.net/isobus/pGNAndSPN/14968?type=PGN. Signal-level enrichment via PR welcome  see CONTRIBUTING.md.";
CM_ SG_ 2147548551 Engine_Fluid_Level_Pressure_6_Ra "Generic 8-byte raw payload. Detail page: https://www.isobus.net/isobus/pGNAndSPN/14972?type=PGN. Signal-level enrichment via PR welcome  see CONTRIBUTING.md.";
CM_ SG_ 2147548552 Engine_Fluid_Level_Pressure_5_Ra "Generic 8-byte raw payload. Detail page: https://www.isobus.net/isobus/pGNAndSPN/14976?type=PGN. Signal-level enrichment via PR welcome  see CONTRIBUTING.md.";
CM_ SG_ 2147548553 Vehicle_Direction_Speed_2_RawPay "Generic 8-byte raw payload. Detail page: https://www.isobus.net/isobus/pGNAndSPN/14977?type=PGN. Signal-level enrichment via PR welcome  see CONTRIBUTING.md.";
CM_ SG_ 2147548554 SAE_J2012_2_Byte_DTC_Display_Raw "Generic 8-byte raw payload. Detail page: https://www.isobus.net/isobus/pGNAndSPN/14981?type=PGN. Signal-level enrichment via PR welcome  see CONTRIBUTING.md.";
CM_ SG_ 2147548555 Aftertreatment_2_Gas_Parameters_ "Generic 8-byte raw payload. Detail page: https://www.isobus.net/isobus/pGNAndSPN/14983?type=PGN. Signal-level enrichment via PR welcome  see CONTRIBUTING.md.";
CM_ SG_ 2147548556 Aftertreatment_1_Gas_Parameters_ "Generic 8-byte raw payload. Detail page: https://www.isobus.net/isobus/pGNAndSPN/14985?type=PGN. Signal-level enrichment via PR welcome  see CONTRIBUTING.md.";
CM_ SG_ 2147548557 Utility_Total_AC_Reactive_Energy "Generic 8-byte raw payload. Detail page: https://www.isobus.net/isobus/pGNAndSPN/14987?type=PGN. Signal-level enrichment via PR welcome  see CONTRIBUTING.md.";
CM_ SG_ 2147548558 Generator_Total_AC_Reactive_Ener "Generic 8-byte raw payload. Detail page: https://www.isobus.net/isobus/pGNAndSPN/14989?type=PGN. Signal-level enrichment via PR welcome  see CONTRIBUTING.md.";
CM_ SG_ 2147548559 Generator_Total_AC_Percent_Power "Generic 8-byte raw payload. Detail page: https://www.isobus.net/isobus/pGNAndSPN/14992?type=PGN. Signal-level enrichment via PR welcome  see CONTRIBUTING.md.";
CM_ SG_ 2147548560 Advertised_Engine_Torque_Curve_R "Generic 8-byte raw payload. Detail page: https://www.isobus.net/isobus/pGNAndSPN/14996?type=PGN. Signal-level enrichment via PR welcome  see CONTRIBUTING.md.";
CM_ SG_ 2147548561 AC_Switching_Device_Status_RawPa "Generic 8-byte raw payload. Detail page: https://www.isobus.net/isobus/pGNAndSPN/15007?type=PGN. Signal-level enrichment via PR welcome  see CONTRIBUTING.md.";
CM_ SG_ 2147548562 Engine_Operating_Information_Raw "Generic 8-byte raw payload. Detail page: https://www.isobus.net/isobus/pGNAndSPN/15025?type=PGN. Signal-level enrichment via PR welcome  see CONTRIBUTING.md.";
CM_ SG_ 2147548563 Generator_Control_1_RawPayload "Generic 8-byte raw payload. Detail page: https://www.isobus.net/isobus/pGNAndSPN/15033?type=PGN. Signal-level enrichment via PR welcome  see CONTRIBUTING.md.";
CM_ SG_ 2147548564 Electronic_Engine_Controller_7_R "Generic 8-byte raw payload. Detail page: https://www.isobus.net/isobus/pGNAndSPN/15037?type=PGN. Signal-level enrichment via PR welcome  see CONTRIBUTING.md.";
CM_ SG_ 2147548565 Transmission_Fluids_2_RawPayload "Generic 8-byte raw payload. Detail page: https://www.isobus.net/isobus/pGNAndSPN/15047?type=PGN. Signal-level enrichment via PR welcome  see CONTRIBUTING.md.";
CM_ SG_ 2147548566 Fuel_Information_2_Liquid_RawPay "Generic 8-byte raw payload. Detail page: https://www.isobus.net/isobus/pGNAndSPN/15049?type=PGN. Signal-level enrichment via PR welcome  see CONTRIBUTING.md.";
CM_ SG_ 2147548567 Fuel_Information_3_Liquid_RawPay "Generic 8-byte raw payload. Detail page: https://www.isobus.net/isobus/pGNAndSPN/15051?type=PGN. Signal-level enrichment via PR welcome  see CONTRIBUTING.md.";
CM_ SG_ 2147548568 Aftertreatment_1_Historical_Info "Generic 8-byte raw payload. Detail page: https://www.isobus.net/isobus/pGNAndSPN/15062?type=PGN. Signal-level enrichment via PR welcome  see CONTRIBUTING.md.";
CM_ SG_ 2147548569 Aftertreatment_2_Historical_info "Generic 8-byte raw payload. Detail page: https://www.isobus.net/isobus/pGNAndSPN/15073?type=PGN. Signal-level enrichment via PR welcome  see CONTRIBUTING.md.";
CM_ SG_ 2147548570 Electronic_Brake_System_2_4_RawP "Generic 8-byte raw payload. Detail page: https://www.isobus.net/isobus/pGNAndSPN/15074?type=PGN. Signal-level enrichment via PR welcome  see CONTRIBUTING.md.";
CM_ SG_ 2147548571 Aftertreatment_1_Diesel_Exhaust_ "Generic 8-byte raw payload. Detail page: https://www.isobus.net/isobus/pGNAndSPN/15081?type=PGN. Signal-level enrichment via PR welcome  see CONTRIBUTING.md.";
CM_ SG_ 2147548572 Sensor_Electrical_Power_2_RawPay "Generic 8-byte raw payload. Detail page: https://www.isobus.net/isobus/pGNAndSPN/15085?type=PGN. Signal-level enrichment via PR welcome  see CONTRIBUTING.md.";
CM_ SG_ 2147548573 Sensor_Electrical_Power_1_RawPay "Generic 8-byte raw payload. Detail page: https://www.isobus.net/isobus/pGNAndSPN/15089?type=PGN. Signal-level enrichment via PR welcome  see CONTRIBUTING.md.";
CM_ SG_ 2147548574 Aftertreatment_2_Air_Control_1_R "Generic 8-byte raw payload. Detail page: https://www.isobus.net/isobus/pGNAndSPN/15097?type=PGN. Signal-level enrichment via PR welcome  see CONTRIBUTING.md.";
CM_ SG_ 2147548575 Aftertreatment_1_Air_Control_1_R "Generic 8-byte raw payload. Detail page: https://www.isobus.net/isobus/pGNAndSPN/15105?type=PGN. Signal-level enrichment via PR welcome  see CONTRIBUTING.md.";
CM_ SG_ 2147548576 Aftertreatment_2_Fuel_Control_1_ "Generic 8-byte raw payload. Detail page: https://www.isobus.net/isobus/pGNAndSPN/15113?type=PGN. Signal-level enrichment via PR welcome  see CONTRIBUTING.md.";
CM_ SG_ 2147548577 Aftertreatment_1_Fuel_Control_1_ "Generic 8-byte raw payload. Detail page: https://www.isobus.net/isobus/pGNAndSPN/15121?type=PGN. Signal-level enrichment via PR welcome  see CONTRIBUTING.md.";
CM_ SG_ 2147548578 Fuel_Information_3_Gaseous_RawPa "Generic 8-byte raw payload. Detail page: https://www.isobus.net/isobus/pGNAndSPN/15125?type=PGN. Signal-level enrichment via PR welcome  see CONTRIBUTING.md.";
CM_ SG_ 2147548579 Electronic_Engine_Controller_6_R "Generic 8-byte raw payload. Detail page: https://www.isobus.net/isobus/pGNAndSPN/15132?type=PGN. Signal-level enrichment via PR welcome  see CONTRIBUTING.md.";
CM_ SG_ 2147548580 PTO_Drive_Engagement_1_RawPayloa "Generic 8-byte raw payload. Detail page: https://www.isobus.net/isobus/pGNAndSPN/15160?type=PGN. Signal-level enrichment via PR welcome  see CONTRIBUTING.md.";
CM_ SG_ 2147548581 Door_Control_2_RawPayload "Generic 8-byte raw payload. Detail page: https://www.isobus.net/isobus/pGNAndSPN/15190?type=PGN. Signal-level enrichment via PR welcome  see CONTRIBUTING.md.";
CM_ SG_ 2147548582 Voltage_Regulator_Excitation_Sta "Generic 8-byte raw payload. Detail page: https://www.isobus.net/isobus/pGNAndSPN/15193?type=PGN. Signal-level enrichment via PR welcome  see CONTRIBUTING.md.";
CM_ SG_ 2147548583 Voltage_Regulator_Operating_Mode "Generic 8-byte raw payload. Detail page: https://www.isobus.net/isobus/pGNAndSPN/15198?type=PGN. Signal-level enrichment via PR welcome  see CONTRIBUTING.md.";
CM_ SG_ 2147548584 Wireless_Communications_Message_ "Generic 8-byte raw payload. Detail page: https://www.isobus.net/isobus/pGNAndSPN/15203?type=PGN. Signal-level enrichment via PR welcome  see CONTRIBUTING.md.";
CM_ SG_ 2147548585 Wireless_Communications_Message_ "Generic 8-byte raw payload. Detail page: https://www.isobus.net/isobus/pGNAndSPN/15208?type=PGN. Signal-level enrichment via PR welcome  see CONTRIBUTING.md.";
CM_ SG_ 2147548586 Engine_Fluid_Level_Pressure_4_Ra "Generic 8-byte raw payload. Detail page: https://www.isobus.net/isobus/pGNAndSPN/15215?type=PGN. Signal-level enrichment via PR welcome  see CONTRIBUTING.md.";
CM_ SG_ 2147548587 Request_For_Complete_Configurabl "Generic 8-byte raw payload. Detail page: https://www.isobus.net/isobus/pGNAndSPN/15216?type=PGN. Signal-level enrichment via PR welcome  see CONTRIBUTING.md.";
CM_ SG_ 2147548588 Engine_Fuel_Information_RawPaylo "Generic 8-byte raw payload. Detail page: https://www.isobus.net/isobus/pGNAndSPN/15218?type=PGN. Signal-level enrichment via PR welcome  see CONTRIBUTING.md.";
CM_ SG_ 2147548589 Request_For_Complete_Configurabl "Generic 8-byte raw payload. Detail page: https://www.isobus.net/isobus/pGNAndSPN/15220?type=PGN. Signal-level enrichment via PR welcome  see CONTRIBUTING.md.";
CM_ SG_ 2147548590 Fifth_Wheel_Smart_Systems_2_RawP "Generic 8-byte raw payload. Detail page: https://www.isobus.net/isobus/pGNAndSPN/15225?type=PGN. Signal-level enrichment via PR welcome  see CONTRIBUTING.md.";
CM_ SG_ 2147548591 Aftertreatment_2_Intermediate_Ga "Generic 8-byte raw payload. Detail page: https://www.isobus.net/isobus/pGNAndSPN/15231?type=PGN. Signal-level enrichment via PR welcome  see CONTRIBUTING.md.";
CM_ SG_ 2147548592 Aftertreatment_2_Outlet_Gas_2_Ra "Generic 8-byte raw payload. Detail page: https://www.isobus.net/isobus/pGNAndSPN/15236?type=PGN. Signal-level enrichment via PR welcome  see CONTRIBUTING.md.";
CM_ SG_ 2147548593 Aftertreatment_2_Intake_Gas_2_Ra "Generic 8-byte raw payload. Detail page: https://www.isobus.net/isobus/pGNAndSPN/15241?type=PGN. Signal-level enrichment via PR welcome  see CONTRIBUTING.md.";
CM_ SG_ 2147548594 Aftertreatment_1_Intermediate_Ga "Generic 8-byte raw payload. Detail page: https://www.isobus.net/isobus/pGNAndSPN/15247?type=PGN. Signal-level enrichment via PR welcome  see CONTRIBUTING.md.";
CM_ SG_ 2147548595 Aftertreatment_1_Outlet_Gas_2_Ra "Generic 8-byte raw payload. Detail page: https://www.isobus.net/isobus/pGNAndSPN/15252?type=PGN. Signal-level enrichment via PR welcome  see CONTRIBUTING.md.";
CM_ SG_ 2147548596 Aftertreatment_1_Intake_Gas_2_Ra "Generic 8-byte raw payload. Detail page: https://www.isobus.net/isobus/pGNAndSPN/15257?type=PGN. Signal-level enrichment via PR welcome  see CONTRIBUTING.md.";
CM_ SG_ 2147548597 Emission_Related_Previously_MIL_ "Generic 8-byte raw payload. Detail page: https://www.isobus.net/isobus/pGNAndSPN/15269?type=PGN. Signal-level enrichment via PR welcome  see CONTRIBUTING.md.";
CM_ SG_ 2147548598 SPN_Support_RawPayload "Generic 8-byte raw payload. Detail page: https://www.isobus.net/isobus/pGNAndSPN/15275?type=PGN. Signal-level enrichment via PR welcome  see CONTRIBUTING.md.";
CM_ SG_ 2147548599 Expanded_Freeze_Frame_RawPayload "Generic 8-byte raw payload. Detail page: https://www.isobus.net/isobus/pGNAndSPN/15281?type=PGN. Signal-level enrichment via PR welcome  see CONTRIBUTING.md.";
CM_ SG_ 2147548600 Diagnostic_Readiness_3_RawPayloa "Generic 8-byte raw payload. Detail page: https://www.isobus.net/isobus/pGNAndSPN/15286?type=PGN. Signal-level enrichment via PR welcome  see CONTRIBUTING.md.";
CM_ SG_ 2147548601 Tire_Pressure_Reference_Informat "Generic 8-byte raw payload. Detail page: https://www.isobus.net/isobus/pGNAndSPN/15288?type=PGN. Signal-level enrichment via PR welcome  see CONTRIBUTING.md.";
CM_ SG_ 2147548602 Farebox_Status_RawPayload "Generic 8-byte raw payload. Detail page: https://www.isobus.net/isobus/pGNAndSPN/15290?type=PGN. Signal-level enrichment via PR welcome  see CONTRIBUTING.md.";
CM_ SG_ 2147548603 Farebox_Point_of_Sale_RawPayload "Generic 8-byte raw payload. Detail page: https://www.isobus.net/isobus/pGNAndSPN/15301?type=PGN. Signal-level enrichment via PR welcome  see CONTRIBUTING.md.";
CM_ SG_ 2147548604 Farebox_Service_Detail_RawPayloa "Generic 8-byte raw payload. Detail page: https://www.isobus.net/isobus/pGNAndSPN/15311?type=PGN. Signal-level enrichment via PR welcome  see CONTRIBUTING.md.";
CM_ SG_ 2147548605 Signal_Preemption_RawPayload "Generic 8-byte raw payload. Detail page: https://www.isobus.net/isobus/pGNAndSPN/15318?type=PGN. Signal-level enrichment via PR welcome  see CONTRIBUTING.md.";
CM_ SG_ 2147548606 Transit_Route_RawPayload "Generic 8-byte raw payload. Detail page: https://www.isobus.net/isobus/pGNAndSPN/15325?type=PGN. Signal-level enrichment via PR welcome  see CONTRIBUTING.md.";
CM_ SG_ 2147548607 Transit_Milepost_RawPayload "Generic 8-byte raw payload. Detail page: https://www.isobus.net/isobus/pGNAndSPN/15327?type=PGN. Signal-level enrichment via PR welcome  see CONTRIBUTING.md.";
CM_ SG_ 2147548608 Passenger_Counter_RawPayload "Generic 8-byte raw payload. Detail page: https://www.isobus.net/isobus/pGNAndSPN/15332?type=PGN. Signal-level enrichment via PR welcome  see CONTRIBUTING.md.";
CM_ SG_ 2147548609 Engine_Fluid_Level_Pressure_3_Ra "Generic 8-byte raw payload. Detail page: https://www.isobus.net/isobus/pGNAndSPN/15337?type=PGN. Signal-level enrichment via PR welcome  see CONTRIBUTING.md.";
CM_ SG_ 2147548610 Electronic_Engine_Controller_14_ "Generic 8-byte raw payload. Detail page: https://www.isobus.net/isobus/pGNAndSPN/15342?type=PGN. Signal-level enrichment via PR welcome  see CONTRIBUTING.md.";
CM_ SG_ 2147548611 Electronic_Engine_Controller_15_ "Generic 8-byte raw payload. Detail page: https://www.isobus.net/isobus/pGNAndSPN/15347?type=PGN. Signal-level enrichment via PR welcome  see CONTRIBUTING.md.";
CM_ SG_ 2147548612 Electronic_Brake_Controller_5_Ra "Generic 8-byte raw payload. Detail page: https://www.isobus.net/isobus/pGNAndSPN/15360?type=PGN. Signal-level enrichment via PR welcome  see CONTRIBUTING.md.";
CM_ SG_ 2147548614 Cold_Start_Aids_RawPayload "Generic 8-byte raw payload. Detail page: https://www.isobus.net/isobus/pGNAndSPN/15373?type=PGN. Signal-level enrichment via PR welcome  see CONTRIBUTING.md.";
CM_ SG_ 2147548615 Off_Highway_Engine_Control_Selec "Generic 8-byte raw payload. Detail page: https://www.isobus.net/isobus/pGNAndSPN/15383?type=PGN. Signal-level enrichment via PR welcome  see CONTRIBUTING.md.";
CM_ SG_ 2147548616 Operator_Primary_Intermediate_Sp "Generic 8-byte raw payload. Detail page: https://www.isobus.net/isobus/pGNAndSPN/15384?type=PGN. Signal-level enrichment via PR welcome  see CONTRIBUTING.md.";
CM_ SG_ 2147548617 Electronic_Control_Module_Inform "Generic 8-byte raw payload. Detail page: https://www.isobus.net/isobus/pGNAndSPN/15385?type=PGN. Signal-level enrichment via PR welcome  see CONTRIBUTING.md.";
CM_ SG_ 2147548618 Intermediate_Speed_Control_RawPa "Generic 8-byte raw payload. Detail page: https://www.isobus.net/isobus/pGNAndSPN/15386?type=PGN. Signal-level enrichment via PR welcome  see CONTRIBUTING.md.";
CM_ SG_ 2147548619 Off_Highway_Engine_Control_Selec "Generic 8-byte raw payload. Detail page: https://www.isobus.net/isobus/pGNAndSPN/15396?type=PGN. Signal-level enrichment via PR welcome  see CONTRIBUTING.md.";
CM_ SG_ 2147548620 Operators_External_Light_Control "Generic 8-byte raw payload. Detail page: https://www.isobus.net/isobus/pGNAndSPN/15407?type=PGN. Signal-level enrichment via PR welcome  see CONTRIBUTING.md.";
CM_ SG_ 2147548621 Operator_Wiper_and_Washer_Contro "Generic 8-byte raw payload. Detail page: https://www.isobus.net/isobus/pGNAndSPN/15416?type=PGN. Signal-level enrichment via PR welcome  see CONTRIBUTING.md.";
CM_ SG_ 2147548622 Working_Set_Member_Message_Obsol "Generic 8-byte raw payload. Detail page: https://www.isobus.net/isobus/pGNAndSPN/15417?type=PGN. Signal-level enrichment via PR welcome  see CONTRIBUTING.md.";
CM_ SG_ 2147548623 Working_Set_Master_Message_Obsol "Generic 8-byte raw payload. Detail page: https://www.isobus.net/isobus/pGNAndSPN/15418?type=PGN. Signal-level enrichment via PR welcome  see CONTRIBUTING.md.";
CM_ SG_ 2147548624 Intake_Exhaust_Conditions_2_RawP "Generic 8-byte raw payload. Detail page: https://www.isobus.net/isobus/pGNAndSPN/15425?type=PGN. Signal-level enrichment via PR welcome  see CONTRIBUTING.md.";
CM_ SG_ 2147548625 FMS_standard_Interface_Identity_ "Generic 8-byte raw payload. Detail page: https://www.isobus.net/isobus/pGNAndSPN/15428?type=PGN. Signal-level enrichment via PR welcome  see CONTRIBUTING.md.";
CM_ SG_ 2147548626 ECU_Performance_RawPayload "Generic 8-byte raw payload. Detail page: https://www.isobus.net/isobus/pGNAndSPN/15430?type=PGN. Signal-level enrichment via PR welcome  see CONTRIBUTING.md.";
CM_ SG_ 2147548627 Turbocharger_Information_6_RawPa "Generic 8-byte raw payload. Detail page: https://www.isobus.net/isobus/pGNAndSPN/15434?type=PGN. Signal-level enrichment via PR welcome  see CONTRIBUTING.md.";
CM_ SG_ 2147548628 Cab_Message_3_RawPayload "Generic 8-byte raw payload. Detail page: https://www.isobus.net/isobus/pGNAndSPN/15452?type=PGN. Signal-level enrichment via PR welcome  see CONTRIBUTING.md.";
CM_ SG_ 2147548629 Electronic_Engine_Controller_5_R "Generic 8-byte raw payload. Detail page: https://www.isobus.net/isobus/pGNAndSPN/15459?type=PGN. Signal-level enrichment via PR welcome  see CONTRIBUTING.md.";
CM_ SG_ 2147548630 Basic_Joystick_Message_1_RawPayl "Generic 8-byte raw payload. Detail page: https://www.isobus.net/isobus/pGNAndSPN/15481?type=PGN. Signal-level enrichment via PR welcome  see CONTRIBUTING.md.";
CM_ SG_ 2147548631 Extended_Joystick_Message_1_RawP "Generic 8-byte raw payload. Detail page: https://www.isobus.net/isobus/pGNAndSPN/15500?type=PGN. Signal-level enrichment via PR welcome  see CONTRIBUTING.md.";
CM_ SG_ 2147548632 Basic_Joystick_Message_2_RawPayl "Generic 8-byte raw payload. Detail page: https://www.isobus.net/isobus/pGNAndSPN/15522?type=PGN. Signal-level enrichment via PR welcome  see CONTRIBUTING.md.";
CM_ SG_ 2147548633 Extended_Joystick_Message_2_RawP "Generic 8-byte raw payload. Detail page: https://www.isobus.net/isobus/pGNAndSPN/15541?type=PGN. Signal-level enrichment via PR welcome  see CONTRIBUTING.md.";
CM_ SG_ 2147548634 Basic_Joystick_Message_3_RawPayl "Generic 8-byte raw payload. Detail page: https://www.isobus.net/isobus/pGNAndSPN/15563?type=PGN. Signal-level enrichment via PR welcome  see CONTRIBUTING.md.";
CM_ SG_ 2147548635 Extended_Joystick_Message_3_RawP "Generic 8-byte raw payload. Detail page: https://www.isobus.net/isobus/pGNAndSPN/15582?type=PGN. Signal-level enrichment via PR welcome  see CONTRIBUTING.md.";
CM_ SG_ 2147548636 Marine_Control_Information_RawPa "Generic 8-byte raw payload. Detail page: https://www.isobus.net/isobus/pGNAndSPN/15586?type=PGN. Signal-level enrichment via PR welcome  see CONTRIBUTING.md.";
CM_ SG_ 2147548637 Military_Application_Message_1_1 "Generic 8-byte raw payload. Detail page: https://www.isobus.net/isobus/pGNAndSPN/15587?type=PGN. Signal-level enrichment via PR welcome  see CONTRIBUTING.md.";
CM_ SG_ 2147548638 Military_Application_Message_2_1 "Generic 8-byte raw payload. Detail page: https://www.isobus.net/isobus/pGNAndSPN/15588?type=PGN. Signal-level enrichment via PR welcome  see CONTRIBUTING.md.";
CM_ SG_ 2147548639 Front_Wheel_Drive_Status_RawPayl "Generic 8-byte raw payload. Detail page: https://www.isobus.net/isobus/pGNAndSPN/15589?type=PGN. Signal-level enrichment via PR welcome  see CONTRIBUTING.md.";
CM_ SG_ 2147548640 Ambient_Conditions_2_RawPayload "Generic 8-byte raw payload. Detail page: https://www.isobus.net/isobus/pGNAndSPN/15594?type=PGN. Signal-level enrichment via PR welcome  see CONTRIBUTING.md.";
CM_ SG_ 2147548641 Cab_Climate_System_Information_1 "Generic 8-byte raw payload. Detail page: https://www.isobus.net/isobus/pGNAndSPN/15603?type=PGN. Signal-level enrichment via PR welcome  see CONTRIBUTING.md.";
CM_ SG_ 2147548642 Supply_Pressure_Demand_RawPayloa "Generic 8-byte raw payload. Detail page: https://www.isobus.net/isobus/pGNAndSPN/15610?type=PGN. Signal-level enrichment via PR welcome  see CONTRIBUTING.md.";
CM_ SG_ 2147548643 Equipment_Operation_and_Control_ "Generic 8-byte raw payload. Detail page: https://www.isobus.net/isobus/pGNAndSPN/15611?type=PGN. Signal-level enrichment via PR welcome  see CONTRIBUTING.md.";
CM_ SG_ 2147548644 Equipment_Performance_Data_RawPa "Generic 8-byte raw payload. Detail page: https://www.isobus.net/isobus/pGNAndSPN/15616?type=PGN. Signal-level enrichment via PR welcome  see CONTRIBUTING.md.";
CM_ SG_ 2147548645 Maximum_Vehicle_Speed_Limit_Stat "Generic 8-byte raw payload. Detail page: https://www.isobus.net/isobus/pGNAndSPN/15624?type=PGN. Signal-level enrichment via PR welcome  see CONTRIBUTING.md.";
CM_ SG_ 2147548646 Hydraulic_Braking_System_RawPayl "Generic 8-byte raw payload. Detail page: https://www.isobus.net/isobus/pGNAndSPN/15632?type=PGN. Signal-level enrichment via PR welcome  see CONTRIBUTING.md.";
CM_ SG_ 2147548647 Bus_1_Utility_Sync_Check_Status_ "Generic 8-byte raw payload. Detail page: https://www.isobus.net/isobus/pGNAndSPN/15638?type=PGN. Signal-level enrichment via PR welcome  see CONTRIBUTING.md.";
CM_ SG_ 2147548648 Bus_1_Generator_Sync_Check_Statu "Generic 8-byte raw payload. Detail page: https://www.isobus.net/isobus/pGNAndSPN/15644?type=PGN. Signal-level enrichment via PR welcome  see CONTRIBUTING.md.";
CM_ SG_ 2147548649 Bus_1_Phase_C_Basic_AC_Quantitie "Generic 8-byte raw payload. Detail page: https://www.isobus.net/isobus/pGNAndSPN/15647?type=PGN. Signal-level enrichment via PR welcome  see CONTRIBUTING.md.";
CM_ SG_ 2147548650 Bus_1_Phase_B_Basic_AC_Quantitie "Generic 8-byte raw payload. Detail page: https://www.isobus.net/isobus/pGNAndSPN/15650?type=PGN. Signal-level enrichment via PR welcome  see CONTRIBUTING.md.";
CM_ SG_ 2147548651 Bus_1_Phase_A_Basic_AC_Quantitie "Generic 8-byte raw payload. Detail page: https://www.isobus.net/isobus/pGNAndSPN/15653?type=PGN. Signal-level enrichment via PR welcome  see CONTRIBUTING.md.";
CM_ SG_ 2147548652 Bus_1_Average_Basic_AC_Quantitie "Generic 8-byte raw payload. Detail page: https://www.isobus.net/isobus/pGNAndSPN/15656?type=PGN. Signal-level enrichment via PR welcome  see CONTRIBUTING.md.";
CM_ SG_ 2147548653 Utility_Total_AC_Energy_RawPaylo "Generic 8-byte raw payload. Detail page: https://www.isobus.net/isobus/pGNAndSPN/15658?type=PGN. Signal-level enrichment via PR welcome  see CONTRIBUTING.md.";
CM_ SG_ 2147548654 Utility_Phase_C_AC_Reactive_Powe "Generic 8-byte raw payload. Detail page: https://www.isobus.net/isobus/pGNAndSPN/15661?type=PGN. Signal-level enrichment via PR welcome  see CONTRIBUTING.md.";
CM_ SG_ 2147548655 Utility_Phase_C_AC_Power_RawPayl "Generic 8-byte raw payload. Detail page: https://www.isobus.net/isobus/pGNAndSPN/15663?type=PGN. Signal-level enrichment via PR welcome  see CONTRIBUTING.md.";
CM_ SG_ 2147548656 Utility_Phase_C_AC_Basic_Quantit "Generic 8-byte raw payload. Detail page: https://www.isobus.net/isobus/pGNAndSPN/15667?type=PGN. Signal-level enrichment via PR welcome  see CONTRIBUTING.md.";
CM_ SG_ 2147548657 Utility_Phase_B_AC_Reactive_Powe "Generic 8-byte raw payload. Detail page: https://www.isobus.net/isobus/pGNAndSPN/15670?type=PGN. Signal-level enrichment via PR welcome  see CONTRIBUTING.md.";
CM_ SG_ 2147548658 Utility_Phase_B_AC_Power_RawPayl "Generic 8-byte raw payload. Detail page: https://www.isobus.net/isobus/pGNAndSPN/15672?type=PGN. Signal-level enrichment via PR welcome  see CONTRIBUTING.md.";
CM_ SG_ 2147548659 Utility_Phase_B_AC_Basic_Quantit "Generic 8-byte raw payload. Detail page: https://www.isobus.net/isobus/pGNAndSPN/15676?type=PGN. Signal-level enrichment via PR welcome  see CONTRIBUTING.md.";
CM_ SG_ 2147548660 Utility_Phase_A_AC_Reactive_Powe "Generic 8-byte raw payload. Detail page: https://www.isobus.net/isobus/pGNAndSPN/15679?type=PGN. Signal-level enrichment via PR welcome  see CONTRIBUTING.md.";
CM_ SG_ 2147548661 Utility_Phase_A_AC_Power_RawPayl "Generic 8-byte raw payload. Detail page: https://www.isobus.net/isobus/pGNAndSPN/15681?type=PGN. Signal-level enrichment via PR welcome  see CONTRIBUTING.md.";
CM_ SG_ 2147548662 Utility_Phase_A_Basic_AC_Quantit "Generic 8-byte raw payload. Detail page: https://www.isobus.net/isobus/pGNAndSPN/15685?type=PGN. Signal-level enrichment via PR welcome  see CONTRIBUTING.md.";
CM_ SG_ 2147548663 Utility_Total_AC_Reactive_Power_ "Generic 8-byte raw payload. Detail page: https://www.isobus.net/isobus/pGNAndSPN/15688?type=PGN. Signal-level enrichment via PR welcome  see CONTRIBUTING.md.";
CM_ SG_ 2147548664 Utility_Total_AC_Power_RawPayloa "Generic 8-byte raw payload. Detail page: https://www.isobus.net/isobus/pGNAndSPN/15690?type=PGN. Signal-level enrichment via PR welcome  see CONTRIBUTING.md.";
CM_ SG_ 2147548665 Utility_Average_Basic_AC_Quantit "Generic 8-byte raw payload. Detail page: https://www.isobus.net/isobus/pGNAndSPN/15694?type=PGN. Signal-level enrichment via PR welcome  see CONTRIBUTING.md.";
CM_ SG_ 2147548666 Generator_Total_AC_Energy_RawPay "Generic 8-byte raw payload. Detail page: https://www.isobus.net/isobus/pGNAndSPN/15696?type=PGN. Signal-level enrichment via PR welcome  see CONTRIBUTING.md.";
CM_ SG_ 2147548667 Generator_Phase_C_AC_Reactive_Po "Generic 8-byte raw payload. Detail page: https://www.isobus.net/isobus/pGNAndSPN/15699?type=PGN. Signal-level enrichment via PR welcome  see CONTRIBUTING.md.";
CM_ SG_ 2147548668 Generator_Phase_C_AC_Power_RawPa "Generic 8-byte raw payload. Detail page: https://www.isobus.net/isobus/pGNAndSPN/15701?type=PGN. Signal-level enrichment via PR welcome  see CONTRIBUTING.md.";
CM_ SG_ 2147548669 Generator_Phase_C_Basic_AC_Quant "Generic 8-byte raw payload. Detail page: https://www.isobus.net/isobus/pGNAndSPN/15705?type=PGN. Signal-level enrichment via PR welcome  see CONTRIBUTING.md.";
CM_ SG_ 2147548670 Generator_Phase_B_AC_Reactive_Po "Generic 8-byte raw payload. Detail page: https://www.isobus.net/isobus/pGNAndSPN/15708?type=PGN. Signal-level enrichment via PR welcome  see CONTRIBUTING.md.";
CM_ SG_ 2147548671 Generator_Phase_B_AC_Power_RawPa "Generic 8-byte raw payload. Detail page: https://www.isobus.net/isobus/pGNAndSPN/15710?type=PGN. Signal-level enrichment via PR welcome  see CONTRIBUTING.md.";
CM_ SG_ 2147548672 Generator_Phase_B_Basic_AC_Quant "Generic 8-byte raw payload. Detail page: https://www.isobus.net/isobus/pGNAndSPN/15714?type=PGN. Signal-level enrichment via PR welcome  see CONTRIBUTING.md.";
CM_ SG_ 2147548673 Generator_Phase_A_AC_Reactive_Po "Generic 8-byte raw payload. Detail page: https://www.isobus.net/isobus/pGNAndSPN/15717?type=PGN. Signal-level enrichment via PR welcome  see CONTRIBUTING.md.";
CM_ SG_ 2147548674 Generator_Phase_A_AC_Power_RawPa "Generic 8-byte raw payload. Detail page: https://www.isobus.net/isobus/pGNAndSPN/15719?type=PGN. Signal-level enrichment via PR welcome  see CONTRIBUTING.md.";
CM_ SG_ 2147548675 Generator_Phase_A_Basic_AC_Quant "Generic 8-byte raw payload. Detail page: https://www.isobus.net/isobus/pGNAndSPN/15723?type=PGN. Signal-level enrichment via PR welcome  see CONTRIBUTING.md.";
CM_ SG_ 2147548676 Generator_Total_AC_Reactive_Powe "Generic 8-byte raw payload. Detail page: https://www.isobus.net/isobus/pGNAndSPN/15726?type=PGN. Signal-level enrichment via PR welcome  see CONTRIBUTING.md.";
CM_ SG_ 2147548677 Generator_Total_AC_Power_RawPayl "Generic 8-byte raw payload. Detail page: https://www.isobus.net/isobus/pGNAndSPN/15728?type=PGN. Signal-level enrichment via PR welcome  see CONTRIBUTING.md.";
CM_ SG_ 2147548678 Generator_Average_Basic_AC_Quant "Generic 8-byte raw payload. Detail page: https://www.isobus.net/isobus/pGNAndSPN/15732?type=PGN. Signal-level enrichment via PR welcome  see CONTRIBUTING.md.";
CM_ SG_ 2147548679 Exhaust_Temperature_RawPayload "Generic 8-byte raw payload. Detail page: https://www.isobus.net/isobus/pGNAndSPN/15736?type=PGN. Signal-level enrichment via PR welcome  see CONTRIBUTING.md.";
CM_ SG_ 2147548680 Required_Tractor_Facilities_mess "Generic 8-byte raw payload. Detail page: https://www.isobus.net/isobus/pGNAndSPN/15782?type=PGN. Signal-level enrichment via PR welcome  see CONTRIBUTING.md.";
CM_ SG_ 2147548681 Tractor_Facilities_response_mess "Generic 8-byte raw payload. Detail page: https://www.isobus.net/isobus/pGNAndSPN/15828?type=PGN. Signal-level enrichment via PR welcome  see CONTRIBUTING.md.";
CM_ SG_ 2147548682 Tractor_control_command_tractor_ "Generic 8-byte raw payload. Detail page: https://www.isobus.net/isobus/pGNAndSPN/15829?type=PGN. Signal-level enrichment via PR welcome  see CONTRIBUTING.md.";

BA_DEF_ BO_ "SystemMessageLongSymbol" STRING;
BA_DEF_ SG_ "SystemSignalLongSymbol" STRING;
BA_ "SystemMessageLongSymbol" BO_ 2147548394 "VDMA_FCEA_Vehicle_Electrical_Power_4_obsol";
BA_ "SystemMessageLongSymbol" BO_ 2147548395 "VDMA_FCEB_Aftertreatment_2_NOx_Adsorber_In";
BA_ "SystemMessageLongSymbol" BO_ 2147548396 "VDMA_FCEC_Aftertreatment_1_NOx_Adsorber_In";
BA_ "SystemMessageLongSymbol" BO_ 2147548397 "VDMA_FCED_Aftertreatment_2_Warm_Up_Diesel_";
BA_ "SystemMessageLongSymbol" BO_ 2147548398 "VDMA_FCEE_Land_Leveling_System_Reference_E";
BA_ "SystemMessageLongSymbol" BO_ 2147548399 "VDMA_FCEF_Engine_Fluid_Level_Pressure_11";
BA_ "SystemMessageLongSymbol" BO_ 2147548400 "VDMA_FCF0_Engine_Fuel_Lube_x000D_Systems_2";
BA_ "SystemMessageLongSymbol" BO_ 2147548401 "VDMA_FCF1_Engine_Turbocharger_Wastegate_Ac";
BA_ "SystemMessageLongSymbol" BO_ 2147548402 "VDMA_FCF2_Engine_Fuel_Throttle_Valve_Infor";
BA_ "SystemMessageLongSymbol" BO_ 2147548403 "VDMA_FCF3_Engine_Turbocharger_Compressor_B";
BA_ "SystemMessageLongSymbol" BO_ 2147548405 "VDMA_FCF5_Charge_Air_Cooler_2_Precooler";
BA_ "SystemMessageLongSymbol" BO_ 2147548407 "VDMA_FCF7_Charge_Air_Cooler_1_Precooler";
BA_ "SystemMessageLongSymbol" BO_ 2147548408 "VDMA_FCF8_Diesel_Particulate_Filter_2_Soot";
BA_ "SystemMessageLongSymbol" BO_ 2147548409 "VDMA_FCF9_Diesel_Particulate_Filter_1_Soot";
BA_ "SystemMessageLongSymbol" BO_ 2147548410 "VDMA_FCFA_Electronic_Engine_Controller_11";
BA_ "SystemMessageLongSymbol" BO_ 2147548411 "VDMA_FCFB_Engine_Manifold_Actuator_Positio";
BA_ "SystemMessageLongSymbol" BO_ 2147548412 "VDMA_FCFC_Engine_Manifold_Actuator_Control";
BA_ "SystemMessageLongSymbol" BO_ 2147548413 "VDMA_FCFD_Electronic_Engine_Controller_9";
BA_ "SystemMessageLongSymbol" BO_ 2147548414 "VDMA_FCFE_Electronic_Engine_Controller_10";
BA_ "SystemMessageLongSymbol" BO_ 2147548416 "VDMA_FD00_Engine_Fluid_Level_Pressure_10";
BA_ "SystemMessageLongSymbol" BO_ 2147548417 "VDMA_FD01_Low_Voltage_Disconnect_Status";
BA_ "SystemMessageLongSymbol" BO_ 2147548419 "VDMA_FD03_Implement_Operating_state_comman";
BA_ "SystemMessageLongSymbol" BO_ 2147548420 "VDMA_FD04_Direct_Lamp_Control_Data_2";
BA_ "SystemMessageLongSymbol" BO_ 2147548421 "VDMA_FD05_Direct_Lamp_Control_Data_1";
BA_ "SystemMessageLongSymbol" BO_ 2147548422 "VDMA_FD06_Direct_Lamp_Control_Command_2";
BA_ "SystemMessageLongSymbol" BO_ 2147548423 "VDMA_FD07_Direct_Lamp_Control_Command_1";
BA_ "SystemMessageLongSymbol" BO_ 2147548425 "VDMA_FD09_High_Resolution_Fuel_Consumption";
BA_ "SystemMessageLongSymbol" BO_ 2147548426 "VDMA_FD0A_Aftertreatment_2_Outlet_Gas_NOx_";
BA_ "SystemMessageLongSymbol" BO_ 2147548427 "VDMA_FD0B_Aftertreatment_2_Outlet_Gas_NOx_";
BA_ "SystemMessageLongSymbol" BO_ 2147548428 "VDMA_FD0C_Aftertreatment_2_Intake_Gas_NOx_";
BA_ "SystemMessageLongSymbol" BO_ 2147548429 "VDMA_FD0D_Aftertreatment_2_Intake_Gas_NOx_";
BA_ "SystemMessageLongSymbol" BO_ 2147548430 "VDMA_FD0E_Aftertreatment_1_Outlet_Gas_NOx_";
BA_ "SystemMessageLongSymbol" BO_ 2147548431 "VDMA_FD0F_Aftertreatment_1_Outlet_Gas_NOx_";
BA_ "SystemMessageLongSymbol" BO_ 2147548432 "VDMA_FD10_Aftertreatment_1_Intake_Gas_NOx_";
BA_ "SystemMessageLongSymbol" BO_ 2147548433 "VDMA_FD11_Aftertreatment_1_Intake_Gas_NOx_";
BA_ "SystemMessageLongSymbol" BO_ 2147548434 "VDMA_FD12_Magnet_Status_Information_1";
BA_ "SystemMessageLongSymbol" BO_ 2147548435 "VDMA_FD13_Magnet_System_Configuration_Info";
BA_ "SystemMessageLongSymbol" BO_ 2147548438 "VDMA_FD16_Occupant_Classification_System_I";
BA_ "SystemMessageLongSymbol" BO_ 2147548439 "VDMA_FD17_Beltlock_and_Airbag_Deactivation";
BA_ "SystemMessageLongSymbol" BO_ 2147548440 "VDMA_FD18_Collision_Sensor_Information";
BA_ "SystemMessageLongSymbol" BO_ 2147548441 "VDMA_FD19_Ignitor_Loop_Information";
BA_ "SystemMessageLongSymbol" BO_ 2147548442 "VDMA_FD1A_Aftertreatment_1_Warm_Up_Diesel_";
BA_ "SystemMessageLongSymbol" BO_ 2147548443 "VDMA_FD1B_Diesel_Particulate_Filter_2_Soot";
BA_ "SystemMessageLongSymbol" BO_ 2147548444 "VDMA_FD1C_Diesel_Particulate_Filter_1_Soot";
BA_ "SystemMessageLongSymbol" BO_ 2147548445 "VDMA_FD1D_Aftertreatment_Differential_Temp";
BA_ "SystemMessageLongSymbol" BO_ 2147548446 "VDMA_FD1E_Aftertreatment_Differential_Temp";
BA_ "SystemMessageLongSymbol" BO_ 2147548447 "VDMA_FD1F_Aftertreatment_2_Diesel_Oxidatio";
BA_ "SystemMessageLongSymbol" BO_ 2147548448 "VDMA_FD20_Aftertreatment_1_Diesel_Oxidatio";
BA_ "SystemMessageLongSymbol" BO_ 2147548449 "VDMA_FD21_Aftertreatment_2_Gas_Oxidation_C";
BA_ "SystemMessageLongSymbol" BO_ 2147548450 "VDMA_FD22_Aftertreatment_1_Gas_Oxidation_C";
BA_ "SystemMessageLongSymbol" BO_ 2147548451 "VDMA_FD23_Extended_Joystick_Message_10";
BA_ "SystemMessageLongSymbol" BO_ 2147548452 "VDMA_FD24_Basic_Joystick_Message_10";
BA_ "SystemMessageLongSymbol" BO_ 2147548453 "VDMA_FD25_Extended_Joystick_Message_9";
BA_ "SystemMessageLongSymbol" BO_ 2147548454 "VDMA_FD26_Basic_Joystick_Message_9";
BA_ "SystemMessageLongSymbol" BO_ 2147548455 "VDMA_FD27_Extended_Joystick_Message_8";
BA_ "SystemMessageLongSymbol" BO_ 2147548456 "VDMA_FD28_Basic_Joystick_Message_8";
BA_ "SystemMessageLongSymbol" BO_ 2147548457 "VDMA_FD29_Extended_Joystick_Message_7";
BA_ "SystemMessageLongSymbol" BO_ 2147548458 "VDMA_FD2A_Basic_Joystick_Message_7";
BA_ "SystemMessageLongSymbol" BO_ 2147548459 "VDMA_FD2B_Extended_Joystick_Message_6";
BA_ "SystemMessageLongSymbol" BO_ 2147548460 "VDMA_FD2C_Basic_Joystick_Message_6";
BA_ "SystemMessageLongSymbol" BO_ 2147548461 "VDMA_FD2D_Extended_Joystick_Message_5";
BA_ "SystemMessageLongSymbol" BO_ 2147548462 "VDMA_FD2E_Basic_Joystick_Message_5";
BA_ "SystemMessageLongSymbol" BO_ 2147548463 "VDMA_FD2F_Extended_Joystick_Message_4";
BA_ "SystemMessageLongSymbol" BO_ 2147548464 "VDMA_FD30_Basic_Joystick_Message_4";
BA_ "SystemMessageLongSymbol" BO_ 2147548467 "VDMA_FD33_Aftertreatment_2_Diesel_Exhaust_";
BA_ "SystemMessageLongSymbol" BO_ 2147548468 "VDMA_FD34_Aftertreatment_2_SCR_Reagant_Tan";
BA_ "SystemMessageLongSymbol" BO_ 2147548469 "VDMA_FD35_Aftertreatment_2_Diesel_Exhaust_";
BA_ "SystemMessageLongSymbol" BO_ 2147548470 "VDMA_FD36_Aftertreatment_2_Diesel_Exhaust_";
BA_ "SystemMessageLongSymbol" BO_ 2147548471 "VDMA_FD37_Aftertreatment_2_SCR_Service_Inf";
BA_ "SystemMessageLongSymbol" BO_ 2147548472 "VDMA_FD38_Aftertreatment_2_SCR_Exhaust_Gas";
BA_ "SystemMessageLongSymbol" BO_ 2147548473 "VDMA_FD39_Aftertreatment_2_SCR_Exhaust_Gas";
BA_ "SystemMessageLongSymbol" BO_ 2147548474 "VDMA_FD3A_Aftertreatment_2_SCR_Dosing_Syst";
BA_ "SystemMessageLongSymbol" BO_ 2147548475 "VDMA_FD3B_Aftertreatment_2_SCR_Dosing_Syst";
BA_ "SystemMessageLongSymbol" BO_ 2147548476 "VDMA_FD3C_Aftertreatment_1_Diesel_Exhaust_";
BA_ "SystemMessageLongSymbol" BO_ 2147548477 "VDMA_FD3D_Aftertreatment_1_SCR_Reagant_Tan";
BA_ "SystemMessageLongSymbol" BO_ 2147548478 "VDMA_FD3E_Aftertreatment_1_SCR_Exhaust_Gas";
BA_ "SystemMessageLongSymbol" BO_ 2147548479 "VDMA_FD3F_Aftertreatment_1_SCR_Exhaust_Gas";
BA_ "SystemMessageLongSymbol" BO_ 2147548480 "VDMA_FD40_Aftertreatment_1_SCR_Dosing_Syst";
BA_ "SystemMessageLongSymbol" BO_ 2147548481 "VDMA_FD41_Aftertreatment_1_SCR_Dosing_Syst";
BA_ "SystemMessageLongSymbol" BO_ 2147548482 "VDMA_FD42_ISOBUS_compliance_certification";
BA_ "SystemMessageLongSymbol" BO_ 2147548484 "VDMA_FD44_Aftertreatment_2_Fuel_Control_2";
BA_ "SystemMessageLongSymbol" BO_ 2147548485 "VDMA_FD45_Aftertreatment_2_Three_Way_Catal";
BA_ "SystemMessageLongSymbol" BO_ 2147548486 "VDMA_FD46_Aftertreatment_1_Three_Way_Catal";
BA_ "SystemMessageLongSymbol" BO_ 2147548487 "VDMA_FD47_Transmission_Mode_Labels";
BA_ "SystemMessageLongSymbol" BO_ 2147548488 "VDMA_FD48_Engine_Exhaust_Bank_2_O2_Fuel_Tr";
BA_ "SystemMessageLongSymbol" BO_ 2147548489 "VDMA_FD49_Engine_Exhaust_Bank_1_O2_Fuel_Tr";
BA_ "SystemMessageLongSymbol" BO_ 2147548490 "VDMA_FD4A_General_Purpose_Message_2_11";
BA_ "SystemMessageLongSymbol" BO_ 2147548491 "VDMA_FD4B_General_Purpose_Message_2_10";
BA_ "SystemMessageLongSymbol" BO_ 2147548492 "VDMA_FD4C_General_Purpose_Message_2_9";
BA_ "SystemMessageLongSymbol" BO_ 2147548493 "VDMA_FD4D_General_Purpose_Message_2_8";
BA_ "SystemMessageLongSymbol" BO_ 2147548494 "VDMA_FD4E_General_Purpose_Message_2_7";
BA_ "SystemMessageLongSymbol" BO_ 2147548495 "VDMA_FD4F_General_Purpose_Message_2_6";
BA_ "SystemMessageLongSymbol" BO_ 2147548496 "VDMA_FD50_General_Purpose_Message_1_9";
BA_ "SystemMessageLongSymbol" BO_ 2147548497 "VDMA_FD51_Aftercooler_Coolant_Control_Valv";
BA_ "SystemMessageLongSymbol" BO_ 2147548498 "VDMA_FD52_Engine_Coolant_Control_Valve_Com";
BA_ "SystemMessageLongSymbol" BO_ 2147548499 "VDMA_FD53_Engine_Average_Information";
BA_ "SystemMessageLongSymbol" BO_ 2147548500 "VDMA_FD54_DTCs_C_Previously_Active";
BA_ "SystemMessageLongSymbol" BO_ 2147548501 "VDMA_FD55_DTCs_C_Confirmed_and_Active";
BA_ "SystemMessageLongSymbol" BO_ 2147548503 "VDMA_FD57_DTCs_B2_Previously_Active";
BA_ "SystemMessageLongSymbol" BO_ 2147548504 "VDMA_FD58_DTCs_B2_Confirmed_and_Active";
BA_ "SystemMessageLongSymbol" BO_ 2147548506 "VDMA_FD5A_DTCs_B1_Previously_Active";
BA_ "SystemMessageLongSymbol" BO_ 2147548507 "VDMA_FD5B_DTCs_B1_Confirmed_and_Active";
BA_ "SystemMessageLongSymbol" BO_ 2147548509 "VDMA_FD5D_DTCs_A_Previously_Active";
BA_ "SystemMessageLongSymbol" BO_ 2147548510 "VDMA_FD5E_DTCs_A_Confirmed_and_Active";
BA_ "SystemMessageLongSymbol" BO_ 2147548512 "VDMA_FD60_Harmonized_B1_Failure_Counts";
BA_ "SystemMessageLongSymbol" BO_ 2147548513 "VDMA_FD61_Harmonized_Cumulative_Continuous";
BA_ "SystemMessageLongSymbol" BO_ 2147548514 "VDMA_FD62_Harmonized_Global_Regulation_Des";
BA_ "SystemMessageLongSymbol" BO_ 2147548515 "VDMA_FD63_Harmonized_Roadworthiness_System";
BA_ "SystemMessageLongSymbol" BO_ 2147548516 "VDMA_FD64_Harmonized_Roadworthiness_Vehicl";
BA_ "SystemMessageLongSymbol" BO_ 2147548517 "VDMA_FD65_Aftertreatment_1_Fuel_Control_2";
BA_ "SystemMessageLongSymbol" BO_ 2147548519 "VDMA_FD67_Zero_Net_Vehicle_Weight_Change";
BA_ "SystemMessageLongSymbol" BO_ 2147548520 "VDMA_FD68_Gross_Combination_Vehicle_Weight";
BA_ "SystemMessageLongSymbol" BO_ 2147548521 "VDMA_FD69_Axle_Group_Calibration_Weights";
BA_ "SystemMessageLongSymbol" BO_ 2147548523 "VDMA_FD6B_Available_Axle_Group_Weights";
BA_ "SystemMessageLongSymbol" BO_ 2147548524 "VDMA_FD6C_Aftertreatment_2_Air_Control_2";
BA_ "SystemMessageLongSymbol" BO_ 2147548525 "VDMA_FD6D_Aftertreatment_1_Air_Control_2";
BA_ "SystemMessageLongSymbol" BO_ 2147548526 "VDMA_FD6E_Aftertreatment_1_SCR_Service_Inf";
BA_ "SystemMessageLongSymbol" BO_ 2147548527 "VDMA_FD6F_Electronic_Engine_Controller_8";
BA_ "SystemMessageLongSymbol" BO_ 2147548529 "VDMA_FD71_Brake_actuator_stroke_status";
BA_ "SystemMessageLongSymbol" BO_ 2147548536 "VDMA_FD78_Aftertreatment_2_Trip_Informatio";
BA_ "SystemMessageLongSymbol" BO_ 2147548537 "VDMA_FD79_Aftertreatment_1_Trip_Informatio";
BA_ "SystemMessageLongSymbol" BO_ 2147548538 "VDMA_FD7A_Aftertreatment_2_Service_1";
BA_ "SystemMessageLongSymbol" BO_ 2147548539 "VDMA_FD7B_Aftertreatment_1_Service_1";
BA_ "SystemMessageLongSymbol" BO_ 2147548540 "VDMA_FD7C_Diesel_Particulate_Filter_Contro";
BA_ "SystemMessageLongSymbol" BO_ 2147548541 "VDMA_FD7D_Reserved_for_FMS_Telltale_status";
BA_ "SystemMessageLongSymbol" BO_ 2147548542 "VDMA_FD7E_Adaptive_Front_Lighting_System_S";
BA_ "SystemMessageLongSymbol" BO_ 2147548544 "VDMA_FD80_Emission_Related_Permanent_Diagn";
BA_ "SystemMessageLongSymbol" BO_ 2147548547 "VDMA_FD83_Transfer_Case_Information";
BA_ "SystemMessageLongSymbol" BO_ 2147548548 "VDMA_FD84_Engine_Fluid_Level_Pressure_9";
BA_ "SystemMessageLongSymbol" BO_ 2147548549 "VDMA_FD85_Engine_Fluid_Level_Pressure_8";
BA_ "SystemMessageLongSymbol" BO_ 2147548550 "VDMA_FD86_Engine_Fluid_Level_Pressure_7";
BA_ "SystemMessageLongSymbol" BO_ 2147548551 "VDMA_FD87_Engine_Fluid_Level_Pressure_6";
BA_ "SystemMessageLongSymbol" BO_ 2147548552 "VDMA_FD88_Engine_Fluid_Level_Pressure_5";
BA_ "SystemMessageLongSymbol" BO_ 2147548553 "VDMA_FD89_Vehicle_Direction_Speed_2";
BA_ "SystemMessageLongSymbol" BO_ 2147548554 "VDMA_FD8A_SAE_J2012_2_Byte_DTC_Display";
BA_ "SystemMessageLongSymbol" BO_ 2147548555 "VDMA_FD8B_Aftertreatment_2_Gas_Parameters";
BA_ "SystemMessageLongSymbol" BO_ 2147548556 "VDMA_FD8C_Aftertreatment_1_Gas_Parameters";
BA_ "SystemMessageLongSymbol" BO_ 2147548557 "VDMA_FD8D_Utility_Total_AC_Reactive_Energy";
BA_ "SystemMessageLongSymbol" BO_ 2147548558 "VDMA_FD8E_Generator_Total_AC_Reactive_Ener";
BA_ "SystemMessageLongSymbol" BO_ 2147548559 "VDMA_FD8F_Generator_Total_AC_Percent_Power";
BA_ "SystemMessageLongSymbol" BO_ 2147548560 "VDMA_FD90_Advertised_Engine_Torque_Curve";
BA_ "SystemMessageLongSymbol" BO_ 2147548561 "VDMA_FD91_AC_Switching_Device_Status";
BA_ "SystemMessageLongSymbol" BO_ 2147548562 "VDMA_FD92_Engine_Operating_Information";
BA_ "SystemMessageLongSymbol" BO_ 2147548564 "VDMA_FD94_Electronic_Engine_Controller_7";
BA_ "SystemMessageLongSymbol" BO_ 2147548566 "VDMA_FD96_Fuel_Information_2_Liquid";
BA_ "SystemMessageLongSymbol" BO_ 2147548567 "VDMA_FD97_Fuel_Information_3_Liquid";
BA_ "SystemMessageLongSymbol" BO_ 2147548568 "VDMA_FD98_Aftertreatment_1_Historical_Info";
BA_ "SystemMessageLongSymbol" BO_ 2147548569 "VDMA_FD99_Aftertreatment_2_Historical_info";
BA_ "SystemMessageLongSymbol" BO_ 2147548570 "VDMA_FD9A_Electronic_Brake_System_2_4";
BA_ "SystemMessageLongSymbol" BO_ 2147548571 "VDMA_FD9B_Aftertreatment_1_Diesel_Exhaust_";
BA_ "SystemMessageLongSymbol" BO_ 2147548572 "VDMA_FD9C_Sensor_Electrical_Power_2";
BA_ "SystemMessageLongSymbol" BO_ 2147548573 "VDMA_FD9D_Sensor_Electrical_Power_1";
BA_ "SystemMessageLongSymbol" BO_ 2147548574 "VDMA_FD9E_Aftertreatment_2_Air_Control_1";
BA_ "SystemMessageLongSymbol" BO_ 2147548575 "VDMA_FD9F_Aftertreatment_1_Air_Control_1";
BA_ "SystemMessageLongSymbol" BO_ 2147548576 "VDMA_FDA0_Aftertreatment_2_Fuel_Control_1";
BA_ "SystemMessageLongSymbol" BO_ 2147548577 "VDMA_FDA1_Aftertreatment_1_Fuel_Control_1";
BA_ "SystemMessageLongSymbol" BO_ 2147548578 "VDMA_FDA2_Fuel_Information_3_Gaseous";
BA_ "SystemMessageLongSymbol" BO_ 2147548579 "VDMA_FDA3_Electronic_Engine_Controller_6";
BA_ "SystemMessageLongSymbol" BO_ 2147548582 "VDMA_FDA6_Voltage_Regulator_Excitation_Sta";
BA_ "SystemMessageLongSymbol" BO_ 2147548583 "VDMA_FDA7_Voltage_Regulator_Operating_Mode";
BA_ "SystemMessageLongSymbol" BO_ 2147548584 "VDMA_FDA8_Wireless_Communications_Message_";
BA_ "SystemMessageLongSymbol" BO_ 2147548585 "VDMA_FDA9_Wireless_Communications_Message_";
BA_ "SystemMessageLongSymbol" BO_ 2147548586 "VDMA_FDAA_Engine_Fluid_Level_Pressure_4";
BA_ "SystemMessageLongSymbol" BO_ 2147548587 "VDMA_FDAB_Request_For_Complete_Configurabl";
BA_ "SystemMessageLongSymbol" BO_ 2147548588 "VDMA_FDAC_Engine_Fuel_Information";
BA_ "SystemMessageLongSymbol" BO_ 2147548589 "VDMA_FDAD_Request_For_Complete_Configurabl";
BA_ "SystemMessageLongSymbol" BO_ 2147548590 "VDMA_FDAE_Fifth_Wheel_Smart_Systems_2";
BA_ "SystemMessageLongSymbol" BO_ 2147548591 "VDMA_FDAF_Aftertreatment_2_Intermediate_Ga";
BA_ "SystemMessageLongSymbol" BO_ 2147548592 "VDMA_FDB0_Aftertreatment_2_Outlet_Gas_2";
BA_ "SystemMessageLongSymbol" BO_ 2147548593 "VDMA_FDB1_Aftertreatment_2_Intake_Gas_2";
BA_ "SystemMessageLongSymbol" BO_ 2147548594 "VDMA_FDB2_Aftertreatment_1_Intermediate_Ga";
BA_ "SystemMessageLongSymbol" BO_ 2147548595 "VDMA_FDB3_Aftertreatment_1_Outlet_Gas_2";
BA_ "SystemMessageLongSymbol" BO_ 2147548596 "VDMA_FDB4_Aftertreatment_1_Intake_Gas_2";
BA_ "SystemMessageLongSymbol" BO_ 2147548597 "VDMA_FDB5_Emission_Related_Previously_MIL_";
BA_ "SystemMessageLongSymbol" BO_ 2147548601 "VDMA_FDB9_Tire_Pressure_Reference_Informat";
BA_ "SystemMessageLongSymbol" BO_ 2147548609 "VDMA_FDC1_Engine_Fluid_Level_Pressure_3";
BA_ "SystemMessageLongSymbol" BO_ 2147548610 "VDMA_FDC2_Electronic_Engine_Controller_14";
BA_ "SystemMessageLongSymbol" BO_ 2147548611 "VDMA_FDC3_Electronic_Engine_Controller_15";
BA_ "SystemMessageLongSymbol" BO_ 2147548612 "VDMA_FDC4_Electronic_Brake_Controller_5";
BA_ "SystemMessageLongSymbol" BO_ 2147548615 "VDMA_FDC7_Off_Highway_Engine_Control_Selec";
BA_ "SystemMessageLongSymbol" BO_ 2147548616 "VDMA_FDC8_Operator_Primary_Intermediate_Sp";
BA_ "SystemMessageLongSymbol" BO_ 2147548617 "VDMA_FDC9_Electronic_Control_Module_Inform";
BA_ "SystemMessageLongSymbol" BO_ 2147548618 "VDMA_FDCA_Intermediate_Speed_Control";
BA_ "SystemMessageLongSymbol" BO_ 2147548619 "VDMA_FDCB_Off_Highway_Engine_Control_Selec";
BA_ "SystemMessageLongSymbol" BO_ 2147548620 "VDMA_FDCC_Operators_External_Light_Control";
BA_ "SystemMessageLongSymbol" BO_ 2147548621 "VDMA_FDCD_Operator_Wiper_and_Washer_Contro";
BA_ "SystemMessageLongSymbol" BO_ 2147548622 "VDMA_FDCE_Working_Set_Member_Message_Obsol";
BA_ "SystemMessageLongSymbol" BO_ 2147548623 "VDMA_FDCF_Working_Set_Master_Message_Obsol";
BA_ "SystemMessageLongSymbol" BO_ 2147548624 "VDMA_FDD0_Intake_Exhaust_Conditions_2";
BA_ "SystemMessageLongSymbol" BO_ 2147548625 "VDMA_FDD1_FMS_standard_Interface_Identity_";
BA_ "SystemMessageLongSymbol" BO_ 2147548627 "VDMA_FDD3_Turbocharger_Information_6";
BA_ "SystemMessageLongSymbol" BO_ 2147548629 "VDMA_FDD5_Electronic_Engine_Controller_5";
BA_ "SystemMessageLongSymbol" BO_ 2147548630 "VDMA_FDD6_Basic_Joystick_Message_1";
BA_ "SystemMessageLongSymbol" BO_ 2147548631 "VDMA_FDD7_Extended_Joystick_Message_1";
BA_ "SystemMessageLongSymbol" BO_ 2147548632 "VDMA_FDD8_Basic_Joystick_Message_2";
BA_ "SystemMessageLongSymbol" BO_ 2147548633 "VDMA_FDD9_Extended_Joystick_Message_2";
BA_ "SystemMessageLongSymbol" BO_ 2147548634 "VDMA_FDDA_Basic_Joystick_Message_3";
BA_ "SystemMessageLongSymbol" BO_ 2147548635 "VDMA_FDDB_Extended_Joystick_Message_3";
BA_ "SystemMessageLongSymbol" BO_ 2147548636 "VDMA_FDDC_Marine_Control_Information";
BA_ "SystemMessageLongSymbol" BO_ 2147548637 "VDMA_FDDD_Military_Application_Message_1_1";
BA_ "SystemMessageLongSymbol" BO_ 2147548638 "VDMA_FDDE_Military_Application_Message_2_1";
BA_ "SystemMessageLongSymbol" BO_ 2147548639 "VDMA_FDDF_Front_Wheel_Drive_Status";
BA_ "SystemMessageLongSymbol" BO_ 2147548641 "VDMA_FDE1_Cab_Climate_System_Information_1";
BA_ "SystemMessageLongSymbol" BO_ 2147548643 "VDMA_FDE3_Equipment_Operation_and_Control";
BA_ "SystemMessageLongSymbol" BO_ 2147548644 "VDMA_FDE4_Equipment_Performance_Data";
BA_ "SystemMessageLongSymbol" BO_ 2147548645 "VDMA_FDE5_Maximum_Vehicle_Speed_Limit_Stat";
BA_ "SystemMessageLongSymbol" BO_ 2147548646 "VDMA_FDE6_Hydraulic_Braking_System";
BA_ "SystemMessageLongSymbol" BO_ 2147548647 "VDMA_FDE7_Bus_1_Utility_Sync_Check_Status";
BA_ "SystemMessageLongSymbol" BO_ 2147548648 "VDMA_FDE8_Bus_1_Generator_Sync_Check_Statu";
BA_ "SystemMessageLongSymbol" BO_ 2147548649 "VDMA_FDE9_Bus_1_Phase_C_Basic_AC_Quantitie";
BA_ "SystemMessageLongSymbol" BO_ 2147548650 "VDMA_FDEA_Bus_1_Phase_B_Basic_AC_Quantitie";
BA_ "SystemMessageLongSymbol" BO_ 2147548651 "VDMA_FDEB_Bus_1_Phase_A_Basic_AC_Quantitie";
BA_ "SystemMessageLongSymbol" BO_ 2147548652 "VDMA_FDEC_Bus_1_Average_Basic_AC_Quantitie";
BA_ "SystemMessageLongSymbol" BO_ 2147548653 "VDMA_FDED_Utility_Total_AC_Energy";
BA_ "SystemMessageLongSymbol" BO_ 2147548654 "VDMA_FDEE_Utility_Phase_C_AC_Reactive_Powe";
BA_ "SystemMessageLongSymbol" BO_ 2147548655 "VDMA_FDEF_Utility_Phase_C_AC_Power";
BA_ "SystemMessageLongSymbol" BO_ 2147548656 "VDMA_FDF0_Utility_Phase_C_AC_Basic_Quantit";
BA_ "SystemMessageLongSymbol" BO_ 2147548657 "VDMA_FDF1_Utility_Phase_B_AC_Reactive_Powe";
BA_ "SystemMessageLongSymbol" BO_ 2147548658 "VDMA_FDF2_Utility_Phase_B_AC_Power";
BA_ "SystemMessageLongSymbol" BO_ 2147548659 "VDMA_FDF3_Utility_Phase_B_AC_Basic_Quantit";
BA_ "SystemMessageLongSymbol" BO_ 2147548660 "VDMA_FDF4_Utility_Phase_A_AC_Reactive_Powe";
BA_ "SystemMessageLongSymbol" BO_ 2147548661 "VDMA_FDF5_Utility_Phase_A_AC_Power";
BA_ "SystemMessageLongSymbol" BO_ 2147548662 "VDMA_FDF6_Utility_Phase_A_Basic_AC_Quantit";
BA_ "SystemMessageLongSymbol" BO_ 2147548663 "VDMA_FDF7_Utility_Total_AC_Reactive_Power";
BA_ "SystemMessageLongSymbol" BO_ 2147548665 "VDMA_FDF9_Utility_Average_Basic_AC_Quantit";
BA_ "SystemMessageLongSymbol" BO_ 2147548666 "VDMA_FDFA_Generator_Total_AC_Energy";
BA_ "SystemMessageLongSymbol" BO_ 2147548667 "VDMA_FDFB_Generator_Phase_C_AC_Reactive_Po";
BA_ "SystemMessageLongSymbol" BO_ 2147548668 "VDMA_FDFC_Generator_Phase_C_AC_Power";
BA_ "SystemMessageLongSymbol" BO_ 2147548669 "VDMA_FDFD_Generator_Phase_C_Basic_AC_Quant";
BA_ "SystemMessageLongSymbol" BO_ 2147548670 "VDMA_FDFE_Generator_Phase_B_AC_Reactive_Po";
BA_ "SystemMessageLongSymbol" BO_ 2147548671 "VDMA_FDFF_Generator_Phase_B_AC_Power";
BA_ "SystemMessageLongSymbol" BO_ 2147548672 "VDMA_FE00_Generator_Phase_B_Basic_AC_Quant";
BA_ "SystemMessageLongSymbol" BO_ 2147548673 "VDMA_FE01_Generator_Phase_A_AC_Reactive_Po";
BA_ "SystemMessageLongSymbol" BO_ 2147548674 "VDMA_FE02_Generator_Phase_A_AC_Power";
BA_ "SystemMessageLongSymbol" BO_ 2147548675 "VDMA_FE03_Generator_Phase_A_Basic_AC_Quant";
BA_ "SystemMessageLongSymbol" BO_ 2147548676 "VDMA_FE04_Generator_Total_AC_Reactive_Powe";
BA_ "SystemMessageLongSymbol" BO_ 2147548677 "VDMA_FE05_Generator_Total_AC_Power";
BA_ "SystemMessageLongSymbol" BO_ 2147548678 "VDMA_FE06_Generator_Average_Basic_AC_Quant";
BA_ "SystemMessageLongSymbol" BO_ 2147548680 "VDMA_FE08_Required_Tractor_Facilities_mess";
BA_ "SystemMessageLongSymbol" BO_ 2147548681 "VDMA_FE09_Tractor_Facilities_response_mess";
BA_ "SystemMessageLongSymbol" BO_ 2147548682 "VDMA_FE0A_Tractor_control_command_tractor_";
BA_ "SystemSignalLongSymbol" SG_ 2147548394 Vehicle_Electrical_Power_4_obsol "Vehicle_Electrical_Power_4_obsol_RawPayload";
BA_ "SystemSignalLongSymbol" SG_ 2147548395 Aftertreatment_2_NOx_Adsorber_In "Aftertreatment_2_NOx_Adsorber_In_RawPayload";
BA_ "SystemSignalLongSymbol" SG_ 2147548396 Aftertreatment_1_NOx_Adsorber_In "Aftertreatment_1_NOx_Adsorber_In_RawPayload";
BA_ "SystemSignalLongSymbol" SG_ 2147548397 Aftertreatment_2_Warm_Up_Diesel_ "Aftertreatment_2_Warm_Up_Diesel__RawPayload";
BA_ "SystemSignalLongSymbol" SG_ 2147548398 Land_Leveling_System_Reference_E "Land_Leveling_System_Reference_E_RawPayload";
BA_ "SystemSignalLongSymbol" SG_ 2147548399 Engine_Fluid_Level_Pressure_11_R "Engine_Fluid_Level_Pressure_11_RawPayload";
BA_ "SystemSignalLongSymbol" SG_ 2147548400 Engine_Fuel_Lube_x000D_Systems_2 "Engine_Fuel_Lube_x000D_Systems_2_RawPayload";
BA_ "SystemSignalLongSymbol" SG_ 2147548401 Engine_Turbocharger_Wastegate_Ac "Engine_Turbocharger_Wastegate_Ac_RawPayload";
BA_ "SystemSignalLongSymbol" SG_ 2147548402 Engine_Fuel_Throttle_Valve_Infor "Engine_Fuel_Throttle_Valve_Infor_RawPayload";
BA_ "SystemSignalLongSymbol" SG_ 2147548403 Engine_Turbocharger_Compressor_B "Engine_Turbocharger_Compressor_B_RawPayload";
BA_ "SystemSignalLongSymbol" SG_ 2147548405 Charge_Air_Cooler_2_Precooler_Ra "Charge_Air_Cooler_2_Precooler_RawPayload";
BA_ "SystemSignalLongSymbol" SG_ 2147548407 Charge_Air_Cooler_1_Precooler_Ra "Charge_Air_Cooler_1_Precooler_RawPayload";
BA_ "SystemSignalLongSymbol" SG_ 2147548408 Diesel_Particulate_Filter_2_Soot "Diesel_Particulate_Filter_2_Soot_RawPayload";
BA_ "SystemSignalLongSymbol" SG_ 2147548409 Diesel_Particulate_Filter_1_Soot "Diesel_Particulate_Filter_1_Soot_RawPayload";
BA_ "SystemSignalLongSymbol" SG_ 2147548410 Electronic_Engine_Controller_11_ "Electronic_Engine_Controller_11_RawPayload";
BA_ "SystemSignalLongSymbol" SG_ 2147548411 Engine_Manifold_Actuator_Positio "Engine_Manifold_Actuator_Positio_RawPayload";
BA_ "SystemSignalLongSymbol" SG_ 2147548412 Engine_Manifold_Actuator_Control "Engine_Manifold_Actuator_Control_RawPayload";
BA_ "SystemSignalLongSymbol" SG_ 2147548413 Electronic_Engine_Controller_9_R "Electronic_Engine_Controller_9_RawPayload";
BA_ "SystemSignalLongSymbol" SG_ 2147548414 Electronic_Engine_Controller_10_ "Electronic_Engine_Controller_10_RawPayload";
BA_ "SystemSignalLongSymbol" SG_ 2147548416 Engine_Fluid_Level_Pressure_10_R "Engine_Fluid_Level_Pressure_10_RawPayload";
BA_ "SystemSignalLongSymbol" SG_ 2147548417 Low_Voltage_Disconnect_Status_Ra "Low_Voltage_Disconnect_Status_RawPayload";
BA_ "SystemSignalLongSymbol" SG_ 2147548419 Implement_Operating_state_comman "Implement_Operating_state_comman_RawPayload";
BA_ "SystemSignalLongSymbol" SG_ 2147548420 Direct_Lamp_Control_Data_2_RawPa "Direct_Lamp_Control_Data_2_RawPayload";
BA_ "SystemSignalLongSymbol" SG_ 2147548421 Direct_Lamp_Control_Data_1_RawPa "Direct_Lamp_Control_Data_1_RawPayload";
BA_ "SystemSignalLongSymbol" SG_ 2147548422 Direct_Lamp_Control_Command_2_Ra "Direct_Lamp_Control_Command_2_RawPayload";
BA_ "SystemSignalLongSymbol" SG_ 2147548423 Direct_Lamp_Control_Command_1_Ra "Direct_Lamp_Control_Command_1_RawPayload";
BA_ "SystemSignalLongSymbol" SG_ 2147548425 High_Resolution_Fuel_Consumption "High_Resolution_Fuel_Consumption_RawPayload";
BA_ "SystemSignalLongSymbol" SG_ 2147548426 Aftertreatment_2_Outlet_Gas_NOx_ "Aftertreatment_2_Outlet_Gas_NOx__RawPayload";
BA_ "SystemSignalLongSymbol" SG_ 2147548427 Aftertreatment_2_Outlet_Gas_NOx_ "Aftertreatment_2_Outlet_Gas_NOx__RawPayload";
BA_ "SystemSignalLongSymbol" SG_ 2147548428 Aftertreatment_2_Intake_Gas_NOx_ "Aftertreatment_2_Intake_Gas_NOx__RawPayload";
BA_ "SystemSignalLongSymbol" SG_ 2147548429 Aftertreatment_2_Intake_Gas_NOx_ "Aftertreatment_2_Intake_Gas_NOx__RawPayload";
BA_ "SystemSignalLongSymbol" SG_ 2147548430 Aftertreatment_1_Outlet_Gas_NOx_ "Aftertreatment_1_Outlet_Gas_NOx__RawPayload";
BA_ "SystemSignalLongSymbol" SG_ 2147548431 Aftertreatment_1_Outlet_Gas_NOx_ "Aftertreatment_1_Outlet_Gas_NOx__RawPayload";
BA_ "SystemSignalLongSymbol" SG_ 2147548432 Aftertreatment_1_Intake_Gas_NOx_ "Aftertreatment_1_Intake_Gas_NOx__RawPayload";
BA_ "SystemSignalLongSymbol" SG_ 2147548433 Aftertreatment_1_Intake_Gas_NOx_ "Aftertreatment_1_Intake_Gas_NOx__RawPayload";
BA_ "SystemSignalLongSymbol" SG_ 2147548434 Magnet_Status_Information_1_RawP "Magnet_Status_Information_1_RawPayload";
BA_ "SystemSignalLongSymbol" SG_ 2147548435 Magnet_System_Configuration_Info "Magnet_System_Configuration_Info_RawPayload";
BA_ "SystemSignalLongSymbol" SG_ 2147548438 Occupant_Classification_System_I "Occupant_Classification_System_I_RawPayload";
BA_ "SystemSignalLongSymbol" SG_ 2147548439 Beltlock_and_Airbag_Deactivation "Beltlock_and_Airbag_Deactivation_RawPayload";
BA_ "SystemSignalLongSymbol" SG_ 2147548440 Collision_Sensor_Information_Raw "Collision_Sensor_Information_RawPayload";
BA_ "SystemSignalLongSymbol" SG_ 2147548441 Ignitor_Loop_Information_RawPayl "Ignitor_Loop_Information_RawPayload";
BA_ "SystemSignalLongSymbol" SG_ 2147548442 Aftertreatment_1_Warm_Up_Diesel_ "Aftertreatment_1_Warm_Up_Diesel__RawPayload";
BA_ "SystemSignalLongSymbol" SG_ 2147548443 Diesel_Particulate_Filter_2_Soot "Diesel_Particulate_Filter_2_Soot_RawPayload";
BA_ "SystemSignalLongSymbol" SG_ 2147548444 Diesel_Particulate_Filter_1_Soot "Diesel_Particulate_Filter_1_Soot_RawPayload";
BA_ "SystemSignalLongSymbol" SG_ 2147548445 Aftertreatment_Differential_Temp "Aftertreatment_Differential_Temp_RawPayload";
BA_ "SystemSignalLongSymbol" SG_ 2147548446 Aftertreatment_Differential_Temp "Aftertreatment_Differential_Temp_RawPayload";
BA_ "SystemSignalLongSymbol" SG_ 2147548447 Aftertreatment_2_Diesel_Oxidatio "Aftertreatment_2_Diesel_Oxidatio_RawPayload";
BA_ "SystemSignalLongSymbol" SG_ 2147548448 Aftertreatment_1_Diesel_Oxidatio "Aftertreatment_1_Diesel_Oxidatio_RawPayload";
BA_ "SystemSignalLongSymbol" SG_ 2147548449 Aftertreatment_2_Gas_Oxidation_C "Aftertreatment_2_Gas_Oxidation_C_RawPayload";
BA_ "SystemSignalLongSymbol" SG_ 2147548450 Aftertreatment_1_Gas_Oxidation_C "Aftertreatment_1_Gas_Oxidation_C_RawPayload";
BA_ "SystemSignalLongSymbol" SG_ 2147548451 Extended_Joystick_Message_10_Raw "Extended_Joystick_Message_10_RawPayload";
BA_ "SystemSignalLongSymbol" SG_ 2147548452 Basic_Joystick_Message_10_RawPay "Basic_Joystick_Message_10_RawPayload";
BA_ "SystemSignalLongSymbol" SG_ 2147548453 Extended_Joystick_Message_9_RawP "Extended_Joystick_Message_9_RawPayload";
BA_ "SystemSignalLongSymbol" SG_ 2147548454 Basic_Joystick_Message_9_RawPayl "Basic_Joystick_Message_9_RawPayload";
BA_ "SystemSignalLongSymbol" SG_ 2147548455 Extended_Joystick_Message_8_RawP "Extended_Joystick_Message_8_RawPayload";
BA_ "SystemSignalLongSymbol" SG_ 2147548456 Basic_Joystick_Message_8_RawPayl "Basic_Joystick_Message_8_RawPayload";
BA_ "SystemSignalLongSymbol" SG_ 2147548457 Extended_Joystick_Message_7_RawP "Extended_Joystick_Message_7_RawPayload";
BA_ "SystemSignalLongSymbol" SG_ 2147548458 Basic_Joystick_Message_7_RawPayl "Basic_Joystick_Message_7_RawPayload";
BA_ "SystemSignalLongSymbol" SG_ 2147548459 Extended_Joystick_Message_6_RawP "Extended_Joystick_Message_6_RawPayload";
BA_ "SystemSignalLongSymbol" SG_ 2147548460 Basic_Joystick_Message_6_RawPayl "Basic_Joystick_Message_6_RawPayload";
BA_ "SystemSignalLongSymbol" SG_ 2147548461 Extended_Joystick_Message_5_RawP "Extended_Joystick_Message_5_RawPayload";
BA_ "SystemSignalLongSymbol" SG_ 2147548462 Basic_Joystick_Message_5_RawPayl "Basic_Joystick_Message_5_RawPayload";
BA_ "SystemSignalLongSymbol" SG_ 2147548463 Extended_Joystick_Message_4_RawP "Extended_Joystick_Message_4_RawPayload";
BA_ "SystemSignalLongSymbol" SG_ 2147548464 Basic_Joystick_Message_4_RawPayl "Basic_Joystick_Message_4_RawPayload";
BA_ "SystemSignalLongSymbol" SG_ 2147548467 Aftertreatment_2_Diesel_Exhaust_ "Aftertreatment_2_Diesel_Exhaust__RawPayload";
BA_ "SystemSignalLongSymbol" SG_ 2147548468 Aftertreatment_2_SCR_Reagant_Tan "Aftertreatment_2_SCR_Reagant_Tan_RawPayload";
BA_ "SystemSignalLongSymbol" SG_ 2147548469 Aftertreatment_2_Diesel_Exhaust_ "Aftertreatment_2_Diesel_Exhaust__RawPayload";
BA_ "SystemSignalLongSymbol" SG_ 2147548470 Aftertreatment_2_Diesel_Exhaust_ "Aftertreatment_2_Diesel_Exhaust__RawPayload";
BA_ "SystemSignalLongSymbol" SG_ 2147548471 Aftertreatment_2_SCR_Service_Inf "Aftertreatment_2_SCR_Service_Inf_RawPayload";
BA_ "SystemSignalLongSymbol" SG_ 2147548472 Aftertreatment_2_SCR_Exhaust_Gas "Aftertreatment_2_SCR_Exhaust_Gas_RawPayload";
BA_ "SystemSignalLongSymbol" SG_ 2147548473 Aftertreatment_2_SCR_Exhaust_Gas "Aftertreatment_2_SCR_Exhaust_Gas_RawPayload";
BA_ "SystemSignalLongSymbol" SG_ 2147548474 Aftertreatment_2_SCR_Dosing_Syst "Aftertreatment_2_SCR_Dosing_Syst_RawPayload";
BA_ "SystemSignalLongSymbol" SG_ 2147548475 Aftertreatment_2_SCR_Dosing_Syst "Aftertreatment_2_SCR_Dosing_Syst_RawPayload";
BA_ "SystemSignalLongSymbol" SG_ 2147548476 Aftertreatment_1_Diesel_Exhaust_ "Aftertreatment_1_Diesel_Exhaust__RawPayload";
BA_ "SystemSignalLongSymbol" SG_ 2147548477 Aftertreatment_1_SCR_Reagant_Tan "Aftertreatment_1_SCR_Reagant_Tan_RawPayload";
BA_ "SystemSignalLongSymbol" SG_ 2147548478 Aftertreatment_1_SCR_Exhaust_Gas "Aftertreatment_1_SCR_Exhaust_Gas_RawPayload";
BA_ "SystemSignalLongSymbol" SG_ 2147548479 Aftertreatment_1_SCR_Exhaust_Gas "Aftertreatment_1_SCR_Exhaust_Gas_RawPayload";
BA_ "SystemSignalLongSymbol" SG_ 2147548480 Aftertreatment_1_SCR_Dosing_Syst "Aftertreatment_1_SCR_Dosing_Syst_RawPayload";
BA_ "SystemSignalLongSymbol" SG_ 2147548481 Aftertreatment_1_SCR_Dosing_Syst "Aftertreatment_1_SCR_Dosing_Syst_RawPayload";
BA_ "SystemSignalLongSymbol" SG_ 2147548482 ISOBUS_compliance_certification_ "ISOBUS_compliance_certification_RawPayload";
BA_ "SystemSignalLongSymbol" SG_ 2147548484 Aftertreatment_2_Fuel_Control_2_ "Aftertreatment_2_Fuel_Control_2_RawPayload";
BA_ "SystemSignalLongSymbol" SG_ 2147548485 Aftertreatment_2_Three_Way_Catal "Aftertreatment_2_Three_Way_Catal_RawPayload";
BA_ "SystemSignalLongSymbol" SG_ 2147548486 Aftertreatment_1_Three_Way_Catal "Aftertreatment_1_Three_Way_Catal_RawPayload";
BA_ "SystemSignalLongSymbol" SG_ 2147548487 Transmission_Mode_Labels_RawPayl "Transmission_Mode_Labels_RawPayload";
BA_ "SystemSignalLongSymbol" SG_ 2147548488 Engine_Exhaust_Bank_2_O2_Fuel_Tr "Engine_Exhaust_Bank_2_O2_Fuel_Tr_RawPayload";
BA_ "SystemSignalLongSymbol" SG_ 2147548489 Engine_Exhaust_Bank_1_O2_Fuel_Tr "Engine_Exhaust_Bank_1_O2_Fuel_Tr_RawPayload";
BA_ "SystemSignalLongSymbol" SG_ 2147548490 General_Purpose_Message_2_11_Raw "General_Purpose_Message_2_11_RawPayload";
BA_ "SystemSignalLongSymbol" SG_ 2147548491 General_Purpose_Message_2_10_Raw "General_Purpose_Message_2_10_RawPayload";
BA_ "SystemSignalLongSymbol" SG_ 2147548492 General_Purpose_Message_2_9_RawP "General_Purpose_Message_2_9_RawPayload";
BA_ "SystemSignalLongSymbol" SG_ 2147548493 General_Purpose_Message_2_8_RawP "General_Purpose_Message_2_8_RawPayload";
BA_ "SystemSignalLongSymbol" SG_ 2147548494 General_Purpose_Message_2_7_RawP "General_Purpose_Message_2_7_RawPayload";
BA_ "SystemSignalLongSymbol" SG_ 2147548495 General_Purpose_Message_2_6_RawP "General_Purpose_Message_2_6_RawPayload";
BA_ "SystemSignalLongSymbol" SG_ 2147548496 General_Purpose_Message_1_9_RawP "General_Purpose_Message_1_9_RawPayload";
BA_ "SystemSignalLongSymbol" SG_ 2147548497 Aftercooler_Coolant_Control_Valv "Aftercooler_Coolant_Control_Valv_RawPayload";
BA_ "SystemSignalLongSymbol" SG_ 2147548498 Engine_Coolant_Control_Valve_Com "Engine_Coolant_Control_Valve_Com_RawPayload";
BA_ "SystemSignalLongSymbol" SG_ 2147548499 Engine_Average_Information_RawPa "Engine_Average_Information_RawPayload";
BA_ "SystemSignalLongSymbol" SG_ 2147548500 DTCs_C_Previously_Active_RawPayl "DTCs_C_Previously_Active_RawPayload";
BA_ "SystemSignalLongSymbol" SG_ 2147548501 DTCs_C_Confirmed_and_Active_RawP "DTCs_C_Confirmed_and_Active_RawPayload";
BA_ "SystemSignalLongSymbol" SG_ 2147548503 DTCs_B2_Previously_Active_RawPay "DTCs_B2_Previously_Active_RawPayload";
BA_ "SystemSignalLongSymbol" SG_ 2147548504 DTCs_B2_Confirmed_and_Active_Raw "DTCs_B2_Confirmed_and_Active_RawPayload";
BA_ "SystemSignalLongSymbol" SG_ 2147548506 DTCs_B1_Previously_Active_RawPay "DTCs_B1_Previously_Active_RawPayload";
BA_ "SystemSignalLongSymbol" SG_ 2147548507 DTCs_B1_Confirmed_and_Active_Raw "DTCs_B1_Confirmed_and_Active_RawPayload";
BA_ "SystemSignalLongSymbol" SG_ 2147548509 DTCs_A_Previously_Active_RawPayl "DTCs_A_Previously_Active_RawPayload";
BA_ "SystemSignalLongSymbol" SG_ 2147548510 DTCs_A_Confirmed_and_Active_RawP "DTCs_A_Confirmed_and_Active_RawPayload";
BA_ "SystemSignalLongSymbol" SG_ 2147548512 Harmonized_B1_Failure_Counts_Raw "Harmonized_B1_Failure_Counts_RawPayload";
BA_ "SystemSignalLongSymbol" SG_ 2147548513 Harmonized_Cumulative_Continuous "Harmonized_Cumulative_Continuous_RawPayload";
BA_ "SystemSignalLongSymbol" SG_ 2147548514 Harmonized_Global_Regulation_Des "Harmonized_Global_Regulation_Des_RawPayload";
BA_ "SystemSignalLongSymbol" SG_ 2147548515 Harmonized_Roadworthiness_System "Harmonized_Roadworthiness_System_RawPayload";
BA_ "SystemSignalLongSymbol" SG_ 2147548516 Harmonized_Roadworthiness_Vehicl "Harmonized_Roadworthiness_Vehicl_RawPayload";
BA_ "SystemSignalLongSymbol" SG_ 2147548517 Aftertreatment_1_Fuel_Control_2_ "Aftertreatment_1_Fuel_Control_2_RawPayload";
BA_ "SystemSignalLongSymbol" SG_ 2147548519 Zero_Net_Vehicle_Weight_Change_R "Zero_Net_Vehicle_Weight_Change_RawPayload";
BA_ "SystemSignalLongSymbol" SG_ 2147548520 Gross_Combination_Vehicle_Weight "Gross_Combination_Vehicle_Weight_RawPayload";
BA_ "SystemSignalLongSymbol" SG_ 2147548521 Axle_Group_Calibration_Weights_R "Axle_Group_Calibration_Weights_RawPayload";
BA_ "SystemSignalLongSymbol" SG_ 2147548523 Available_Axle_Group_Weights_Raw "Available_Axle_Group_Weights_RawPayload";
BA_ "SystemSignalLongSymbol" SG_ 2147548524 Aftertreatment_2_Air_Control_2_R "Aftertreatment_2_Air_Control_2_RawPayload";
BA_ "SystemSignalLongSymbol" SG_ 2147548525 Aftertreatment_1_Air_Control_2_R "Aftertreatment_1_Air_Control_2_RawPayload";
BA_ "SystemSignalLongSymbol" SG_ 2147548526 Aftertreatment_1_SCR_Service_Inf "Aftertreatment_1_SCR_Service_Inf_RawPayload";
BA_ "SystemSignalLongSymbol" SG_ 2147548527 Electronic_Engine_Controller_8_R "Electronic_Engine_Controller_8_RawPayload";
BA_ "SystemSignalLongSymbol" SG_ 2147548529 Brake_actuator_stroke_status_Raw "Brake_actuator_stroke_status_RawPayload";
BA_ "SystemSignalLongSymbol" SG_ 2147548530 Engine_Spark_Voltage_6_RawPayloa "Engine_Spark_Voltage_6_RawPayload";
BA_ "SystemSignalLongSymbol" SG_ 2147548531 Engine_Spark_Voltage_5_RawPayloa "Engine_Spark_Voltage_5_RawPayload";
BA_ "SystemSignalLongSymbol" SG_ 2147548532 Engine_Spark_Voltage_4_RawPayloa "Engine_Spark_Voltage_4_RawPayload";
BA_ "SystemSignalLongSymbol" SG_ 2147548533 Engine_Spark_Voltage_3_RawPayloa "Engine_Spark_Voltage_3_RawPayload";
BA_ "SystemSignalLongSymbol" SG_ 2147548534 Engine_Spark_Voltage_2_RawPayloa "Engine_Spark_Voltage_2_RawPayload";
BA_ "SystemSignalLongSymbol" SG_ 2147548535 Engine_Spark_Voltage_1_RawPayloa "Engine_Spark_Voltage_1_RawPayload";
BA_ "SystemSignalLongSymbol" SG_ 2147548536 Aftertreatment_2_Trip_Informatio "Aftertreatment_2_Trip_Informatio_RawPayload";
BA_ "SystemSignalLongSymbol" SG_ 2147548537 Aftertreatment_1_Trip_Informatio "Aftertreatment_1_Trip_Informatio_RawPayload";
BA_ "SystemSignalLongSymbol" SG_ 2147548538 Aftertreatment_2_Service_1_RawPa "Aftertreatment_2_Service_1_RawPayload";
BA_ "SystemSignalLongSymbol" SG_ 2147548539 Aftertreatment_1_Service_1_RawPa "Aftertreatment_1_Service_1_RawPayload";
BA_ "SystemSignalLongSymbol" SG_ 2147548540 Diesel_Particulate_Filter_Contro "Diesel_Particulate_Filter_Contro_RawPayload";
BA_ "SystemSignalLongSymbol" SG_ 2147548541 Reserved_for_FMS_Telltale_status "Reserved_for_FMS_Telltale_status_RawPayload";
BA_ "SystemSignalLongSymbol" SG_ 2147548542 Adaptive_Front_Lighting_System_S "Adaptive_Front_Lighting_System_S_RawPayload";
BA_ "SystemSignalLongSymbol" SG_ 2147548543 Engine_Configuration_2_RawPayloa "Engine_Configuration_2_RawPayload";
BA_ "SystemSignalLongSymbol" SG_ 2147548544 Emission_Related_Permanent_Diagn "Emission_Related_Permanent_Diagn_RawPayload";
BA_ "SystemSignalLongSymbol" SG_ 2147548547 Transfer_Case_Information_RawPay "Transfer_Case_Information_RawPayload";
BA_ "SystemSignalLongSymbol" SG_ 2147548548 Engine_Fluid_Level_Pressure_9_Ra "Engine_Fluid_Level_Pressure_9_RawPayload";
BA_ "SystemSignalLongSymbol" SG_ 2147548549 Engine_Fluid_Level_Pressure_8_Ra "Engine_Fluid_Level_Pressure_8_RawPayload";
BA_ "SystemSignalLongSymbol" SG_ 2147548550 Engine_Fluid_Level_Pressure_7_Ra "Engine_Fluid_Level_Pressure_7_RawPayload";
BA_ "SystemSignalLongSymbol" SG_ 2147548551 Engine_Fluid_Level_Pressure_6_Ra "Engine_Fluid_Level_Pressure_6_RawPayload";
BA_ "SystemSignalLongSymbol" SG_ 2147548552 Engine_Fluid_Level_Pressure_5_Ra "Engine_Fluid_Level_Pressure_5_RawPayload";
BA_ "SystemSignalLongSymbol" SG_ 2147548553 Vehicle_Direction_Speed_2_RawPay "Vehicle_Direction_Speed_2_RawPayload";
BA_ "SystemSignalLongSymbol" SG_ 2147548554 SAE_J2012_2_Byte_DTC_Display_Raw "SAE_J2012_2_Byte_DTC_Display_RawPayload";
BA_ "SystemSignalLongSymbol" SG_ 2147548555 Aftertreatment_2_Gas_Parameters_ "Aftertreatment_2_Gas_Parameters_RawPayload";
BA_ "SystemSignalLongSymbol" SG_ 2147548556 Aftertreatment_1_Gas_Parameters_ "Aftertreatment_1_Gas_Parameters_RawPayload";
BA_ "SystemSignalLongSymbol" SG_ 2147548557 Utility_Total_AC_Reactive_Energy "Utility_Total_AC_Reactive_Energy_RawPayload";
BA_ "SystemSignalLongSymbol" SG_ 2147548558 Generator_Total_AC_Reactive_Ener "Generator_Total_AC_Reactive_Ener_RawPayload";
BA_ "SystemSignalLongSymbol" SG_ 2147548559 Generator_Total_AC_Percent_Power "Generator_Total_AC_Percent_Power_RawPayload";
BA_ "SystemSignalLongSymbol" SG_ 2147548560 Advertised_Engine_Torque_Curve_R "Advertised_Engine_Torque_Curve_RawPayload";
BA_ "SystemSignalLongSymbol" SG_ 2147548561 AC_Switching_Device_Status_RawPa "AC_Switching_Device_Status_RawPayload";
BA_ "SystemSignalLongSymbol" SG_ 2147548562 Engine_Operating_Information_Raw "Engine_Operating_Information_RawPayload";
BA_ "SystemSignalLongSymbol" SG_ 2147548564 Electronic_Engine_Controller_7_R "Electronic_Engine_Controller_7_RawPayload";
BA_ "SystemSignalLongSymbol" SG_ 2147548566 Fuel_Information_2_Liquid_RawPay "Fuel_Information_2_Liquid_RawPayload";
BA_ "SystemSignalLongSymbol" SG_ 2147548567 Fuel_Information_3_Liquid_RawPay "Fuel_Information_3_Liquid_RawPayload";
BA_ "SystemSignalLongSymbol" SG_ 2147548568 Aftertreatment_1_Historical_Info "Aftertreatment_1_Historical_Info_RawPayload";
BA_ "SystemSignalLongSymbol" SG_ 2147548569 Aftertreatment_2_Historical_info "Aftertreatment_2_Historical_info_RawPayload";
BA_ "SystemSignalLongSymbol" SG_ 2147548570 Electronic_Brake_System_2_4_RawP "Electronic_Brake_System_2_4_RawPayload";
BA_ "SystemSignalLongSymbol" SG_ 2147548571 Aftertreatment_1_Diesel_Exhaust_ "Aftertreatment_1_Diesel_Exhaust__RawPayload";
BA_ "SystemSignalLongSymbol" SG_ 2147548572 Sensor_Electrical_Power_2_RawPay "Sensor_Electrical_Power_2_RawPayload";
BA_ "SystemSignalLongSymbol" SG_ 2147548573 Sensor_Electrical_Power_1_RawPay "Sensor_Electrical_Power_1_RawPayload";
BA_ "SystemSignalLongSymbol" SG_ 2147548574 Aftertreatment_2_Air_Control_1_R "Aftertreatment_2_Air_Control_1_RawPayload";
BA_ "SystemSignalLongSymbol" SG_ 2147548575 Aftertreatment_1_Air_Control_1_R "Aftertreatment_1_Air_Control_1_RawPayload";
BA_ "SystemSignalLongSymbol" SG_ 2147548576 Aftertreatment_2_Fuel_Control_1_ "Aftertreatment_2_Fuel_Control_1_RawPayload";
BA_ "SystemSignalLongSymbol" SG_ 2147548577 Aftertreatment_1_Fuel_Control_1_ "Aftertreatment_1_Fuel_Control_1_RawPayload";
BA_ "SystemSignalLongSymbol" SG_ 2147548578 Fuel_Information_3_Gaseous_RawPa "Fuel_Information_3_Gaseous_RawPayload";
BA_ "SystemSignalLongSymbol" SG_ 2147548579 Electronic_Engine_Controller_6_R "Electronic_Engine_Controller_6_RawPayload";
BA_ "SystemSignalLongSymbol" SG_ 2147548580 PTO_Drive_Engagement_1_RawPayloa "PTO_Drive_Engagement_1_RawPayload";
BA_ "SystemSignalLongSymbol" SG_ 2147548582 Voltage_Regulator_Excitation_Sta "Voltage_Regulator_Excitation_Sta_RawPayload";
BA_ "SystemSignalLongSymbol" SG_ 2147548583 Voltage_Regulator_Operating_Mode "Voltage_Regulator_Operating_Mode_RawPayload";
BA_ "SystemSignalLongSymbol" SG_ 2147548584 Wireless_Communications_Message_ "Wireless_Communications_Message__RawPayload";
BA_ "SystemSignalLongSymbol" SG_ 2147548585 Wireless_Communications_Message_ "Wireless_Communications_Message__RawPayload";
BA_ "SystemSignalLongSymbol" SG_ 2147548586 Engine_Fluid_Level_Pressure_4_Ra "Engine_Fluid_Level_Pressure_4_RawPayload";
BA_ "SystemSignalLongSymbol" SG_ 2147548587 Request_For_Complete_Configurabl "Request_For_Complete_Configurabl_RawPayload";
BA_ "SystemSignalLongSymbol" SG_ 2147548588 Engine_Fuel_Information_RawPaylo "Engine_Fuel_Information_RawPayload";
BA_ "SystemSignalLongSymbol" SG_ 2147548589 Request_For_Complete_Configurabl "Request_For_Complete_Configurabl_RawPayload";
BA_ "SystemSignalLongSymbol" SG_ 2147548590 Fifth_Wheel_Smart_Systems_2_RawP "Fifth_Wheel_Smart_Systems_2_RawPayload";
BA_ "SystemSignalLongSymbol" SG_ 2147548591 Aftertreatment_2_Intermediate_Ga "Aftertreatment_2_Intermediate_Ga_RawPayload";
BA_ "SystemSignalLongSymbol" SG_ 2147548592 Aftertreatment_2_Outlet_Gas_2_Ra "Aftertreatment_2_Outlet_Gas_2_RawPayload";
BA_ "SystemSignalLongSymbol" SG_ 2147548593 Aftertreatment_2_Intake_Gas_2_Ra "Aftertreatment_2_Intake_Gas_2_RawPayload";
BA_ "SystemSignalLongSymbol" SG_ 2147548594 Aftertreatment_1_Intermediate_Ga "Aftertreatment_1_Intermediate_Ga_RawPayload";
BA_ "SystemSignalLongSymbol" SG_ 2147548595 Aftertreatment_1_Outlet_Gas_2_Ra "Aftertreatment_1_Outlet_Gas_2_RawPayload";
BA_ "SystemSignalLongSymbol" SG_ 2147548596 Aftertreatment_1_Intake_Gas_2_Ra "Aftertreatment_1_Intake_Gas_2_RawPayload";
BA_ "SystemSignalLongSymbol" SG_ 2147548597 Emission_Related_Previously_MIL_ "Emission_Related_Previously_MIL__RawPayload";
BA_ "SystemSignalLongSymbol" SG_ 2147548600 Diagnostic_Readiness_3_RawPayloa "Diagnostic_Readiness_3_RawPayload";
BA_ "SystemSignalLongSymbol" SG_ 2147548601 Tire_Pressure_Reference_Informat "Tire_Pressure_Reference_Informat_RawPayload";
BA_ "SystemSignalLongSymbol" SG_ 2147548604 Farebox_Service_Detail_RawPayloa "Farebox_Service_Detail_RawPayload";
BA_ "SystemSignalLongSymbol" SG_ 2147548609 Engine_Fluid_Level_Pressure_3_Ra "Engine_Fluid_Level_Pressure_3_RawPayload";
BA_ "SystemSignalLongSymbol" SG_ 2147548610 Electronic_Engine_Controller_14_ "Electronic_Engine_Controller_14_RawPayload";
BA_ "SystemSignalLongSymbol" SG_ 2147548611 Electronic_Engine_Controller_15_ "Electronic_Engine_Controller_15_RawPayload";
BA_ "SystemSignalLongSymbol" SG_ 2147548612 Electronic_Brake_Controller_5_Ra "Electronic_Brake_Controller_5_RawPayload";
BA_ "SystemSignalLongSymbol" SG_ 2147548615 Off_Highway_Engine_Control_Selec "Off_Highway_Engine_Control_Selec_RawPayload";
BA_ "SystemSignalLongSymbol" SG_ 2147548616 Operator_Primary_Intermediate_Sp "Operator_Primary_Intermediate_Sp_RawPayload";
BA_ "SystemSignalLongSymbol" SG_ 2147548617 Electronic_Control_Module_Inform "Electronic_Control_Module_Inform_RawPayload";
BA_ "SystemSignalLongSymbol" SG_ 2147548618 Intermediate_Speed_Control_RawPa "Intermediate_Speed_Control_RawPayload";
BA_ "SystemSignalLongSymbol" SG_ 2147548619 Off_Highway_Engine_Control_Selec "Off_Highway_Engine_Control_Selec_RawPayload";
BA_ "SystemSignalLongSymbol" SG_ 2147548620 Operators_External_Light_Control "Operators_External_Light_Control_RawPayload";
BA_ "SystemSignalLongSymbol" SG_ 2147548621 Operator_Wiper_and_Washer_Contro "Operator_Wiper_and_Washer_Contro_RawPayload";
BA_ "SystemSignalLongSymbol" SG_ 2147548622 Working_Set_Member_Message_Obsol "Working_Set_Member_Message_Obsol_RawPayload";
BA_ "SystemSignalLongSymbol" SG_ 2147548623 Working_Set_Master_Message_Obsol "Working_Set_Master_Message_Obsol_RawPayload";
BA_ "SystemSignalLongSymbol" SG_ 2147548624 Intake_Exhaust_Conditions_2_RawP "Intake_Exhaust_Conditions_2_RawPayload";
BA_ "SystemSignalLongSymbol" SG_ 2147548625 FMS_standard_Interface_Identity_ "FMS_standard_Interface_Identity__RawPayload";
BA_ "SystemSignalLongSymbol" SG_ 2147548627 Turbocharger_Information_6_RawPa "Turbocharger_Information_6_RawPayload";
BA_ "SystemSignalLongSymbol" SG_ 2147548629 Electronic_Engine_Controller_5_R "Electronic_Engine_Controller_5_RawPayload";
BA_ "SystemSignalLongSymbol" SG_ 2147548630 Basic_Joystick_Message_1_RawPayl "Basic_Joystick_Message_1_RawPayload";
BA_ "SystemSignalLongSymbol" SG_ 2147548631 Extended_Joystick_Message_1_RawP "Extended_Joystick_Message_1_RawPayload";
BA_ "SystemSignalLongSymbol" SG_ 2147548632 Basic_Joystick_Message_2_RawPayl "Basic_Joystick_Message_2_RawPayload";
BA_ "SystemSignalLongSymbol" SG_ 2147548633 Extended_Joystick_Message_2_RawP "Extended_Joystick_Message_2_RawPayload";
BA_ "SystemSignalLongSymbol" SG_ 2147548634 Basic_Joystick_Message_3_RawPayl "Basic_Joystick_Message_3_RawPayload";
BA_ "SystemSignalLongSymbol" SG_ 2147548635 Extended_Joystick_Message_3_RawP "Extended_Joystick_Message_3_RawPayload";
BA_ "SystemSignalLongSymbol" SG_ 2147548636 Marine_Control_Information_RawPa "Marine_Control_Information_RawPayload";
BA_ "SystemSignalLongSymbol" SG_ 2147548637 Military_Application_Message_1_1 "Military_Application_Message_1_1_RawPayload";
BA_ "SystemSignalLongSymbol" SG_ 2147548638 Military_Application_Message_2_1 "Military_Application_Message_2_1_RawPayload";
BA_ "SystemSignalLongSymbol" SG_ 2147548639 Front_Wheel_Drive_Status_RawPayl "Front_Wheel_Drive_Status_RawPayload";
BA_ "SystemSignalLongSymbol" SG_ 2147548641 Cab_Climate_System_Information_1 "Cab_Climate_System_Information_1_RawPayload";
BA_ "SystemSignalLongSymbol" SG_ 2147548642 Supply_Pressure_Demand_RawPayloa "Supply_Pressure_Demand_RawPayload";
BA_ "SystemSignalLongSymbol" SG_ 2147548643 Equipment_Operation_and_Control_ "Equipment_Operation_and_Control_RawPayload";
BA_ "SystemSignalLongSymbol" SG_ 2147548644 Equipment_Performance_Data_RawPa "Equipment_Performance_Data_RawPayload";
BA_ "SystemSignalLongSymbol" SG_ 2147548645 Maximum_Vehicle_Speed_Limit_Stat "Maximum_Vehicle_Speed_Limit_Stat_RawPayload";
BA_ "SystemSignalLongSymbol" SG_ 2147548646 Hydraulic_Braking_System_RawPayl "Hydraulic_Braking_System_RawPayload";
BA_ "SystemSignalLongSymbol" SG_ 2147548647 Bus_1_Utility_Sync_Check_Status_ "Bus_1_Utility_Sync_Check_Status_RawPayload";
BA_ "SystemSignalLongSymbol" SG_ 2147548648 Bus_1_Generator_Sync_Check_Statu "Bus_1_Generator_Sync_Check_Statu_RawPayload";
BA_ "SystemSignalLongSymbol" SG_ 2147548649 Bus_1_Phase_C_Basic_AC_Quantitie "Bus_1_Phase_C_Basic_AC_Quantitie_RawPayload";
BA_ "SystemSignalLongSymbol" SG_ 2147548650 Bus_1_Phase_B_Basic_AC_Quantitie "Bus_1_Phase_B_Basic_AC_Quantitie_RawPayload";
BA_ "SystemSignalLongSymbol" SG_ 2147548651 Bus_1_Phase_A_Basic_AC_Quantitie "Bus_1_Phase_A_Basic_AC_Quantitie_RawPayload";
BA_ "SystemSignalLongSymbol" SG_ 2147548652 Bus_1_Average_Basic_AC_Quantitie "Bus_1_Average_Basic_AC_Quantitie_RawPayload";
BA_ "SystemSignalLongSymbol" SG_ 2147548653 Utility_Total_AC_Energy_RawPaylo "Utility_Total_AC_Energy_RawPayload";
BA_ "SystemSignalLongSymbol" SG_ 2147548654 Utility_Phase_C_AC_Reactive_Powe "Utility_Phase_C_AC_Reactive_Powe_RawPayload";
BA_ "SystemSignalLongSymbol" SG_ 2147548655 Utility_Phase_C_AC_Power_RawPayl "Utility_Phase_C_AC_Power_RawPayload";
BA_ "SystemSignalLongSymbol" SG_ 2147548656 Utility_Phase_C_AC_Basic_Quantit "Utility_Phase_C_AC_Basic_Quantit_RawPayload";
BA_ "SystemSignalLongSymbol" SG_ 2147548657 Utility_Phase_B_AC_Reactive_Powe "Utility_Phase_B_AC_Reactive_Powe_RawPayload";
BA_ "SystemSignalLongSymbol" SG_ 2147548658 Utility_Phase_B_AC_Power_RawPayl "Utility_Phase_B_AC_Power_RawPayload";
BA_ "SystemSignalLongSymbol" SG_ 2147548659 Utility_Phase_B_AC_Basic_Quantit "Utility_Phase_B_AC_Basic_Quantit_RawPayload";
BA_ "SystemSignalLongSymbol" SG_ 2147548660 Utility_Phase_A_AC_Reactive_Powe "Utility_Phase_A_AC_Reactive_Powe_RawPayload";
BA_ "SystemSignalLongSymbol" SG_ 2147548661 Utility_Phase_A_AC_Power_RawPayl "Utility_Phase_A_AC_Power_RawPayload";
BA_ "SystemSignalLongSymbol" SG_ 2147548662 Utility_Phase_A_Basic_AC_Quantit "Utility_Phase_A_Basic_AC_Quantit_RawPayload";
BA_ "SystemSignalLongSymbol" SG_ 2147548663 Utility_Total_AC_Reactive_Power_ "Utility_Total_AC_Reactive_Power_RawPayload";
BA_ "SystemSignalLongSymbol" SG_ 2147548664 Utility_Total_AC_Power_RawPayloa "Utility_Total_AC_Power_RawPayload";
BA_ "SystemSignalLongSymbol" SG_ 2147548665 Utility_Average_Basic_AC_Quantit "Utility_Average_Basic_AC_Quantit_RawPayload";
BA_ "SystemSignalLongSymbol" SG_ 2147548666 Generator_Total_AC_Energy_RawPay "Generator_Total_AC_Energy_RawPayload";
BA_ "SystemSignalLongSymbol" SG_ 2147548667 Generator_Phase_C_AC_Reactive_Po "Generator_Phase_C_AC_Reactive_Po_RawPayload";
BA_ "SystemSignalLongSymbol" SG_ 2147548668 Generator_Phase_C_AC_Power_RawPa "Generator_Phase_C_AC_Power_RawPayload";
BA_ "SystemSignalLongSymbol" SG_ 2147548669 Generator_Phase_C_Basic_AC_Quant "Generator_Phase_C_Basic_AC_Quant_RawPayload";
BA_ "SystemSignalLongSymbol" SG_ 2147548670 Generator_Phase_B_AC_Reactive_Po "Generator_Phase_B_AC_Reactive_Po_RawPayload";
BA_ "SystemSignalLongSymbol" SG_ 2147548671 Generator_Phase_B_AC_Power_RawPa "Generator_Phase_B_AC_Power_RawPayload";
BA_ "SystemSignalLongSymbol" SG_ 2147548672 Generator_Phase_B_Basic_AC_Quant "Generator_Phase_B_Basic_AC_Quant_RawPayload";
BA_ "SystemSignalLongSymbol" SG_ 2147548673 Generator_Phase_A_AC_Reactive_Po "Generator_Phase_A_AC_Reactive_Po_RawPayload";
BA_ "SystemSignalLongSymbol" SG_ 2147548674 Generator_Phase_A_AC_Power_RawPa "Generator_Phase_A_AC_Power_RawPayload";
BA_ "SystemSignalLongSymbol" SG_ 2147548675 Generator_Phase_A_Basic_AC_Quant "Generator_Phase_A_Basic_AC_Quant_RawPayload";
BA_ "SystemSignalLongSymbol" SG_ 2147548676 Generator_Total_AC_Reactive_Powe "Generator_Total_AC_Reactive_Powe_RawPayload";
BA_ "SystemSignalLongSymbol" SG_ 2147548677 Generator_Total_AC_Power_RawPayl "Generator_Total_AC_Power_RawPayload";
BA_ "SystemSignalLongSymbol" SG_ 2147548678 Generator_Average_Basic_AC_Quant "Generator_Average_Basic_AC_Quant_RawPayload";
BA_ "SystemSignalLongSymbol" SG_ 2147548680 Required_Tractor_Facilities_mess "Required_Tractor_Facilities_mess_RawPayload";
BA_ "SystemSignalLongSymbol" SG_ 2147548681 Tractor_Facilities_response_mess "Tractor_Facilities_response_mess_RawPayload";
BA_ "SystemSignalLongSymbol" SG_ 2147548682 Tractor_control_command_tractor_ "Tractor_control_command_tractor__RawPayload";
