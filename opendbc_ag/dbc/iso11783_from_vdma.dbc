VERSION "created by canmatrix"

NS_ :

BS_: 250000

BU_:

BO_ 2147483904 VDMA_100_Transmission_Control_1: 8 Vector__XXX
 SG_ Transmission_Control_1_RawPayloa : 0|64@1+ (1,0) [0|18446744073709551615] "" Vector__XXX

BO_ 2147484160 VDMA_200_Electronic_Brake_System: 8 Vector__XXX
 SG_ Electronic_Brake_System_1_1_RawP : 0|64@1+ (1,0) [0|18446744073709551615] "" Vector__XXX

BO_ 2147484416 VDMA_300_Electronic_Brake_System: 8 Vector__XXX
 SG_ Electronic_Brake_System_2_1_RawP : 0|64@1+ (1,0) [0|18446744073709551615] "" Vector__XXX

BO_ 2147484672 VDMA_400_External_Brake_Request: 8 Vector__XXX
 SG_ External_Brake_Request_RawPayloa : 0|64@1+ (1,0) [0|18446744073709551615] "" Vector__XXX

BO_ 2147484928 VDMA_500_CANopen_Application_Mes: 8 Vector__XXX
 SG_ CANopen_Application_Message_1_1_ : 0|64@1+ (1,0) [0|18446744073709551615] "" Vector__XXX

BO_ 2147485184 VDMA_600_CANopen_Application_Mes: 8 Vector__XXX
 SG_ CANopen_Application_Message_2_1_ : 0|64@1+ (1,0) [0|18446744073709551615] "" Vector__XXX

BO_ 2147485440 VDMA_700_General_Purpose_Valve_P: 8 Vector__XXX
 SG_ General_Purpose_Valve_Pressure_R : 0|64@1+ (1,0) [0|18446744073709551615] "" Vector__XXX

BO_ 2147485696 VDMA_800_Auxiliary_Input_Output_: 8 Vector__XXX
 SG_ Auxiliary_Input_Output_Status_5_ : 0|64@1+ (1,0) [0|18446744073709551615] "" Vector__XXX

BO_ 2147485952 VDMA_900_Static_Roll_Angle_Senso: 8 Vector__XXX
 SG_ Static_Roll_Angle_Sensor_Informa : 0|64@1+ (1,0) [0|18446744073709551615] "" Vector__XXX

BO_ 2147486208 VDMA_A00_Cruise_Control_Vehicle_: 8 Vector__XXX
 SG_ Cruise_Control_Vehicle_Speed_2_R : 0|64@1+ (1,0) [0|18446744073709551615] "" Vector__XXX

BO_ 2147486464 VDMA_B00_Advanced_Emergency_Brak: 8 Vector__XXX
 SG_ Advanced_Emergency_Braking_Syste : 0|64@1+ (1,0) [0|18446744073709551615] "" Vector__XXX

BO_ 2147486720 VDMA_C00_Electronic_Engine_Contr: 8 Vector__XXX
 SG_ Electronic_Engine_Controller_16_ : 0|64@1+ (1,0) [0|18446744073709551615] "" Vector__XXX

BO_ 2147486976 VDMA_D00_Transmission_Control_2: 8 Vector__XXX
 SG_ Transmission_Control_2_RawPayloa : 0|64@1+ (1,0) [0|18446744073709551615] "" Vector__XXX

BO_ 2147487232 VDMA_E00_Safety_Header_Message: 8 Vector__XXX
 SG_ Safety_Header_Message_RawPayload : 0|64@1+ (1,0) [0|18446744073709551615] "" Vector__XXX

BO_ 2147487488 VDMA_F00_High_Voltage_Energy_Sto: 8 Vector__XXX
 SG_ High_Voltage_Energy_Storage_Pack : 0|64@1+ (1,0) [0|18446744073709551615] "" Vector__XXX

BO_ 2147487744 VDMA_1000_High_Voltage_Energy_St: 8 Vector__XXX
 SG_ High_Voltage_Energy_Storage_Pack : 0|64@1+ (1,0) [0|18446744073709551615] "" Vector__XXX

BO_ 2147488000 VDMA_1100_High_Voltage_Energy_St: 8 Vector__XXX
 SG_ High_Voltage_Energy_Storage_Pack : 0|64@1+ (1,0) [0|18446744073709551615] "" Vector__XXX

BO_ 2147488256 VDMA_1200_High_Voltage_Energy_St: 8 Vector__XXX
 SG_ High_Voltage_Energy_Storage_Pack : 0|64@1+ (1,0) [0|18446744073709551615] "" Vector__XXX

BO_ 2147488512 VDMA_1300_High_Voltage_Energy_St: 8 Vector__XXX
 SG_ High_Voltage_Energy_Storage_Pack : 0|64@1+ (1,0) [0|18446744073709551615] "" Vector__XXX

BO_ 2147488768 VDMA_1400_High_Voltage_Energy_St: 8 Vector__XXX
 SG_ High_Voltage_Energy_Storage_Pack : 0|64@1+ (1,0) [0|18446744073709551615] "" Vector__XXX

BO_ 2147489024 VDMA_1500_High_Voltage_Energy_St: 8 Vector__XXX
 SG_ High_Voltage_Energy_Storage_Pack : 0|64@1+ (1,0) [0|18446744073709551615] "" Vector__XXX

BO_ 2147489280 VDMA_1600_High_Voltage_Energy_St: 8 Vector__XXX
 SG_ High_Voltage_Energy_Storage_Pack : 0|64@1+ (1,0) [0|18446744073709551615] "" Vector__XXX

BO_ 2147489536 VDMA_1700_High_Voltage_Energy_St: 8 Vector__XXX
 SG_ High_Voltage_Energy_Storage_Pack : 0|64@1+ (1,0) [0|18446744073709551615] "" Vector__XXX

BO_ 2147489792 VDMA_1800_High_Voltage_Energy_St: 8 Vector__XXX
 SG_ High_Voltage_Energy_Storage_Pack : 0|64@1+ (1,0) [0|18446744073709551615] "" Vector__XXX

BO_ 2147490048 VDMA_1900_High_Voltage_Energy_St: 8 Vector__XXX
 SG_ High_Voltage_Energy_Storage_Pack : 0|64@1+ (1,0) [0|18446744073709551615] "" Vector__XXX

BO_ 2147490304 VDMA_1A00_High_Voltage_Energy_St: 8 Vector__XXX
 SG_ High_Voltage_Energy_Storage_Pack : 0|64@1+ (1,0) [0|18446744073709551615] "" Vector__XXX

BO_ 2147490560 VDMA_1B00_High_Voltage_Energy_St: 8 Vector__XXX
 SG_ High_Voltage_Energy_Storage_Syst : 0|64@1+ (1,0) [0|18446744073709551615] "" Vector__XXX

BO_ 2147490816 VDMA_1C00_Transmission_Control_3: 8 Vector__XXX
 SG_ Transmission_Control_3_Obsolete_ : 0|64@1+ (1,0) [0|18446744073709551615] "" Vector__XXX

BO_ 2147491072 VDMA_1D00_Engine_Ignition_Contro: 8 Vector__XXX
 SG_ Engine_Ignition_Controller_RawPa : 0|64@1+ (1,0) [0|18446744073709551615] "" Vector__XXX

BO_ 2147491328 VDMA_1E00_Alternator_Control: 8 Vector__XXX
 SG_ Alternator_Control_RawPayload : 0|64@1+ (1,0) [0|18446744073709551615] "" Vector__XXX

BO_ 2147491584 VDMA_1F00_High_Voltage_Energy_St: 8 Vector__XXX
 SG_ High_Voltage_Energy_Storage_Pack : 0|64@1+ (1,0) [0|18446744073709551615] "" Vector__XXX

BO_ 2147491840 VDMA_2000_High_Voltage_Energy_St: 8 Vector__XXX
 SG_ High_Voltage_Energy_Storage_Pack : 0|64@1+ (1,0) [0|18446744073709551615] "" Vector__XXX

BO_ 2147492096 VDMA_2100_High_Voltage_Energy_St: 8 Vector__XXX
 SG_ High_Voltage_Energy_Storage_Pack : 0|64@1+ (1,0) [0|18446744073709551615] "" Vector__XXX

BO_ 2147492352 VDMA_2200_High_Voltage_Energy_St: 8 Vector__XXX
 SG_ High_Voltage_Energy_Storage_Pack : 0|64@1+ (1,0) [0|18446744073709551615] "" Vector__XXX

BO_ 2147492608 VDMA_2300_Tractor_Implement_Mana: 8 Vector__XXX
 SG_ Tractor_Implement_Management_TIM : 0|64@1+ (1,0) [0|18446744073709551615] "" Vector__XXX

BO_ 2147492864 VDMA_2400_Tractor_Implement_Mana: 8 Vector__XXX
 SG_ Tractor_Implement_Management_TIM : 0|64@1+ (1,0) [0|18446744073709551615] "" Vector__XXX

BO_ 2147493120 VDMA_2500_Multi_PG: 8 Vector__XXX
 SG_ Multi_PG_RawPayload : 0|64@1+ (1,0) [0|18446744073709551615] "" Vector__XXX

BO_ 2147493376 VDMA_2600_Motor_Generator_1_Inve: 8 Vector__XXX
 SG_ Motor_Generator_1_Inverter_Contr : 0|64@1+ (1,0) [0|18446744073709551615] "" Vector__XXX

BO_ 2147493632 VDMA_2700_Motor_Generator_2_Inve: 8 Vector__XXX
 SG_ Motor_Generator_2_Inverter_Contr : 0|64@1+ (1,0) [0|18446744073709551615] "" Vector__XXX

BO_ 2147493888 VDMA_2800_Motor_Generator_1_Inve: 8 Vector__XXX
 SG_ Motor_Generator_1_Inverter_Rate_ : 0|64@1+ (1,0) [0|18446744073709551615] "" Vector__XXX

BO_ 2147494144 VDMA_2900_Motor_Generator_2_Inve: 8 Vector__XXX
 SG_ Motor_Generator_2_Inverter_Rate_ : 0|64@1+ (1,0) [0|18446744073709551615] "" Vector__XXX

BO_ 2147494400 VDMA_2A00_High_Voltage_Energy_St: 8 Vector__XXX
 SG_ High_Voltage_Energy_Storage_Pack : 0|64@1+ (1,0) [0|18446744073709551615] "" Vector__XXX

BO_ 2147494656 VDMA_2B00_High_Voltage_Energy_St: 8 Vector__XXX
 SG_ High_Voltage_Energy_Storage_Pack : 0|64@1+ (1,0) [0|18446744073709551615] "" Vector__XXX

BO_ 2147494912 VDMA_2C00_High_Voltage_Energy_St: 8 Vector__XXX
 SG_ High_Voltage_Energy_Storage_Pack : 0|64@1+ (1,0) [0|18446744073709551615] "" Vector__XXX

BO_ 2147495168 VDMA_2D00_High_Voltage_Energy_St: 8 Vector__XXX
 SG_ High_Voltage_Energy_Storage_Pack : 0|64@1+ (1,0) [0|18446744073709551615] "" Vector__XXX

BO_ 2147495424 VDMA_2E00_High_Voltage_Energy_St: 8 Vector__XXX
 SG_ High_Voltage_Energy_Storage_Pack : 0|64@1+ (1,0) [0|18446744073709551615] "" Vector__XXX

BO_ 2147495680 VDMA_2F00_High_Voltage_Energy_St: 8 Vector__XXX
 SG_ High_Voltage_Energy_Storage_Pack : 0|64@1+ (1,0) [0|18446744073709551615] "" Vector__XXX

BO_ 2147495936 VDMA_3000_High_Voltage_Energy_St: 8 Vector__XXX
 SG_ High_Voltage_Energy_Storage_Pack : 0|64@1+ (1,0) [0|18446744073709551615] "" Vector__XXX

BO_ 2147496192 VDMA_3100_High_Voltage_Energy_St: 8 Vector__XXX
 SG_ High_Voltage_Energy_Storage_Pack : 0|64@1+ (1,0) [0|18446744073709551615] "" Vector__XXX

BO_ 2147496448 VDMA_3200_High_Voltage_Energy_St: 8 Vector__XXX
 SG_ High_Voltage_Energy_Storage_Pack : 0|64@1+ (1,0) [0|18446744073709551615] "" Vector__XXX

BO_ 2147496704 VDMA_3300_High_Voltage_Energy_St: 8 Vector__XXX
 SG_ High_Voltage_Energy_Storage_Pack : 0|64@1+ (1,0) [0|18446744073709551615] "" Vector__XXX

BO_ 2147496960 VDMA_3400_Reliable_Long_Message: 8 Vector__XXX
 SG_ Reliable_Long_Message_RawPayload : 0|64@1+ (1,0) [0|18446744073709551615] "" Vector__XXX

BO_ 2147497216 VDMA_3500_Reliable_Short_Message: 8 Vector__XXX
 SG_ Reliable_Short_Message_RawPayloa : 0|64@1+ (1,0) [0|18446744073709551615] "" Vector__XXX

BO_ 2147497472 VDMA_3600_Unreliable_Message: 8 Vector__XXX
 SG_ Unreliable_Message_RawPayload : 0|64@1+ (1,0) [0|18446744073709551615] "" Vector__XXX

BO_ 2147497728 VDMA_3700_Message_Acknowledgemen: 8 Vector__XXX
 SG_ Message_Acknowledgement_RawPaylo : 0|64@1+ (1,0) [0|18446744073709551615] "" Vector__XXX

BO_ 2147497984 VDMA_3800_Version_Negotiation_Se: 8 Vector__XXX
 SG_ Version_Negotiation_Section_RawP : 0|64@1+ (1,0) [0|18446744073709551615] "" Vector__XXX

BO_ 2147498240 VDMA_3900_External_ACC_Accelerat: 8 Vector__XXX
 SG_ External_ACC_Acceleration_Reques : 0|64@1+ (1,0) [0|18446744073709551615] "" Vector__XXX

BO_ 2147498496 VDMA_3A00_Battery_Charger_1_Comm: 8 Vector__XXX
 SG_ Battery_Charger_1_Command_1_RawP : 0|64@1+ (1,0) [0|18446744073709551615] "" Vector__XXX

BO_ 2147498752 VDMA_3B00_Battery_Charger_2_Comm: 8 Vector__XXX
 SG_ Battery_Charger_2_Command_1_RawP : 0|64@1+ (1,0) [0|18446744073709551615] "" Vector__XXX

BO_ 2147499008 VDMA_3C00_Tractor_Implement_Mana: 8 Vector__XXX
 SG_ Tractor_Implement_Management_TIM : 0|64@1+ (1,0) [0|18446744073709551615] "" Vector__XXX

BO_ 2147499264 VDMA_3D00_Tractor_Implement_Mana: 8 Vector__XXX
 SG_ Tractor_Implement_Management_TIM : 0|64@1+ (1,0) [0|18446744073709551615] "" Vector__XXX

BO_ 2147499520 VDMA_3E00_Fuel_Cell_System_Contr: 8 Vector__XXX
 SG_ Fuel_Cell_System_Control_Command : 0|64@1+ (1,0) [0|18446744073709551615] "" Vector__XXX

BO_ 2147499776 VDMA_3F00_Fuel_Cell_System_Power: 8 Vector__XXX
 SG_ Fuel_Cell_System_Power_Limit_Com : 0|64@1+ (1,0) [0|18446744073709551615] "" Vector__XXX

BO_ 2147500032 VDMA_4000_Fuel_Cell_System_Curre: 8 Vector__XXX
 SG_ Fuel_Cell_System_Current_Limit_C : 0|64@1+ (1,0) [0|18446744073709551615] "" Vector__XXX

BO_ 2147500288 VDMA_4100_Hydrogen_Storage_Syste: 8 Vector__XXX
 SG_ Hydrogen_Storage_System_Control_ : 0|64@1+ (1,0) [0|18446744073709551615] "" Vector__XXX

BO_ 2147500544 VDMA_4200_Transmission_Control_4: 8 Vector__XXX
 SG_ Transmission_Control_4_RawPayloa : 0|64@1+ (1,0) [0|18446744073709551615] "" Vector__XXX

BO_ 2147500800 VDMA_4300_Safety_Header_Message_: 8 Vector__XXX
 SG_ Safety_Header_Message_2_RawPaylo : 0|64@1+ (1,0) [0|18446744073709551615] "" Vector__XXX

BO_ 2147501568 VDMA_4600_API_Select: 8 Vector__XXX
 SG_ API_Select_RawPayload : 0|64@1+ (1,0) [0|18446744073709551615] "" Vector__XXX

BO_ 2147502080 VDMA_4800_Tractor_Implement_Mana: 8 Vector__XXX
 SG_ Tractor_Implement_Management_TIM : 0|64@1+ (1,0) [0|18446744073709551615] "" Vector__XXX

BO_ 2147502336 VDMA_4900_Tractor_Implement_Mana: 8 Vector__XXX
 SG_ Tractor_Implement_Management_TIM : 0|64@1+ (1,0) [0|18446744073709551615] "" Vector__XXX

BO_ 2147502592 VDMA_4A00_EV_Multi_Connection_DC: 8 Vector__XXX
 SG_ EV_Multi_Connection_DC_Status_1_ : 0|64@1+ (1,0) [0|18446744073709551615] "" Vector__XXX

BO_ 2147502848 VDMA_4B00_EV_Multi_Connection_DC: 8 Vector__XXX
 SG_ EV_Multi_Connection_DC_Charging_ : 0|64@1+ (1,0) [0|18446744073709551615] "" Vector__XXX

BO_ 2147503104 VDMA_4C00_Electrified_Accessory_: 8 Vector__XXX
 SG_ Electrified_Accessory_Engine_Coo : 0|64@1+ (1,0) [0|18446744073709551615] "" Vector__XXX

BO_ 2147503360 VDMA_4D00_FD_Transport_Protocol_: 8 Vector__XXX
 SG_ FD_Transport_Protocol_Connection : 0|64@1+ (1,0) [0|18446744073709551615] "" Vector__XXX

BO_ 2147503616 VDMA_4E00_FD_Transport_Protocol_: 8 Vector__XXX
 SG_ FD_Transport_Protocol_Data_Trans : 0|64@1+ (1,0) [0|18446744073709551615] "" Vector__XXX

BO_ 2147503872 VDMA_4F00_Data_Transfer_Support: 8 Vector__XXX
 SG_ Data_Transfer_Support_RawPayload : 0|64@1+ (1,0) [0|18446744073709551615] "" Vector__XXX

BO_ 2147504128 VDMA_5000_Monthly_Data_Transfer: 8 Vector__XXX
 SG_ Monthly_Data_Transfer_RawPayload : 0|64@1+ (1,0) [0|18446744073709551615] "" Vector__XXX

BO_ 2147504384 VDMA_5100_Weekly_Data_Transfer: 8 Vector__XXX
 SG_ Weekly_Data_Transfer_RawPayload : 0|64@1+ (1,0) [0|18446744073709551615] "" Vector__XXX

BO_ 2147504640 VDMA_5200_Daily_Data_Transfer: 8 Vector__XXX
 SG_ Daily_Data_Transfer_RawPayload : 0|64@1+ (1,0) [0|18446744073709551615] "" Vector__XXX

BO_ 2147504896 VDMA_5300_EVSE_Control_1: 8 Vector__XXX
 SG_ EVSE_Control_1_RawPayload : 0|64@1+ (1,0) [0|18446744073709551615] "" Vector__XXX

BO_ 2147505152 VDMA_5400_Winch_Information_3: 8 Vector__XXX
 SG_ Winch_Information_3_RawPayload : 0|64@1+ (1,0) [0|18446744073709551615] "" Vector__XXX

BO_ 2147505408 VDMA_5500_Air_Suspension_Control: 8 Vector__XXX
 SG_ Air_Suspension_Control_8_RawPayl : 0|64@1+ (1,0) [0|18446744073709551615] "" Vector__XXX

BO_ 2147505664 VDMA_5600_Motor_Generator_2_Inve: 8 Vector__XXX
 SG_ Motor_Generator_2_Inverter_Contr : 0|64@1+ (1,0) [0|18446744073709551615] "" Vector__XXX

BO_ 2147505920 VDMA_5700_Motor_Generator_1_Inve: 8 Vector__XXX
 SG_ Motor_Generator_1_Inverter_Contr : 0|64@1+ (1,0) [0|18446744073709551615] "" Vector__XXX

BO_ 2147506176 VDMA_5800_Hoist_Command_Informat: 8 Vector__XXX
 SG_ Hoist_Command_Information_RawPay : 0|64@1+ (1,0) [0|18446744073709551615] "" Vector__XXX

BO_ 2147506432 VDMA_5900_Motor_Generator_2_Inve: 8 Vector__XXX
 SG_ Motor_Generator_2_Inverter_Isola : 0|64@1+ (1,0) [0|18446744073709551615] "" Vector__XXX

BO_ 2147506688 VDMA_5A00_Motor_Generator_1_Inve: 8 Vector__XXX
 SG_ Motor_Generator_1_Inverter_Isola : 0|64@1+ (1,0) [0|18446744073709551615] "" Vector__XXX

BO_ 2147506944 VDMA_5B00_Motor_Generator_2_Inve: 8 Vector__XXX
 SG_ Motor_Generator_2_Inverter_Limit : 0|64@1+ (1,0) [0|18446744073709551615] "" Vector__XXX

BO_ 2147507200 VDMA_5C00_Motor_Generator_2_Inve: 8 Vector__XXX
 SG_ Motor_Generator_2_Inverter_Limit : 0|64@1+ (1,0) [0|18446744073709551615] "" Vector__XXX

BO_ 2147507456 VDMA_5D00_Motor_Generator_2_Inve: 8 Vector__XXX
 SG_ Motor_Generator_2_Inverter_Limit : 0|64@1+ (1,0) [0|18446744073709551615] "" Vector__XXX

BO_ 2147507712 VDMA_5E00_Motor_Generator_1_Inve: 8 Vector__XXX
 SG_ Motor_Generator_1_Inverter_Limit : 0|64@1+ (1,0) [0|18446744073709551615] "" Vector__XXX

BO_ 2147507968 VDMA_5F00_Motor_Generator_1_Inve: 8 Vector__XXX
 SG_ Motor_Generator_1_Inverter_Limit : 0|64@1+ (1,0) [0|18446744073709551615] "" Vector__XXX

BO_ 2147508224 VDMA_6000_Motor_Generator_1_Inve: 8 Vector__XXX
 SG_ Motor_Generator_1_Inverter_Limit : 0|64@1+ (1,0) [0|18446744073709551615] "" Vector__XXX

BO_ 2147508480 VDMA_6100_Personnel_Detect_Inter: 8 Vector__XXX
 SG_ Personnel_Detect_Interlock_RawPa : 0|64@1+ (1,0) [0|18446744073709551615] "" Vector__XXX

BO_ 2147508736 VDMA_6200_Engine_Cylinder_Combus: 8 Vector__XXX
 SG_ Engine_Cylinder_Combustion_Confi : 0|64@1+ (1,0) [0|18446744073709551615] "" Vector__XXX

BO_ 2147508992 VDMA_6300_Engine_Cylinder_Combus: 8 Vector__XXX
 SG_ Engine_Cylinder_Combustion_Confi : 0|64@1+ (1,0) [0|18446744073709551615] "" Vector__XXX

BO_ 2147509248 VDMA_6400_Engine_Cylinder_Pressu: 8 Vector__XXX
 SG_ Engine_Cylinder_Pressure_Timing_ : 0|64@1+ (1,0) [0|18446744073709551615] "" Vector__XXX

BO_ 2147509504 VDMA_6500_Engine_Cylinder_Pressu: 8 Vector__XXX
 SG_ Engine_Cylinder_Pressure_Timing_ : 0|64@1+ (1,0) [0|18446744073709551615] "" Vector__XXX

BO_ 2147509760 VDMA_6600_Electrified_Accessory_: 8 Vector__XXX
 SG_ Electrified_Accessory_Generator_ : 0|64@1+ (1,0) [0|18446744073709551615] "" Vector__XXX

BO_ 2147510016 VDMA_6700_Electrified_Accessory_: 8 Vector__XXX
 SG_ Electrified_Accessory_Generator_ : 0|64@1+ (1,0) [0|18446744073709551615] "" Vector__XXX

BO_ 2147510272 VDMA_6800_On_Board_Programming_1: 8 Vector__XXX
 SG_ On_Board_Programming_1_RawPayloa : 0|64@1+ (1,0) [0|18446744073709551615] "" Vector__XXX

BO_ 2147510528 VDMA_6900_Marine_Control_Informa: 8 Vector__XXX
 SG_ Marine_Control_Information_Confi : 0|64@1+ (1,0) [0|18446744073709551615] "" Vector__XXX

BO_ 2147510784 VDMA_6A00_Marine_Control_Informa: 8 Vector__XXX
 SG_ Marine_Control_Information_2_Raw : 0|64@1+ (1,0) [0|18446744073709551615] "" Vector__XXX

BO_ 2147511040 VDMA_6B00_Well_Stimulation_Pump_: 8 Vector__XXX
 SG_ Well_Stimulation_Pump_Sensor_Cal : 0|64@1+ (1,0) [0|18446744073709551615] "" Vector__XXX

BO_ 2147511296 VDMA_6C00_CiA_602_2_XCP_Obsolete: 8 Vector__XXX
 SG_ CiA_602_2_XCP_Obsolete_RawPayloa : 0|64@1+ (1,0) [0|18446744073709551615] "" Vector__XXX

BO_ 2147511552 VDMA_6D00_Well_Stimulation_Pump_: 8 Vector__XXX
 SG_ Well_Stimulation_Pump_System_Con : 0|64@1+ (1,0) [0|18446744073709551615] "" Vector__XXX

BO_ 2147511808 VDMA_6E00_Configurable_Receive_S: 8 Vector__XXX
 SG_ Configurable_Receive_SPNs_Comman : 0|64@1+ (1,0) [0|18446744073709551615] "" Vector__XXX

BO_ 2147512064 VDMA_6F00_Authentication_Client_: 8 Vector__XXX
 SG_ Authentication_Client_to_Authent : 0|64@1+ (1,0) [0|18446744073709551615] "" Vector__XXX

BO_ 2147512320 VDMA_7000_Authentication_Server_: 8 Vector__XXX
 SG_ Authentication_Server_to_Authent : 0|64@1+ (1,0) [0|18446744073709551615] "" Vector__XXX

BO_ 2147512576 VDMA_7100_Configurable_Transmit_: 8 Vector__XXX
 SG_ Configurable_Transmit_PGNs_Comma : 0|64@1+ (1,0) [0|18446744073709551615] "" Vector__XXX

BO_ 2147512832 VDMA_7200_Oil_Debris_Monitor_Con: 8 Vector__XXX
 SG_ Oil_Debris_Monitor_Configuration : 0|64@1+ (1,0) [0|18446744073709551615] "" Vector__XXX

BO_ 2147513088 VDMA_7300_Electrified_Accessory_: 8 Vector__XXX
 SG_ Electrified_Accessory_Propulsion : 0|64@1+ (1,0) [0|18446744073709551615] "" Vector__XXX

BO_ 2147513344 VDMA_7400_Electrified_Accessory_: 8 Vector__XXX
 SG_ Electrified_Accessory_Propulsion : 0|64@1+ (1,0) [0|18446744073709551615] "" Vector__XXX

BO_ 2147513600 VDMA_7500_Electrified_Accessory_: 8 Vector__XXX
 SG_ Electrified_Accessory_Propulsion : 0|64@1+ (1,0) [0|18446744073709551615] "" Vector__XXX

BO_ 2147513856 VDMA_7600_Electrified_Accessory_: 8 Vector__XXX
 SG_ Electrified_Accessory_Power_Elec : 0|64@1+ (1,0) [0|18446744073709551615] "" Vector__XXX

BO_ 2147514112 VDMA_7700_Electrified_Accessory_: 8 Vector__XXX
 SG_ Electrified_Accessory_Power_Elec : 0|64@1+ (1,0) [0|18446744073709551615] "" Vector__XXX

BO_ 2147514368 VDMA_7800_Electrified_Accessory_: 8 Vector__XXX
 SG_ Electrified_Accessory_Power_Elec : 0|64@1+ (1,0) [0|18446744073709551615] "" Vector__XXX

BO_ 2147514624 VDMA_7900_Electrified_Accessory_: 8 Vector__XXX
 SG_ Electrified_Accessory_Propulsion : 0|64@1+ (1,0) [0|18446744073709551615] "" Vector__XXX

BO_ 2147514880 VDMA_7A00_Electrified_Accessory_: 8 Vector__XXX
 SG_ Electrified_Accessory_Propulsion : 0|64@1+ (1,0) [0|18446744073709551615] "" Vector__XXX

BO_ 2147515136 VDMA_7B00_Electrified_Accessory_: 8 Vector__XXX
 SG_ Electrified_Accessory_Power_Elec : 0|64@1+ (1,0) [0|18446744073709551615] "" Vector__XXX

BO_ 2147515392 VDMA_7C00_Extended_Control_Funct: 8 Vector__XXX
 SG_ Extended_Control_Function_Functi : 0|64@1+ (1,0) [0|18446744073709551615] "" Vector__XXX

BO_ 2147515648 VDMA_7D00_Electrified_Accessory_: 8 Vector__XXX
 SG_ Electrified_Accessory_Motor_Comm : 0|64@1+ (1,0) [0|18446744073709551615] "" Vector__XXX

BO_ 2147515904 VDMA_7E00_Engine_Speed_Ramp_Rate: 8 Vector__XXX
 SG_ Engine_Speed_Ramp_Rate_Boundary_ : 0|64@1+ (1,0) [0|18446744073709551615] "" Vector__XXX

BO_ 2147516160 VDMA_7F00_Tire_Sensor_Identifica: 8 Vector__XXX
 SG_ Tire_Sensor_Identification_Comma : 0|64@1+ (1,0) [0|18446744073709551615] "" Vector__XXX

BO_ 2147516416 VDMA_8000_Hybrid_or_EV_System_Co: 8 Vector__XXX
 SG_ Hybrid_or_EV_System_Control_1_Ra : 0|64@1+ (1,0) [0|18446744073709551615] "" Vector__XXX

BO_ 2147516672 VDMA_8100_Aftertreatment_System_: 8 Vector__XXX
 SG_ Aftertreatment_System_Control_Ra : 0|64@1+ (1,0) [0|18446744073709551615] "" Vector__XXX

BO_ 2147516928 VDMA_8200_Tire_Configuration_Com: 8 Vector__XXX
 SG_ Tire_Configuration_Command_Infor : 0|64@1+ (1,0) [0|18446744073709551615] "" Vector__XXX

BO_ 2147517184 VDMA_8300_Payload_Calibration_In: 8 Vector__XXX
 SG_ Payload_Calibration_Information_ : 0|64@1+ (1,0) [0|18446744073709551615] "" Vector__XXX

BO_ 2147517440 VDMA_8400_Aftertreatment_1_Parti: 8 Vector__XXX
 SG_ Aftertreatment_1_Particulate_Sen : 0|64@1+ (1,0) [0|18446744073709551615] "" Vector__XXX

BO_ 2147517696 VDMA_8500_Cab_Message_2: 8 Vector__XXX
 SG_ Cab_Message_2_RawPayload : 0|64@1+ (1,0) [0|18446744073709551615] "" Vector__XXX

BO_ 2147517952 VDMA_8600_Switched_Power_Outputs: 8 Vector__XXX
 SG_ Switched_Power_Outputs_Command_R : 0|64@1+ (1,0) [0|18446744073709551615] "" Vector__XXX

BO_ 2147518208 VDMA_8700_Engine_State_Requests: 8 Vector__XXX
 SG_ Engine_State_Requests_RawPayload : 0|64@1+ (1,0) [0|18446744073709551615] "" Vector__XXX

BO_ 2147518464 VDMA_8800_Radio_Beacon_Request: 8 Vector__XXX
 SG_ Radio_Beacon_Request_RawPayload : 0|64@1+ (1,0) [0|18446744073709551615] "" Vector__XXX

BO_ 2147518720 VDMA_8900_Running_Gear_Equipment: 8 Vector__XXX
 SG_ Running_Gear_Equipment_2_4_RawPa : 0|64@1+ (1,0) [0|18446744073709551615] "" Vector__XXX

BO_ 2147518976 VDMA_8A00_Running_Gear_Equipment: 8 Vector__XXX
 SG_ Running_Gear_Equipment_1_2_RawPa : 0|64@1+ (1,0) [0|18446744073709551615] "" Vector__XXX

BO_ 2147519232 VDMA_8B00_CCP_Data_Transmission_: 8 Vector__XXX
 SG_ CCP_Data_Transmission_Object_Raw : 0|64@1+ (1,0) [0|18446744073709551615] "" Vector__XXX

BO_ 2147519488 VDMA_8C00_CCP_Command_Receive_Ob: 8 Vector__XXX
 SG_ CCP_Command_Receive_Object_RawPa : 0|64@1+ (1,0) [0|18446744073709551615] "" Vector__XXX

BO_ 2147519744 VDMA_8D00_Sequence_Control_Clien: 8 Vector__XXX
 SG_ Sequence_Control_Client_to_Seque : 0|64@1+ (1,0) [0|18446744073709551615] "" Vector__XXX

BO_ 2147520000 VDMA_8E00_Sequence_Control_Maste: 8 Vector__XXX
 SG_ Sequence_Control_Master_to_Seque : 0|64@1+ (1,0) [0|18446744073709551615] "" Vector__XXX

BO_ 2147520256 VDMA_8F00_Engine_Configuration_C: 8 Vector__XXX
 SG_ Engine_Configuration_Commands_Ra : 0|64@1+ (1,0) [0|18446744073709551615] "" Vector__XXX

BO_ 2147520512 VDMA_9000_Supplemental_Fan_Comma: 8 Vector__XXX
 SG_ Supplemental_Fan_Command_RawPayl : 0|64@1+ (1,0) [0|18446744073709551615] "" Vector__XXX

BO_ 2147520768 VDMA_9100_Vehicle_Chassis_Lubric: 8 Vector__XXX
 SG_ Vehicle_Chassis_Lubrication_Syst : 0|64@1+ (1,0) [0|18446744073709551615] "" Vector__XXX

BO_ 2147521024 VDMA_9200_Aftertreatment_1_Hydro: 8 Vector__XXX
 SG_ Aftertreatment_1_Hydrocarbon_Dos : 0|64@1+ (1,0) [0|18446744073709551615] "" Vector__XXX

BO_ 2147521280 VDMA_9300_NAME_Management_Messag: 8 Vector__XXX
 SG_ NAME_Management_Message_RawPaylo : 0|64@1+ (1,0) [0|18446744073709551615] "" Vector__XXX

BO_ 2147521536 VDMA_9400_Aftertreatment_1_Diese: 8 Vector__XXX
 SG_ Aftertreatment_1_Diesel_Particul : 0|64@1+ (1,0) [0|18446744073709551615] "" Vector__XXX

BO_ 2147521792 VDMA_9500_Aftertreatment_2_Diese: 8 Vector__XXX
 SG_ Aftertreatment_2_Diesel_Particul : 0|64@1+ (1,0) [0|18446744073709551615] "" Vector__XXX

BO_ 2147522048 VDMA_9600_Low_Voltage_Disconnect: 8 Vector__XXX
 SG_ Low_Voltage_Disconnect_Set_Opera : 0|64@1+ (1,0) [0|18446744073709551615] "" Vector__XXX

BO_ 2147522304 VDMA_9700_Noise_Control_Status: 8 Vector__XXX
 SG_ Noise_Control_Status_RawPayload : 0|64@1+ (1,0) [0|18446744073709551615] "" Vector__XXX

BO_ 2147522560 VDMA_9800_Noise_Control_1: 8 Vector__XXX
 SG_ Noise_Control_1_RawPayload : 0|64@1+ (1,0) [0|18446744073709551615] "" Vector__XXX

BO_ 2147522816 VDMA_9900_Joystick_Lamp_Command_: 8 Vector__XXX
 SG_ Joystick_Lamp_Command_Message_Ra : 0|64@1+ (1,0) [0|18446744073709551615] "" Vector__XXX

BO_ 2147523072 VDMA_9A00_General_Purpose_Messag: 8 Vector__XXX
 SG_ General_Purpose_Message_1_8_RawP : 0|64@1+ (1,0) [0|18446744073709551615] "" Vector__XXX

BO_ 2147523584 VDMA_9C00_Auxiliary_Input_Output: 8 Vector__XXX
 SG_ Auxiliary_Input_Output_Status_7_ : 0|64@1+ (1,0) [0|18446744073709551615] "" Vector__XXX

BO_ 2147523840 VDMA_9D00_Auxiliary_Input_Output: 8 Vector__XXX
 SG_ Auxiliary_Input_Output_Status_6_ : 0|64@1+ (1,0) [0|18446744073709551615] "" Vector__XXX

BO_ 2147524096 VDMA_9E00_DTC_Counts: 8 Vector__XXX
 SG_ DTC_Counts_RawPayload : 0|64@1+ (1,0) [0|18446744073709551615] "" Vector__XXX

BO_ 2147524352 VDMA_9F00_Immediate_Fault_Status: 8 Vector__XXX
 SG_ Immediate_Fault_Status_RawPayloa : 0|64@1+ (1,0) [0|18446744073709551615] "" Vector__XXX

BO_ 2147524608 VDMA_A000_NTE_Status: 8 Vector__XXX
 SG_ NTE_Status_RawPayload : 0|64@1+ (1,0) [0|18446744073709551615] "" Vector__XXX

BO_ 2147524864 VDMA_A100_Emission_Increasing_Au: 8 Vector__XXX
 SG_ Emission_Increasing_Auxiliary_Em : 0|64@1+ (1,0) [0|18446744073709551615] "" Vector__XXX

BO_ 2147525120 VDMA_A200_Regulated_Exhaust_Emis: 8 Vector__XXX
 SG_ Regulated_Exhaust_Emission_Level : 0|64@1+ (1,0) [0|18446744073709551615] "" Vector__XXX

BO_ 2147525376 VDMA_A300_DTC_To_Lamp_Associatio: 8 Vector__XXX
 SG_ DTC_To_Lamp_Association_RawPaylo : 0|64@1+ (1,0) [0|18446744073709551615] "" Vector__XXX

BO_ 2147525632 VDMA_A400_Scaled_Test_Results: 8 Vector__XXX
 SG_ Scaled_Test_Results_RawPayload : 0|64@1+ (1,0) [0|18446744073709551615] "" Vector__XXX

BO_ 2147525888 VDMA_A500_Auxiliary_Input_Output: 8 Vector__XXX
 SG_ Auxiliary_Input_Output_Status_4_ : 0|64@1+ (1,0) [0|18446744073709551615] "" Vector__XXX

BO_ 2147526144 VDMA_A600_Auxiliary_Input_Output: 8 Vector__XXX
 SG_ Auxiliary_Input_Output_Status_3_ : 0|64@1+ (1,0) [0|18446744073709551615] "" Vector__XXX

BO_ 2147526400 VDMA_A700_Auxiliary_Input_Output: 8 Vector__XXX
 SG_ Auxiliary_Input_Output_Status_2_ : 0|64@1+ (1,0) [0|18446744073709551615] "" Vector__XXX

BO_ 2147526656 VDMA_A800_Text_Display: 8 Vector__XXX
 SG_ Text_Display_RawPayload : 0|64@1+ (1,0) [0|18446744073709551615] "" Vector__XXX

BO_ 2147526912 VDMA_A900_Forward_Lane_Image_Com: 8 Vector__XXX
 SG_ Forward_Lane_Image_Command_RawPa : 0|64@1+ (1,0) [0|18446744073709551615] "" Vector__XXX

BO_ 2147527168 VDMA_AA00_Client_ECU_to_File_Ser: 8 Vector__XXX
 SG_ Client_ECU_to_File_Server_messag : 0|64@1+ (1,0) [0|18446744073709551615] "" Vector__XXX

BO_ 2147527424 VDMA_AB00_File_Server_to_Client_: 8 Vector__XXX
 SG_ File_Server_to_Client_ECU_messag : 0|64@1+ (1,0) [0|18446744073709551615] "" Vector__XXX

BO_ 2147528192 VDMA_AE00_Tire_Pressure_Referenc: 8 Vector__XXX
 SG_ Tire_Pressure_Reference_Setting_ : 0|64@1+ (1,0) [0|18446744073709551615] "" Vector__XXX

BO_ 2147528448 VDMA_AF00_Parameter_Locate_Messa: 8 Vector__XXX
 SG_ Parameter_Locate_Message_RawPayl : 0|64@1+ (1,0) [0|18446744073709551615] "" Vector__XXX

BO_ 2147528704 VDMA_B000_Configuration_Identifi: 8 Vector__XXX
 SG_ Configuration_Identification_Mes : 0|64@1+ (1,0) [0|18446744073709551615] "" Vector__XXX

BO_ 2147528960 VDMA_B100_Proprietarily_Configur: 8 Vector__XXX
 SG_ Proprietarily_Configurable_Messa : 0|64@1+ (1,0) [0|18446744073709551615] "" Vector__XXX

BO_ 2147529216 VDMA_B200_Proprietarily_Configur: 8 Vector__XXX
 SG_ Proprietarily_Configurable_Messa : 0|64@1+ (1,0) [0|18446744073709551615] "" Vector__XXX

BO_ 2147529472 VDMA_B300_Proprietarily_Configur: 8 Vector__XXX
 SG_ Proprietarily_Configurable_Messa : 0|64@1+ (1,0) [0|18446744073709551615] "" Vector__XXX

BO_ 2147529728 VDMA_B400_Proprietarily_Configur: 8 Vector__XXX
 SG_ Proprietarily_Configurable_Messa : 0|64@1+ (1,0) [0|18446744073709551615] "" Vector__XXX

BO_ 2147529984 VDMA_B500_Proprietarily_Configur: 8 Vector__XXX
 SG_ Proprietarily_Configurable_Messa : 0|64@1+ (1,0) [0|18446744073709551615] "" Vector__XXX

BO_ 2147530240 VDMA_B600_Proprietarily_Configur: 8 Vector__XXX
 SG_ Proprietarily_Configurable_Messa : 0|64@1+ (1,0) [0|18446744073709551615] "" Vector__XXX

BO_ 2147530496 VDMA_B700_Proprietarily_Configur: 8 Vector__XXX
 SG_ Proprietarily_Configurable_Messa : 0|64@1+ (1,0) [0|18446744073709551615] "" Vector__XXX

BO_ 2147530752 VDMA_B800_Proprietarily_Configur: 8 Vector__XXX
 SG_ Proprietarily_Configurable_Messa : 0|64@1+ (1,0) [0|18446744073709551615] "" Vector__XXX

BO_ 2147531008 VDMA_B900_Proprietarily_Configur: 8 Vector__XXX
 SG_ Proprietarily_Configurable_Messa : 0|64@1+ (1,0) [0|18446744073709551615] "" Vector__XXX

BO_ 2147531264 VDMA_BA00_Proprietarily_Configur: 8 Vector__XXX
 SG_ Proprietarily_Configurable_Messa : 0|64@1+ (1,0) [0|18446744073709551615] "" Vector__XXX

BO_ 2147531520 VDMA_BB00_Proprietarily_Configur: 8 Vector__XXX
 SG_ Proprietarily_Configurable_Messa : 0|64@1+ (1,0) [0|18446744073709551615] "" Vector__XXX

BO_ 2147531776 VDMA_BC00_Proprietarily_Configur: 8 Vector__XXX
 SG_ Proprietarily_Configurable_Messa : 0|64@1+ (1,0) [0|18446744073709551615] "" Vector__XXX

BO_ 2147532032 VDMA_BD00_Proprietarily_Configur: 8 Vector__XXX
 SG_ Proprietarily_Configurable_Messa : 0|64@1+ (1,0) [0|18446744073709551615] "" Vector__XXX

BO_ 2147532288 VDMA_BE00_Proprietarily_Configur: 8 Vector__XXX
 SG_ Proprietarily_Configurable_Messa : 0|64@1+ (1,0) [0|18446744073709551615] "" Vector__XXX

BO_ 2147532544 VDMA_BF00_Proprietarily_Configur: 8 Vector__XXX
 SG_ Proprietarily_Configurable_Messa : 0|64@1+ (1,0) [0|18446744073709551615] "" Vector__XXX

BO_ 2147532800 VDMA_C000_Proprietarily_Configur: 8 Vector__XXX
 SG_ Proprietarily_Configurable_Messa : 0|64@1+ (1,0) [0|18446744073709551615] "" Vector__XXX

BO_ 2147533056 VDMA_C100_Diagnostic_Readiness_2: 8 Vector__XXX
 SG_ Diagnostic_Readiness_2_RawPayloa : 0|64@1+ (1,0) [0|18446744073709551615] "" Vector__XXX

BO_ 2147533312 VDMA_C200_Monitor_Performance_Ra: 8 Vector__XXX
 SG_ Monitor_Performance_Ratio_RawPay : 0|64@1+ (1,0) [0|18446744073709551615] "" Vector__XXX

BO_ 2147533824 VDMA_C400_General_Purpose_Valve_: 8 Vector__XXX
 SG_ General_Purpose_Valve_command_Ra : 0|64@1+ (1,0) [0|18446744073709551615] "" Vector__XXX

BO_ 2147534080 VDMA_C500_General_Purpose_Valve_: 8 Vector__XXX
 SG_ General_Purpose_Valve_measured_f : 0|64@1+ (1,0) [0|18446744073709551615] "" Vector__XXX

BO_ 2147534336 VDMA_C600_General_Purpose_Valve_: 8 Vector__XXX
 SG_ General_Purpose_Valve_estimated_ : 0|64@1+ (1,0) [0|18446744073709551615] "" Vector__XXX

BO_ 2147535104 VDMA_C900_Request_2: 8 Vector__XXX
 SG_ Request_2_RawPayload : 0|64@1+ (1,0) [0|18446744073709551615] "" Vector__XXX

BO_ 2147535360 VDMA_CA00_Transfer: 8 Vector__XXX
 SG_ Transfer_RawPayload : 0|64@1+ (1,0) [0|18446744073709551615] "" Vector__XXX

BO_ 2147536640 VDMA_CF00_Continuous_Torque_Spee: 8 Vector__XXX
 SG_ Continuous_Torque_Speed_Limit_Re : 0|64@1+ (1,0) [0|18446744073709551615] "" Vector__XXX

BO_ 2147536896 VDMA_D000_Background_lighting_le: 8 Vector__XXX
 SG_ Background_lighting_level_comman : 0|64@1+ (1,0) [0|18446744073709551615] "" Vector__XXX

BO_ 2147537152 VDMA_D100_Air_Suspension_Control: 8 Vector__XXX
 SG_ Air_Suspension_Control_6_RawPayl : 0|64@1+ (1,0) [0|18446744073709551615] "" Vector__XXX

BO_ 2147537408 VDMA_D200_Air_Suspension_Control: 8 Vector__XXX
 SG_ Air_Suspension_Control_2_RawPayl : 0|64@1+ (1,0) [0|18446744073709551615] "" Vector__XXX

BO_ 2147537664 VDMA_D300_Calibration_Informatio: 8 Vector__XXX
 SG_ Calibration_Information_RawPaylo : 0|64@1+ (1,0) [0|18446744073709551615] "" Vector__XXX

BO_ 2147537920 VDMA_D400_Data_Security: 8 Vector__XXX
 SG_ Data_Security_RawPayload : 0|64@1+ (1,0) [0|18446744073709551615] "" Vector__XXX

BO_ 2147538176 VDMA_D500_Time_Date_Adjust: 8 Vector__XXX
 SG_ Time_Date_Adjust_RawPayload : 0|64@1+ (1,0) [0|18446744073709551615] "" Vector__XXX

BO_ 2147538432 VDMA_D600_Boot_Load_Data: 8 Vector__XXX
 SG_ Boot_Load_Data_RawPayload : 0|64@1+ (1,0) [0|18446744073709551615] "" Vector__XXX

BO_ 2147539968 VDMA_DC00_Anti_theft_Status: 8 Vector__XXX
 SG_ Anti_theft_Status_RawPayload : 0|64@1+ (1,0) [0|18446744073709551615] "" Vector__XXX

BO_ 2147540224 VDMA_DD00_Anti_theft_Request: 8 Vector__XXX
 SG_ Anti_theft_Request_RawPayload : 0|64@1+ (1,0) [0|18446744073709551615] "" Vector__XXX

BO_ 2147540480 VDMA_DE00_Reset: 8 Vector__XXX
 SG_ Reset_RawPayload : 0|64@1+ (1,0) [0|18446744073709551615] "" Vector__XXX

BO_ 2147540992 VDMA_E000_Cab_Message_1: 8 Vector__XXX
 SG_ Cab_Message_1_RawPayload : 0|64@1+ (1,0) [0|18446744073709551615] "" Vector__XXX

BO_ 2147541248 VDMA_E100_General_Purpose_Messag: 8 Vector__XXX
 SG_ General_Purpose_Message_2_1_RawP : 0|64@1+ (1,0) [0|18446744073709551615] "" Vector__XXX

BO_ 2147541504 VDMA_E200_General_Purpose_Messag: 8 Vector__XXX
 SG_ General_Purpose_Message_1_1_RawP : 0|64@1+ (1,0) [0|18446744073709551615] "" Vector__XXX

BO_ 2147541760 VDMA_E300_Command_Non_continuous: 8 Vector__XXX
 SG_ Command_Non_continuously_Monitor : 0|64@1+ (1,0) [0|18446744073709551615] "" Vector__XXX

BO_ 2147542016 VDMA_E400_Running_Gear_Equipment: 8 Vector__XXX
 SG_ Running_Gear_Equipment_1_1_RawPa : 0|64@1+ (1,0) [0|18446744073709551615] "" Vector__XXX

BO_ 2147542272 VDMA_E500_Running_Gear_Equipment: 8 Vector__XXX
 SG_ Running_Gear_Equipment_2_1_RawPa : 0|64@1+ (1,0) [0|18446744073709551615] "" Vector__XXX

BO_ 2147544320 VDMA_ED00_Network_Message: 8 Vector__XXX
 SG_ Network_Message_RawPayload : 0|64@1+ (1,0) [0|18446744073709551615] "" Vector__XXX

BO_ 2147545088 VDMA_F000_Electronic_Retarder_Co: 8 Vector__XXX
 SG_ Electronic_Retarder_Controller_1 : 0|64@1+ (1,0) [0|18446744073709551615] "" Vector__XXX

BO_ 2147545089 VDMA_F001_Electronic_Brake_Contr: 8 Vector__XXX
 SG_ Electronic_Brake_Controller_1_Ra : 0|64@1+ (1,0) [0|18446744073709551615] "" Vector__XXX

BO_ 2147545090 VDMA_F002_Electronic_Transmissio: 8 Vector__XXX
 SG_ Electronic_Transmission_Controll : 0|64@1+ (1,0) [0|18446744073709551615] "" Vector__XXX

BO_ 2147545093 VDMA_F005_Electronic_Transmissio: 8 Vector__XXX
 SG_ Electronic_Transmission_Controll : 0|64@1+ (1,0) [0|18446744073709551615] "" Vector__XXX

BO_ 2147545094 VDMA_F006_Electronic_Axle_Contro: 8 Vector__XXX
 SG_ Electronic_Axle_Controller_1_Raw : 0|64@1+ (1,0) [0|18446744073709551615] "" Vector__XXX

BO_ 2147545095 VDMA_F007_Forward_Lane_Image_1: 8 Vector__XXX
 SG_ Forward_Lane_Image_1_RawPayload : 0|64@1+ (1,0) [0|18446744073709551615] "" Vector__XXX

BO_ 2147545096 VDMA_F008_Hydraulic_Pressure_Gov: 8 Vector__XXX
 SG_ Hydraulic_Pressure_Governor_Info : 0|64@1+ (1,0) [0|18446744073709551615] "" Vector__XXX

BO_ 2147545097 VDMA_F009_Vehicle_Dynamic_Stabil: 8 Vector__XXX
 SG_ Vehicle_Dynamic_Stability_Contro : 0|64@1+ (1,0) [0|18446744073709551615] "" Vector__XXX

BO_ 2147545098 VDMA_F00A_Engine_Gas_Flow_Rate_1: 8 Vector__XXX
 SG_ Engine_Gas_Flow_Rate_1_RawPayloa : 0|64@1+ (1,0) [0|18446744073709551615] "" Vector__XXX

BO_ 2147545099 VDMA_F00B_Electronic_Steering_Co: 8 Vector__XXX
 SG_ Electronic_Steering_Control_RawP : 0|64@1+ (1,0) [0|18446744073709551615] "" Vector__XXX

BO_ 2147545100 VDMA_F00C_Electronic_Transmissio: 8 Vector__XXX
 SG_ Electronic_Transmission_Controll : 0|64@1+ (1,0) [0|18446744073709551615] "" Vector__XXX

BO_ 2147545101 VDMA_F00D_Land_Leveling_System_O: 8 Vector__XXX
 SG_ Land_Leveling_System_Operational : 0|64@1+ (1,0) [0|18446744073709551615] "" Vector__XXX

BO_ 2147545102 VDMA_F00E_Aftertreatment_1_Intak: 8 Vector__XXX
 SG_ Aftertreatment_1_Intake_Gas_1_Ra : 0|64@1+ (1,0) [0|18446744073709551615] "" Vector__XXX

BO_ 2147545103 VDMA_F00F_Aftertreatment_1_Outle: 8 Vector__XXX
 SG_ Aftertreatment_1_Outlet_Gas_1_Ra : 0|64@1+ (1,0) [0|18446744073709551615] "" Vector__XXX

BO_ 2147545104 VDMA_F010_Aftertreatment_2_Intak: 8 Vector__XXX
 SG_ Aftertreatment_2_Intake_Gas_1_Ra : 0|64@1+ (1,0) [0|18446744073709551615] "" Vector__XXX

BO_ 2147545105 VDMA_F011_Aftertreatment_2_Outle: 8 Vector__XXX
 SG_ Aftertreatment_2_Outlet_Gas_1_Ra : 0|64@1+ (1,0) [0|18446744073709551615] "" Vector__XXX

BO_ 2147545106 VDMA_F012_Fifth_Wheel_Smart_Syst: 8 Vector__XXX
 SG_ Fifth_Wheel_Smart_Systems_1_RawP : 0|64@1+ (1,0) [0|18446744073709551615] "" Vector__XXX

BO_ 2147545107 VDMA_F013_Slope_Sensor_Informati: 8 Vector__XXX
 SG_ Slope_Sensor_Information_RawPayl : 0|64@1+ (1,0) [0|18446744073709551615] "" Vector__XXX

BO_ 2147545108 VDMA_F014_Blade_Information: 8 Vector__XXX
 SG_ Blade_Information_RawPayload : 0|64@1+ (1,0) [0|18446744073709551615] "" Vector__XXX

BO_ 2147545109 VDMA_F015_Requested_Generator_To: 8 Vector__XXX
 SG_ Requested_Generator_Total_AC_Rea : 0|64@1+ (1,0) [0|18446744073709551615] "" Vector__XXX

BO_ 2147545110 VDMA_F016_Cylinder_Combustion_St: 8 Vector__XXX
 SG_ Cylinder_Combustion_Status_RawPa : 0|64@1+ (1,0) [0|18446744073709551615] "" Vector__XXX

BO_ 2147545111 VDMA_F017_Engine_Knock_Level_1: 8 Vector__XXX
 SG_ Engine_Knock_Level_1_RawPayload : 0|64@1+ (1,0) [0|18446744073709551615] "" Vector__XXX

BO_ 2147545112 VDMA_F018_Engine_Knock_Level_2: 8 Vector__XXX
 SG_ Engine_Knock_Level_2_RawPayload : 0|64@1+ (1,0) [0|18446744073709551615] "" Vector__XXX

BO_ 2147545113 VDMA_F019_Engine_Knock_Level_3: 8 Vector__XXX
 SG_ Engine_Knock_Level_3_RawPayload : 0|64@1+ (1,0) [0|18446744073709551615] "" Vector__XXX

BO_ 2147545114 VDMA_F01A_Engine_Throttle_Fuel_A: 8 Vector__XXX
 SG_ Engine_Throttle_Fuel_Actuator_Co : 0|64@1+ (1,0) [0|18446744073709551615] "" Vector__XXX

BO_ 2147545115 VDMA_F01B_General_Purpose_Messag: 8 Vector__XXX
 SG_ General_Purpose_Message_1_7_RawP : 0|64@1+ (1,0) [0|18446744073709551615] "" Vector__XXX

BO_ 2147545116 VDMA_F01C_Requested_Generator_Av: 8 Vector__XXX
 SG_ Requested_Generator_Average_Basi : 0|64@1+ (1,0) [0|18446744073709551615] "" Vector__XXX

BO_ 2147545117 VDMA_F01D_Steering_Angle_Sensor_: 8 Vector__XXX
 SG_ Steering_Angle_Sensor_Informatio : 0|64@1+ (1,0) [0|18446744073709551615] "" Vector__XXX

BO_ 2147545118 VDMA_F01E_Generator_Control_2: 8 Vector__XXX
 SG_ Generator_Control_2_RawPayload : 0|64@1+ (1,0) [0|18446744073709551615] "" Vector__XXX

BO_ 2147545119 VDMA_F01F_Electronic_Brake_Syste: 8 Vector__XXX
 SG_ Electronic_Brake_System_2_6_RawP : 0|64@1+ (1,0) [0|18446744073709551615] "" Vector__XXX

BO_ 2147545120 VDMA_F020_Electronic_Brake_Syste: 8 Vector__XXX
 SG_ Electronic_Brake_System_2_5_RawP : 0|64@1+ (1,0) [0|18446744073709551615] "" Vector__XXX

BO_ 2147545121 VDMA_F021_Engine_Speed_Sensor_In: 8 Vector__XXX
 SG_ Engine_Speed_Sensor_Information_ : 0|64@1+ (1,0) [0|18446744073709551615] "" Vector__XXX

BO_ 2147545123 VDMA_F023_Aftertreatment_1_SCR_D: 8 Vector__XXX
 SG_ Aftertreatment_1_SCR_Dosing_Syst : 0|64@1+ (1,0) [0|18446744073709551615] "" Vector__XXX

BO_ 2147545124 VDMA_F024_Aftertreatment_1_SCR_D: 8 Vector__XXX
 SG_ Aftertreatment_1_SCR_Dosing_Syst : 0|64@1+ (1,0) [0|18446744073709551615] "" Vector__XXX

BO_ 2147545125 VDMA_F025_Aftertreatment_1_SCR_A: 8 Vector__XXX
 SG_ Aftertreatment_1_SCR_Ammonia_Inf : 0|64@1+ (1,0) [0|18446744073709551615] "" Vector__XXX

BO_ 2147545126 VDMA_F026_Aftertreatment_2_SCR_D: 8 Vector__XXX
 SG_ Aftertreatment_2_SCR_Dosing_Syst : 0|64@1+ (1,0) [0|18446744073709551615] "" Vector__XXX

BO_ 2147545127 VDMA_F027_Aftertreatment_2_SCR_D: 8 Vector__XXX
 SG_ Aftertreatment_2_SCR_Dosing_Syst : 0|64@1+ (1,0) [0|18446744073709551615] "" Vector__XXX

BO_ 2147545128 VDMA_F028_Aftertreatment_2_SCR_A: 8 Vector__XXX
 SG_ Aftertreatment_2_SCR_Ammonia_Inf : 0|64@1+ (1,0) [0|18446744073709551615] "" Vector__XXX

BO_ 2147545129 VDMA_F029_Slope_Sensor_Informati: 8 Vector__XXX
 SG_ Slope_Sensor_Information_2_RawPa : 0|64@1+ (1,0) [0|18446744073709551615] "" Vector__XXX

BO_ 2147545130 VDMA_F02A_Angular_Rate_Informati: 8 Vector__XXX
 SG_ Angular_Rate_Information_RawPayl : 0|64@1+ (1,0) [0|18446744073709551615] "" Vector__XXX

BO_ 2147545131 VDMA_F02B_Crash_Notification: 8 Vector__XXX
 SG_ Crash_Notification_RawPayload : 0|64@1+ (1,0) [0|18446744073709551615] "" Vector__XXX

BO_ 2147545132 VDMA_F02C_Magnet_Status_Informat: 8 Vector__XXX
 SG_ Magnet_Status_Information_2_RawP : 0|64@1+ (1,0) [0|18446744073709551615] "" Vector__XXX

BO_ 2147545133 VDMA_F02D_Acceleration_Sensor: 8 Vector__XXX
 SG_ Acceleration_Sensor_RawPayload : 0|64@1+ (1,0) [0|18446744073709551615] "" Vector__XXX

BO_ 2147545134 VDMA_F02E_Engine_Turbocharger_Co: 8 Vector__XXX
 SG_ Engine_Turbocharger_Control_1_Ra : 0|64@1+ (1,0) [0|18446744073709551615] "" Vector__XXX

BO_ 2147545135 VDMA_F02F_Advanced_Emergency_Bra: 8 Vector__XXX
 SG_ Advanced_Emergency_Braking_Syste : 0|64@1+ (1,0) [0|18446744073709551615] "" Vector__XXX

BO_ 2147545136 VDMA_F030_Wireless_Status: 8 Vector__XXX
 SG_ Wireless_Status_RawPayload : 0|64@1+ (1,0) [0|18446744073709551615] "" Vector__XXX

BO_ 2147545137 VDMA_F031_Wand_Sensor: 8 Vector__XXX
 SG_ Wand_Sensor_RawPayload : 0|64@1+ (1,0) [0|18446744073709551615] "" Vector__XXX

BO_ 2147545138 VDMA_F032_Linear_Displacement_Se: 8 Vector__XXX
 SG_ Linear_Displacement_Sensor_RawPa : 0|64@1+ (1,0) [0|18446744073709551615] "" Vector__XXX

BO_ 2147545139 VDMA_F033_Aftertreatment_1_SCR_A: 8 Vector__XXX
 SG_ Aftertreatment_1_SCR_Ammonia_Inf : 0|64@1+ (1,0) [0|18446744073709551615] "" Vector__XXX

BO_ 2147545140 VDMA_F034_Aftertreatment_2_SCR_A: 8 Vector__XXX
 SG_ Aftertreatment_2_SCR_Ammonia_Inf : 0|64@1+ (1,0) [0|18446744073709551615] "" Vector__XXX

BO_ 2147545142 VDMA_F036_High_Voltage_Energy_St: 8 Vector__XXX
 SG_ High_Voltage_Energy_Storage_Syst : 0|64@1+ (1,0) [0|18446744073709551615] "" Vector__XXX

BO_ 2147545143 VDMA_F037_Engine_Turbocharger_Bl: 8 Vector__XXX
 SG_ Engine_Turbocharger_Blowoff_Actu : 0|64@1+ (1,0) [0|18446744073709551615] "" Vector__XXX

BO_ 2147545144 VDMA_F038_Engine_Torque_Fuel_Req: 8 Vector__XXX
 SG_ Engine_Torque_Fuel_Request_RawPa : 0|64@1+ (1,0) [0|18446744073709551615] "" Vector__XXX

BO_ 2147545145 VDMA_F039_Engine_Air_System_Info: 8 Vector__XXX
 SG_ Engine_Air_System_Information_Ra : 0|64@1+ (1,0) [0|18446744073709551615] "" Vector__XXX

BO_ 2147545146 VDMA_F03A_Engine_Cylinder_1_Comb: 8 Vector__XXX
 SG_ Engine_Cylinder_1_Combustion_Inf : 0|64@1+ (1,0) [0|18446744073709551615] "" Vector__XXX

BO_ 2147545147 VDMA_F03B_Engine_Cylinder_2_Comb: 8 Vector__XXX
 SG_ Engine_Cylinder_2_Combustion_Inf : 0|64@1+ (1,0) [0|18446744073709551615] "" Vector__XXX

BO_ 2147545148 VDMA_F03C_Engine_Cylinder_3_Comb: 8 Vector__XXX
 SG_ Engine_Cylinder_3_Combustion_Inf : 0|64@1+ (1,0) [0|18446744073709551615] "" Vector__XXX

BO_ 2147545149 VDMA_F03D_Engine_Cylinder_4_Comb: 8 Vector__XXX
 SG_ Engine_Cylinder_4_Combustion_Inf : 0|64@1+ (1,0) [0|18446744073709551615] "" Vector__XXX

BO_ 2147545150 VDMA_F03E_Engine_Cylinder_5_Comb: 8 Vector__XXX
 SG_ Engine_Cylinder_5_Combustion_Inf : 0|64@1+ (1,0) [0|18446744073709551615] "" Vector__XXX

BO_ 2147545151 VDMA_F03F_Engine_Cylinder_6_Comb: 8 Vector__XXX
 SG_ Engine_Cylinder_6_Combustion_Inf : 0|64@1+ (1,0) [0|18446744073709551615] "" Vector__XXX

BO_ 2147545152 VDMA_F040_Engine_Cylinder_7_Comb: 8 Vector__XXX
 SG_ Engine_Cylinder_7_Combustion_Inf : 0|64@1+ (1,0) [0|18446744073709551615] "" Vector__XXX

BO_ 2147545153 VDMA_F041_Engine_Cylinder_8_Comb: 8 Vector__XXX
 SG_ Engine_Cylinder_8_Combustion_Inf : 0|64@1+ (1,0) [0|18446744073709551615] "" Vector__XXX

BO_ 2147545154 VDMA_F042_Engine_Cylinder_9_Comb: 8 Vector__XXX
 SG_ Engine_Cylinder_9_Combustion_Inf : 0|64@1+ (1,0) [0|18446744073709551615] "" Vector__XXX

BO_ 2147545155 VDMA_F043_Engine_Cylinder_10_Com: 8 Vector__XXX
 SG_ Engine_Cylinder_10_Combustion_In : 0|64@1+ (1,0) [0|18446744073709551615] "" Vector__XXX

BO_ 2147545156 VDMA_F044_Engine_Cylinder_11_Com: 8 Vector__XXX
 SG_ Engine_Cylinder_11_Combustion_In : 0|64@1+ (1,0) [0|18446744073709551615] "" Vector__XXX

BO_ 2147545157 VDMA_F045_Engine_Cylinder_12_Com: 8 Vector__XXX
 SG_ Engine_Cylinder_12_Combustion_In : 0|64@1+ (1,0) [0|18446744073709551615] "" Vector__XXX

BO_ 2147545158 VDMA_F046_Engine_Cylinder_13_Com: 8 Vector__XXX
 SG_ Engine_Cylinder_13_Combustion_In : 0|64@1+ (1,0) [0|18446744073709551615] "" Vector__XXX

BO_ 2147545159 VDMA_F047_Engine_Cylinder_14_Com: 8 Vector__XXX
 SG_ Engine_Cylinder_14_Combustion_In : 0|64@1+ (1,0) [0|18446744073709551615] "" Vector__XXX

BO_ 2147545160 VDMA_F048_Engine_Cylinder_15_Com: 8 Vector__XXX
 SG_ Engine_Cylinder_15_Combustion_In : 0|64@1+ (1,0) [0|18446744073709551615] "" Vector__XXX

BO_ 2147545161 VDMA_F049_Engine_Cylinder_16_Com: 8 Vector__XXX
 SG_ Engine_Cylinder_16_Combustion_In : 0|64@1+ (1,0) [0|18446744073709551615] "" Vector__XXX

BO_ 2147545162 VDMA_F04A_Engine_Cylinder_17_Com: 8 Vector__XXX
 SG_ Engine_Cylinder_17_Combustion_In : 0|64@1+ (1,0) [0|18446744073709551615] "" Vector__XXX

BO_ 2147545163 VDMA_F04B_Engine_Cylinder_18_Com: 8 Vector__XXX
 SG_ Engine_Cylinder_18_Combustion_In : 0|64@1+ (1,0) [0|18446744073709551615] "" Vector__XXX

BO_ 2147545164 VDMA_F04C_Engine_Cylinder_19_Com: 8 Vector__XXX
 SG_ Engine_Cylinder_19_Combustion_In : 0|64@1+ (1,0) [0|18446744073709551615] "" Vector__XXX

BO_ 2147545165 VDMA_F04D_Engine_Cylinder_20_Com: 8 Vector__XXX
 SG_ Engine_Cylinder_20_Combustion_In : 0|64@1+ (1,0) [0|18446744073709551615] "" Vector__XXX

BO_ 2147545166 VDMA_F04E_Engine_Cylinder_1_Comb: 8 Vector__XXX
 SG_ Engine_Cylinder_1_Combustion_Ave : 0|64@1+ (1,0) [0|18446744073709551615] "" Vector__XXX

BO_ 2147545167 VDMA_F04F_Engine_Cylinder_2_Comb: 8 Vector__XXX
 SG_ Engine_Cylinder_2_Combustion_Ave : 0|64@1+ (1,0) [0|18446744073709551615] "" Vector__XXX

BO_ 2147545168 VDMA_F050_Engine_Cylinder_3_Comb: 8 Vector__XXX
 SG_ Engine_Cylinder_3_Combustion_Ave : 0|64@1+ (1,0) [0|18446744073709551615] "" Vector__XXX

BO_ 2147545169 VDMA_F051_Engine_Cylinder_4_Comb: 8 Vector__XXX
 SG_ Engine_Cylinder_4_Combustion_Ave : 0|64@1+ (1,0) [0|18446744073709551615] "" Vector__XXX

BO_ 2147545170 VDMA_F052_Engine_Cylinder_5_Comb: 8 Vector__XXX
 SG_ Engine_Cylinder_5_Combustion_Ave : 0|64@1+ (1,0) [0|18446744073709551615] "" Vector__XXX

BO_ 2147545171 VDMA_F053_Engine_Cylinder_6_Comb: 8 Vector__XXX
 SG_ Engine_Cylinder_6_Combustion_Ave : 0|64@1+ (1,0) [0|18446744073709551615] "" Vector__XXX

BO_ 2147545172 VDMA_F054_Engine_Cylinder_7_Comb: 8 Vector__XXX
 SG_ Engine_Cylinder_7_Combustion_Ave : 0|64@1+ (1,0) [0|18446744073709551615] "" Vector__XXX

BO_ 2147545173 VDMA_F055_Engine_Cylinder_8_Comb: 8 Vector__XXX
 SG_ Engine_Cylinder_8_Combustion_Ave : 0|64@1+ (1,0) [0|18446744073709551615] "" Vector__XXX

BO_ 2147545174 VDMA_F056_Engine_Cylinder_9_Comb: 8 Vector__XXX
 SG_ Engine_Cylinder_9_Combustion_Ave : 0|64@1+ (1,0) [0|18446744073709551615] "" Vector__XXX

BO_ 2147545175 VDMA_F057_Engine_Cylinder_10_Com: 8 Vector__XXX
 SG_ Engine_Cylinder_10_Combustion_Av : 0|64@1+ (1,0) [0|18446744073709551615] "" Vector__XXX

BO_ 2147545176 VDMA_F058_Engine_Cylinder_11_Com: 8 Vector__XXX
 SG_ Engine_Cylinder_11_Combustion_Av : 0|64@1+ (1,0) [0|18446744073709551615] "" Vector__XXX

BO_ 2147545177 VDMA_F059_Engine_Cylinder_12_Com: 8 Vector__XXX
 SG_ Engine_Cylinder_12_Combustion_Av : 0|64@1+ (1,0) [0|18446744073709551615] "" Vector__XXX

CM_ BO_ 2147483904  "Source: isobus.net VDMA Data Dictionary (https://www.isobus.net/isobus/pGNAndSPN/38?type=PGN)";
CM_ BO_ 2147484160  "Source: isobus.net VDMA Data Dictionary (https://www.isobus.net/isobus/pGNAndSPN/39?type=PGN)";
CM_ BO_ 2147484416  "Source: isobus.net VDMA Data Dictionary (https://www.isobus.net/isobus/pGNAndSPN/40?type=PGN)";
CM_ BO_ 2147484672  "Source: isobus.net VDMA Data Dictionary (https://www.isobus.net/isobus/pGNAndSPN/50?type=PGN)";
CM_ BO_ 2147484928  "Source: isobus.net VDMA Data Dictionary (https://www.isobus.net/isobus/pGNAndSPN/51?type=PGN)";
CM_ BO_ 2147485184  "Source: isobus.net VDMA Data Dictionary (https://www.isobus.net/isobus/pGNAndSPN/52?type=PGN)";
CM_ BO_ 2147485440  "Source: isobus.net VDMA Data Dictionary (https://www.isobus.net/isobus/pGNAndSPN/57?type=PGN)";
CM_ BO_ 2147485696  "Source: isobus.net VDMA Data Dictionary (https://www.isobus.net/isobus/pGNAndSPN/61?type=PGN)";
CM_ BO_ 2147485952  "Source: isobus.net VDMA Data Dictionary (https://www.isobus.net/isobus/pGNAndSPN/63?type=PGN)";
CM_ BO_ 2147486208  "Source: isobus.net VDMA Data Dictionary (https://www.isobus.net/isobus/pGNAndSPN/71?type=PGN)";
CM_ BO_ 2147486464  "Source: isobus.net VDMA Data Dictionary (https://www.isobus.net/isobus/pGNAndSPN/74?type=PGN)";
CM_ BO_ 2147486720  "Source: isobus.net VDMA Data Dictionary (https://www.isobus.net/isobus/pGNAndSPN/77?type=PGN)";
CM_ BO_ 2147486976  "Source: isobus.net VDMA Data Dictionary (https://www.isobus.net/isobus/pGNAndSPN/96?type=PGN)";
CM_ BO_ 2147487232  "Source: isobus.net VDMA Data Dictionary (https://www.isobus.net/isobus/pGNAndSPN/103?type=PGN)";
CM_ BO_ 2147487488  "Source: isobus.net VDMA Data Dictionary (https://www.isobus.net/isobus/pGNAndSPN/115?type=PGN)";
CM_ BO_ 2147487744  "Source: isobus.net VDMA Data Dictionary (https://www.isobus.net/isobus/pGNAndSPN/127?type=PGN)";
CM_ BO_ 2147488000  "Source: isobus.net VDMA Data Dictionary (https://www.isobus.net/isobus/pGNAndSPN/139?type=PGN)";
CM_ BO_ 2147488256  "Source: isobus.net VDMA Data Dictionary (https://www.isobus.net/isobus/pGNAndSPN/151?type=PGN)";
CM_ BO_ 2147488512  "Source: isobus.net VDMA Data Dictionary (https://www.isobus.net/isobus/pGNAndSPN/163?type=PGN)";
CM_ BO_ 2147488768  "Source: isobus.net VDMA Data Dictionary (https://www.isobus.net/isobus/pGNAndSPN/175?type=PGN)";
CM_ BO_ 2147489024  "Source: isobus.net VDMA Data Dictionary (https://www.isobus.net/isobus/pGNAndSPN/187?type=PGN)";
CM_ BO_ 2147489280  "Source: isobus.net VDMA Data Dictionary (https://www.isobus.net/isobus/pGNAndSPN/199?type=PGN)";
CM_ BO_ 2147489536  "Source: isobus.net VDMA Data Dictionary (https://www.isobus.net/isobus/pGNAndSPN/211?type=PGN)";
CM_ BO_ 2147489792  "Source: isobus.net VDMA Data Dictionary (https://www.isobus.net/isobus/pGNAndSPN/223?type=PGN)";
CM_ BO_ 2147490048  "Source: isobus.net VDMA Data Dictionary (https://www.isobus.net/isobus/pGNAndSPN/235?type=PGN)";
CM_ BO_ 2147490304  "Source: isobus.net VDMA Data Dictionary (https://www.isobus.net/isobus/pGNAndSPN/247?type=PGN)";
CM_ BO_ 2147490560  "Source: isobus.net VDMA Data Dictionary (https://www.isobus.net/isobus/pGNAndSPN/259?type=PGN)";
CM_ BO_ 2147490816  "Source: isobus.net VDMA Data Dictionary (https://www.isobus.net/isobus/pGNAndSPN/267?type=PGN)";
CM_ BO_ 2147491072  "Source: isobus.net VDMA Data Dictionary (https://www.isobus.net/isobus/pGNAndSPN/268?type=PGN)";
CM_ BO_ 2147491328  "Source: isobus.net VDMA Data Dictionary (https://www.isobus.net/isobus/pGNAndSPN/272?type=PGN)";
CM_ BO_ 2147491584  "Source: isobus.net VDMA Data Dictionary (https://www.isobus.net/isobus/pGNAndSPN/284?type=PGN)";
CM_ BO_ 2147491840  "Source: isobus.net VDMA Data Dictionary (https://www.isobus.net/isobus/pGNAndSPN/296?type=PGN)";
CM_ BO_ 2147492096  "Source: isobus.net VDMA Data Dictionary (https://www.isobus.net/isobus/pGNAndSPN/308?type=PGN)";
CM_ BO_ 2147492352  "Source: isobus.net VDMA Data Dictionary (https://www.isobus.net/isobus/pGNAndSPN/320?type=PGN)";
CM_ BO_ 2147492608  "Source: isobus.net VDMA Data Dictionary (https://www.isobus.net/isobus/pGNAndSPN/494?type=PGN)";
CM_ BO_ 2147492864  "Source: isobus.net VDMA Data Dictionary (https://www.isobus.net/isobus/pGNAndSPN/584?type=PGN)";
CM_ BO_ 2147493120  "Source: isobus.net VDMA Data Dictionary (https://www.isobus.net/isobus/pGNAndSPN/590?type=PGN)";
CM_ BO_ 2147493376  "Source: isobus.net VDMA Data Dictionary (https://www.isobus.net/isobus/pGNAndSPN/598?type=PGN)";
CM_ BO_ 2147493632  "Source: isobus.net VDMA Data Dictionary (https://www.isobus.net/isobus/pGNAndSPN/606?type=PGN)";
CM_ BO_ 2147493888  "Source: isobus.net VDMA Data Dictionary (https://www.isobus.net/isobus/pGNAndSPN/610?type=PGN)";
CM_ BO_ 2147494144  "Source: isobus.net VDMA Data Dictionary (https://www.isobus.net/isobus/pGNAndSPN/614?type=PGN)";
CM_ BO_ 2147494400  "Source: isobus.net VDMA Data Dictionary (https://www.isobus.net/isobus/pGNAndSPN/626?type=PGN)";
CM_ BO_ 2147494656  "Source: isobus.net VDMA Data Dictionary (https://www.isobus.net/isobus/pGNAndSPN/638?type=PGN)";
CM_ BO_ 2147494912  "Source: isobus.net VDMA Data Dictionary (https://www.isobus.net/isobus/pGNAndSPN/650?type=PGN)";
CM_ BO_ 2147495168  "Source: isobus.net VDMA Data Dictionary (https://www.isobus.net/isobus/pGNAndSPN/662?type=PGN)";
CM_ BO_ 2147495424  "Source: isobus.net VDMA Data Dictionary (https://www.isobus.net/isobus/pGNAndSPN/674?type=PGN)";
CM_ BO_ 2147495680  "Source: isobus.net VDMA Data Dictionary (https://www.isobus.net/isobus/pGNAndSPN/686?type=PGN)";
CM_ BO_ 2147495936  "Source: isobus.net VDMA Data Dictionary (https://www.isobus.net/isobus/pGNAndSPN/698?type=PGN)";
CM_ BO_ 2147496192  "Source: isobus.net VDMA Data Dictionary (https://www.isobus.net/isobus/pGNAndSPN/710?type=PGN)";
CM_ BO_ 2147496448  "Source: isobus.net VDMA Data Dictionary (https://www.isobus.net/isobus/pGNAndSPN/722?type=PGN)";
CM_ BO_ 2147496704  "Source: isobus.net VDMA Data Dictionary (https://www.isobus.net/isobus/pGNAndSPN/734?type=PGN)";
CM_ BO_ 2147496960  "Source: isobus.net VDMA Data Dictionary (https://www.isobus.net/isobus/pGNAndSPN/735?type=PGN)";
CM_ BO_ 2147497216  "Source: isobus.net VDMA Data Dictionary (https://www.isobus.net/isobus/pGNAndSPN/736?type=PGN)";
CM_ BO_ 2147497472  "Source: isobus.net VDMA Data Dictionary (https://www.isobus.net/isobus/pGNAndSPN/737?type=PGN)";
CM_ BO_ 2147497728  "Source: isobus.net VDMA Data Dictionary (https://www.isobus.net/isobus/pGNAndSPN/738?type=PGN)";
CM_ BO_ 2147497984  "Source: isobus.net VDMA Data Dictionary (https://www.isobus.net/isobus/pGNAndSPN/739?type=PGN)";
CM_ BO_ 2147498240  "Source: isobus.net VDMA Data Dictionary (https://www.isobus.net/isobus/pGNAndSPN/744?type=PGN)";
CM_ BO_ 2147498496  "Source: isobus.net VDMA Data Dictionary (https://www.isobus.net/isobus/pGNAndSPN/748?type=PGN)";
CM_ BO_ 2147498752  "Source: isobus.net VDMA Data Dictionary (https://www.isobus.net/isobus/pGNAndSPN/752?type=PGN)";
CM_ BO_ 2147499008  "Source: isobus.net VDMA Data Dictionary (https://www.isobus.net/isobus/pGNAndSPN/1073?type=PGN)";
CM_ BO_ 2147499264  "Source: isobus.net VDMA Data Dictionary (https://www.isobus.net/isobus/pGNAndSPN/1276?type=PGN)";
CM_ BO_ 2147499520  "Source: isobus.net VDMA Data Dictionary (https://www.isobus.net/isobus/pGNAndSPN/1282?type=PGN)";
CM_ BO_ 2147499776  "Source: isobus.net VDMA Data Dictionary (https://www.isobus.net/isobus/pGNAndSPN/1286?type=PGN)";
CM_ BO_ 2147500032  "Source: isobus.net VDMA Data Dictionary (https://www.isobus.net/isobus/pGNAndSPN/1290?type=PGN)";
CM_ BO_ 2147500288  "Source: isobus.net VDMA Data Dictionary (https://www.isobus.net/isobus/pGNAndSPN/1293?type=PGN)";
CM_ BO_ 2147500544  "Source: isobus.net VDMA Data Dictionary (https://www.isobus.net/isobus/pGNAndSPN/1301?type=PGN)";
CM_ BO_ 2147500800  "Source: isobus.net VDMA Data Dictionary (https://www.isobus.net/isobus/pGNAndSPN/1302?type=PGN)";
CM_ BO_ 2147501568  "Source: isobus.net VDMA Data Dictionary (https://www.isobus.net/isobus/pGNAndSPN/1307?type=PGN)";
CM_ BO_ 2147502080  "Source: isobus.net VDMA Data Dictionary (https://www.isobus.net/isobus/pGNAndSPN/1308?type=PGN)";
CM_ BO_ 2147502336  "Source: isobus.net VDMA Data Dictionary (https://www.isobus.net/isobus/pGNAndSPN/1309?type=PGN)";
CM_ BO_ 2147502592  "Source: isobus.net VDMA Data Dictionary (https://www.isobus.net/isobus/pGNAndSPN/1313?type=PGN)";
CM_ BO_ 2147502848  "Source: isobus.net VDMA Data Dictionary (https://www.isobus.net/isobus/pGNAndSPN/1317?type=PGN)";
CM_ BO_ 2147503104  "Source: isobus.net VDMA Data Dictionary (https://www.isobus.net/isobus/pGNAndSPN/1322?type=PGN)";
CM_ BO_ 2147503360  "Source: isobus.net VDMA Data Dictionary (https://www.isobus.net/isobus/pGNAndSPN/1336?type=PGN)";
CM_ BO_ 2147503616  "Source: isobus.net VDMA Data Dictionary (https://www.isobus.net/isobus/pGNAndSPN/1340?type=PGN)";
CM_ BO_ 2147503872  "Source: isobus.net VDMA Data Dictionary (https://www.isobus.net/isobus/pGNAndSPN/1350?type=PGN)";
CM_ BO_ 2147504128  "Source: isobus.net VDMA Data Dictionary (https://www.isobus.net/isobus/pGNAndSPN/1355?type=PGN)";
CM_ BO_ 2147504384  "Source: isobus.net VDMA Data Dictionary (https://www.isobus.net/isobus/pGNAndSPN/1360?type=PGN)";
CM_ BO_ 2147504640  "Source: isobus.net VDMA Data Dictionary (https://www.isobus.net/isobus/pGNAndSPN/1365?type=PGN)";
CM_ BO_ 2147504896  "Source: isobus.net VDMA Data Dictionary (https://www.isobus.net/isobus/pGNAndSPN/1369?type=PGN)";
CM_ BO_ 2147505152  "Source: isobus.net VDMA Data Dictionary (https://www.isobus.net/isobus/pGNAndSPN/1370?type=PGN)";
CM_ BO_ 2147505408  "Source: isobus.net VDMA Data Dictionary (https://www.isobus.net/isobus/pGNAndSPN/1371?type=PGN)";
CM_ BO_ 2147505664  "Source: isobus.net VDMA Data Dictionary (https://www.isobus.net/isobus/pGNAndSPN/1378?type=PGN)";
CM_ BO_ 2147505920  "Source: isobus.net VDMA Data Dictionary (https://www.isobus.net/isobus/pGNAndSPN/1385?type=PGN)";
CM_ BO_ 2147506176  "Source: isobus.net VDMA Data Dictionary (https://www.isobus.net/isobus/pGNAndSPN/1387?type=PGN)";
CM_ BO_ 2147506432  "Source: isobus.net VDMA Data Dictionary (https://www.isobus.net/isobus/pGNAndSPN/1391?type=PGN)";
CM_ BO_ 2147506688  "Source: isobus.net VDMA Data Dictionary (https://www.isobus.net/isobus/pGNAndSPN/1395?type=PGN)";
CM_ BO_ 2147506944  "Source: isobus.net VDMA Data Dictionary (https://www.isobus.net/isobus/pGNAndSPN/1401?type=PGN)";
CM_ BO_ 2147507200  "Source: isobus.net VDMA Data Dictionary (https://www.isobus.net/isobus/pGNAndSPN/1407?type=PGN)";
CM_ BO_ 2147507456  "Source: isobus.net VDMA Data Dictionary (https://www.isobus.net/isobus/pGNAndSPN/1413?type=PGN)";
CM_ BO_ 2147507712  "Source: isobus.net VDMA Data Dictionary (https://www.isobus.net/isobus/pGNAndSPN/1419?type=PGN)";
CM_ BO_ 2147507968  "Source: isobus.net VDMA Data Dictionary (https://www.isobus.net/isobus/pGNAndSPN/1425?type=PGN)";
CM_ BO_ 2147508224  "Source: isobus.net VDMA Data Dictionary (https://www.isobus.net/isobus/pGNAndSPN/1431?type=PGN)";
CM_ BO_ 2147508480  "Source: isobus.net VDMA Data Dictionary (https://www.isobus.net/isobus/pGNAndSPN/1433?type=PGN)";
CM_ BO_ 2147508736  "Source: isobus.net VDMA Data Dictionary (https://www.isobus.net/isobus/pGNAndSPN/1435?type=PGN)";
CM_ BO_ 2147508992  "Source: isobus.net VDMA Data Dictionary (https://www.isobus.net/isobus/pGNAndSPN/1437?type=PGN)";
CM_ BO_ 2147509248  "Source: isobus.net VDMA Data Dictionary (https://www.isobus.net/isobus/pGNAndSPN/1441?type=PGN)";
CM_ BO_ 2147509504  "Source: isobus.net VDMA Data Dictionary (https://www.isobus.net/isobus/pGNAndSPN/1445?type=PGN)";
CM_ BO_ 2147509760  "Source: isobus.net VDMA Data Dictionary (https://www.isobus.net/isobus/pGNAndSPN/1452?type=PGN)";
CM_ BO_ 2147510016  "Source: isobus.net VDMA Data Dictionary (https://www.isobus.net/isobus/pGNAndSPN/1459?type=PGN)";
CM_ BO_ 2147510272  "Source: isobus.net VDMA Data Dictionary (https://www.isobus.net/isobus/pGNAndSPN/1471?type=PGN)";
CM_ BO_ 2147510528  "Source: isobus.net VDMA Data Dictionary (https://www.isobus.net/isobus/pGNAndSPN/1475?type=PGN)";
CM_ BO_ 2147510784  "Source: isobus.net VDMA Data Dictionary (https://www.isobus.net/isobus/pGNAndSPN/1482?type=PGN)";
CM_ BO_ 2147511040  "Source: isobus.net VDMA Data Dictionary (https://www.isobus.net/isobus/pGNAndSPN/1484?type=PGN)";
CM_ BO_ 2147511296  "Source: isobus.net VDMA Data Dictionary (https://www.isobus.net/isobus/pGNAndSPN/1485?type=PGN)";
CM_ BO_ 2147511552  "Source: isobus.net VDMA Data Dictionary (https://www.isobus.net/isobus/pGNAndSPN/1496?type=PGN)";
CM_ BO_ 2147511808  "Source: isobus.net VDMA Data Dictionary (https://www.isobus.net/isobus/pGNAndSPN/1501?type=PGN)";
CM_ BO_ 2147512064  "Source: isobus.net VDMA Data Dictionary (https://www.isobus.net/isobus/pGNAndSPN/1527?type=PGN)";
CM_ BO_ 2147512320  "Source: isobus.net VDMA Data Dictionary (https://www.isobus.net/isobus/pGNAndSPN/1552?type=PGN)";
CM_ BO_ 2147512576  "Source: isobus.net VDMA Data Dictionary (https://www.isobus.net/isobus/pGNAndSPN/1556?type=PGN)";
CM_ BO_ 2147512832  "Source: isobus.net VDMA Data Dictionary (https://www.isobus.net/isobus/pGNAndSPN/1569?type=PGN)";
CM_ BO_ 2147513088  "Source: isobus.net VDMA Data Dictionary (https://www.isobus.net/isobus/pGNAndSPN/1576?type=PGN)";
CM_ BO_ 2147513344  "Source: isobus.net VDMA Data Dictionary (https://www.isobus.net/isobus/pGNAndSPN/1583?type=PGN)";
CM_ BO_ 2147513600  "Source: isobus.net VDMA Data Dictionary (https://www.isobus.net/isobus/pGNAndSPN/1590?type=PGN)";
CM_ BO_ 2147513856  "Source: isobus.net VDMA Data Dictionary (https://www.isobus.net/isobus/pGNAndSPN/1597?type=PGN)";
CM_ BO_ 2147514112  "Source: isobus.net VDMA Data Dictionary (https://www.isobus.net/isobus/pGNAndSPN/1604?type=PGN)";
CM_ BO_ 2147514368  "Source: isobus.net VDMA Data Dictionary (https://www.isobus.net/isobus/pGNAndSPN/1611?type=PGN)";
CM_ BO_ 2147514624  "Source: isobus.net VDMA Data Dictionary (https://www.isobus.net/isobus/pGNAndSPN/1618?type=PGN)";
CM_ BO_ 2147514880  "Source: isobus.net VDMA Data Dictionary (https://www.isobus.net/isobus/pGNAndSPN/1625?type=PGN)";
CM_ BO_ 2147515136  "Source: isobus.net VDMA Data Dictionary (https://www.isobus.net/isobus/pGNAndSPN/1632?type=PGN)";
CM_ BO_ 2147515392  "Source: isobus.net VDMA Data Dictionary (https://www.isobus.net/isobus/pGNAndSPN/1633?type=PGN)";
CM_ BO_ 2147515648  "Source: isobus.net VDMA Data Dictionary (https://www.isobus.net/isobus/pGNAndSPN/1655?type=PGN)";
CM_ BO_ 2147515904  "Source: isobus.net VDMA Data Dictionary (https://www.isobus.net/isobus/pGNAndSPN/1657?type=PGN)";
CM_ BO_ 2147516160  "Source: isobus.net VDMA Data Dictionary (https://www.isobus.net/isobus/pGNAndSPN/1661?type=PGN)";
CM_ BO_ 2147516416  "Source: isobus.net VDMA Data Dictionary (https://www.isobus.net/isobus/pGNAndSPN/1674?type=PGN)";
CM_ BO_ 2147516672  "Source: isobus.net VDMA Data Dictionary (https://www.isobus.net/isobus/pGNAndSPN/1680?type=PGN)";
CM_ BO_ 2147516928  "Source: isobus.net VDMA Data Dictionary (https://www.isobus.net/isobus/pGNAndSPN/1687?type=PGN)";
CM_ BO_ 2147517184  "Source: isobus.net VDMA Data Dictionary (https://www.isobus.net/isobus/pGNAndSPN/1690?type=PGN)";
CM_ BO_ 2147517440  "Source: isobus.net VDMA Data Dictionary (https://www.isobus.net/isobus/pGNAndSPN/1695?type=PGN)";
CM_ BO_ 2147517696  "Source: isobus.net VDMA Data Dictionary (https://www.isobus.net/isobus/pGNAndSPN/1713?type=PGN)";
CM_ BO_ 2147517952  "Source: isobus.net VDMA Data Dictionary (https://www.isobus.net/isobus/pGNAndSPN/1745?type=PGN)";
CM_ BO_ 2147518208  "Source: isobus.net VDMA Data Dictionary (https://www.isobus.net/isobus/pGNAndSPN/1754?type=PGN)";
CM_ BO_ 2147518464  "Source: isobus.net VDMA Data Dictionary (https://www.isobus.net/isobus/pGNAndSPN/1758?type=PGN)";
CM_ BO_ 2147518720  "Source: isobus.net VDMA Data Dictionary (https://www.isobus.net/isobus/pGNAndSPN/1759?type=PGN)";
CM_ BO_ 2147518976  "Source: isobus.net VDMA Data Dictionary (https://www.isobus.net/isobus/pGNAndSPN/1760?type=PGN)";
CM_ BO_ 2147519232  "Source: isobus.net VDMA Data Dictionary (https://www.isobus.net/isobus/pGNAndSPN/1761?type=PGN)";
CM_ BO_ 2147519488  "Source: isobus.net VDMA Data Dictionary (https://www.isobus.net/isobus/pGNAndSPN/1762?type=PGN)";
CM_ BO_ 2147519744  "Source: isobus.net VDMA Data Dictionary (https://www.isobus.net/isobus/pGNAndSPN/1763?type=PGN)";
CM_ BO_ 2147520000  "Source: isobus.net VDMA Data Dictionary (https://www.isobus.net/isobus/pGNAndSPN/1764?type=PGN)";
CM_ BO_ 2147520256  "Source: isobus.net VDMA Data Dictionary (https://www.isobus.net/isobus/pGNAndSPN/1765?type=PGN)";
CM_ BO_ 2147520512  "Source: isobus.net VDMA Data Dictionary (https://www.isobus.net/isobus/pGNAndSPN/1769?type=PGN)";
CM_ BO_ 2147520768  "Source: isobus.net VDMA Data Dictionary (https://www.isobus.net/isobus/pGNAndSPN/1774?type=PGN)";
CM_ BO_ 2147521024  "Source: isobus.net VDMA Data Dictionary (https://www.isobus.net/isobus/pGNAndSPN/1780?type=PGN)";
CM_ BO_ 2147521280  "Source: isobus.net VDMA Data Dictionary (https://www.isobus.net/isobus/pGNAndSPN/1798?type=PGN)";
CM_ BO_ 2147521536  "Source: isobus.net VDMA Data Dictionary (https://www.isobus.net/isobus/pGNAndSPN/1800?type=PGN)";
CM_ BO_ 2147521792  "Source: isobus.net VDMA Data Dictionary (https://www.isobus.net/isobus/pGNAndSPN/1802?type=PGN)";
CM_ BO_ 2147522048  "Source: isobus.net VDMA Data Dictionary (https://www.isobus.net/isobus/pGNAndSPN/1803?type=PGN)";
CM_ BO_ 2147522304  "Source: isobus.net VDMA Data Dictionary (https://www.isobus.net/isobus/pGNAndSPN/1805?type=PGN)";
CM_ BO_ 2147522560  "Source: isobus.net VDMA Data Dictionary (https://www.isobus.net/isobus/pGNAndSPN/1807?type=PGN)";
CM_ BO_ 2147522816  "Source: isobus.net VDMA Data Dictionary (https://www.isobus.net/isobus/pGNAndSPN/1837?type=PGN)";
CM_ BO_ 2147523072  "Source: isobus.net VDMA Data Dictionary (https://www.isobus.net/isobus/pGNAndSPN/1838?type=PGN)";
CM_ BO_ 2147523584  "Source: isobus.net VDMA Data Dictionary (https://www.isobus.net/isobus/pGNAndSPN/1848?type=PGN)";
CM_ BO_ 2147523840  "Source: isobus.net VDMA Data Dictionary (https://www.isobus.net/isobus/pGNAndSPN/1856?type=PGN)";
CM_ BO_ 2147524096  "Source: isobus.net VDMA Data Dictionary (https://www.isobus.net/isobus/pGNAndSPN/1861?type=PGN)";
CM_ BO_ 2147524352  "Source: isobus.net VDMA Data Dictionary (https://www.isobus.net/isobus/pGNAndSPN/1873?type=PGN)";
CM_ BO_ 2147524608  "Source: isobus.net VDMA Data Dictionary (https://www.isobus.net/isobus/pGNAndSPN/1879?type=PGN)";
CM_ BO_ 2147524864  "Source: isobus.net VDMA Data Dictionary (https://www.isobus.net/isobus/pGNAndSPN/1882?type=PGN)";
CM_ BO_ 2147525120  "Source: isobus.net VDMA Data Dictionary (https://www.isobus.net/isobus/pGNAndSPN/1887?type=PGN)";
CM_ BO_ 2147525376  "Source: isobus.net VDMA Data Dictionary (https://www.isobus.net/isobus/pGNAndSPN/1899?type=PGN)";
CM_ BO_ 2147525632  "Source: isobus.net VDMA Data Dictionary (https://www.isobus.net/isobus/pGNAndSPN/1906?type=PGN)";
CM_ BO_ 2147525888  "Source: isobus.net VDMA Data Dictionary (https://www.isobus.net/isobus/pGNAndSPN/1938?type=PGN)";
CM_ BO_ 2147526144  "Source: isobus.net VDMA Data Dictionary (https://www.isobus.net/isobus/pGNAndSPN/1970?type=PGN)";
CM_ BO_ 2147526400  "Source: isobus.net VDMA Data Dictionary (https://www.isobus.net/isobus/pGNAndSPN/2002?type=PGN)";
CM_ BO_ 2147526656  "Source: isobus.net VDMA Data Dictionary (https://www.isobus.net/isobus/pGNAndSPN/2005?type=PGN)";
CM_ BO_ 2147526912  "Source: isobus.net VDMA Data Dictionary (https://www.isobus.net/isobus/pGNAndSPN/2011?type=PGN)";
CM_ BO_ 2147527168  "Source: isobus.net VDMA Data Dictionary (https://www.isobus.net/isobus/pGNAndSPN/2012?type=PGN)";
CM_ BO_ 2147527424  "Source: isobus.net VDMA Data Dictionary (https://www.isobus.net/isobus/pGNAndSPN/2013?type=PGN)";
CM_ BO_ 2147528192  "Source: isobus.net VDMA Data Dictionary (https://www.isobus.net/isobus/pGNAndSPN/2025?type=PGN)";
CM_ BO_ 2147528448  "Source: isobus.net VDMA Data Dictionary (https://www.isobus.net/isobus/pGNAndSPN/2026?type=PGN)";
CM_ BO_ 2147528704  "Source: isobus.net VDMA Data Dictionary (https://www.isobus.net/isobus/pGNAndSPN/2027?type=PGN)";
CM_ BO_ 2147528960  "Source: isobus.net VDMA Data Dictionary (https://www.isobus.net/isobus/pGNAndSPN/2028?type=PGN)";
CM_ BO_ 2147529216  "Source: isobus.net VDMA Data Dictionary (https://www.isobus.net/isobus/pGNAndSPN/2029?type=PGN)";
CM_ BO_ 2147529472  "Source: isobus.net VDMA Data Dictionary (https://www.isobus.net/isobus/pGNAndSPN/2030?type=PGN)";
CM_ BO_ 2147529728  "Source: isobus.net VDMA Data Dictionary (https://www.isobus.net/isobus/pGNAndSPN/2031?type=PGN)";
CM_ BO_ 2147529984  "Source: isobus.net VDMA Data Dictionary (https://www.isobus.net/isobus/pGNAndSPN/2032?type=PGN)";
CM_ BO_ 2147530240  "Source: isobus.net VDMA Data Dictionary (https://www.isobus.net/isobus/pGNAndSPN/2033?type=PGN)";
CM_ BO_ 2147530496  "Source: isobus.net VDMA Data Dictionary (https://www.isobus.net/isobus/pGNAndSPN/2034?type=PGN)";
CM_ BO_ 2147530752  "Source: isobus.net VDMA Data Dictionary (https://www.isobus.net/isobus/pGNAndSPN/2035?type=PGN)";
CM_ BO_ 2147531008  "Source: isobus.net VDMA Data Dictionary (https://www.isobus.net/isobus/pGNAndSPN/2036?type=PGN)";
CM_ BO_ 2147531264  "Source: isobus.net VDMA Data Dictionary (https://www.isobus.net/isobus/pGNAndSPN/2037?type=PGN)";
CM_ BO_ 2147531520  "Source: isobus.net VDMA Data Dictionary (https://www.isobus.net/isobus/pGNAndSPN/2038?type=PGN)";
CM_ BO_ 2147531776  "Source: isobus.net VDMA Data Dictionary (https://www.isobus.net/isobus/pGNAndSPN/2039?type=PGN)";
CM_ BO_ 2147532032  "Source: isobus.net VDMA Data Dictionary (https://www.isobus.net/isobus/pGNAndSPN/2040?type=PGN)";
CM_ BO_ 2147532288  "Source: isobus.net VDMA Data Dictionary (https://www.isobus.net/isobus/pGNAndSPN/2041?type=PGN)";
CM_ BO_ 2147532544  "Source: isobus.net VDMA Data Dictionary (https://www.isobus.net/isobus/pGNAndSPN/2042?type=PGN)";
CM_ BO_ 2147532800  "Source: isobus.net VDMA Data Dictionary (https://www.isobus.net/isobus/pGNAndSPN/2043?type=PGN)";
CM_ BO_ 2147533056  "Source: isobus.net VDMA Data Dictionary (https://www.isobus.net/isobus/pGNAndSPN/2047?type=PGN)";
CM_ BO_ 2147533312  "Source: isobus.net VDMA Data Dictionary (https://www.isobus.net/isobus/pGNAndSPN/2052?type=PGN)";
CM_ BO_ 2147533824  "Source: isobus.net VDMA Data Dictionary (https://www.isobus.net/isobus/pGNAndSPN/2060?type=PGN)";
CM_ BO_ 2147534080  "Source: isobus.net VDMA Data Dictionary (https://www.isobus.net/isobus/pGNAndSPN/2066?type=PGN)";
CM_ BO_ 2147534336  "Source: isobus.net VDMA Data Dictionary (https://www.isobus.net/isobus/pGNAndSPN/2074?type=PGN)";
CM_ BO_ 2147535104  "Source: isobus.net VDMA Data Dictionary (https://www.isobus.net/isobus/pGNAndSPN/2082?type=PGN)";
CM_ BO_ 2147535360  "Source: isobus.net VDMA Data Dictionary (https://www.isobus.net/isobus/pGNAndSPN/2086?type=PGN)";
CM_ BO_ 2147536640  "Source: isobus.net VDMA Data Dictionary (https://www.isobus.net/isobus/pGNAndSPN/2102?type=PGN)";
CM_ BO_ 2147536896  "Source: isobus.net VDMA Data Dictionary (https://www.isobus.net/isobus/pGNAndSPN/2103?type=PGN)";
CM_ BO_ 2147537152  "Source: isobus.net VDMA Data Dictionary (https://www.isobus.net/isobus/pGNAndSPN/2107?type=PGN)";
CM_ BO_ 2147537408  "Source: isobus.net VDMA Data Dictionary (https://www.isobus.net/isobus/pGNAndSPN/2126?type=PGN)";
CM_ BO_ 2147537664  "Source: isobus.net VDMA Data Dictionary (https://www.isobus.net/isobus/pGNAndSPN/2128?type=PGN)";
CM_ BO_ 2147537920  "Source: isobus.net VDMA Data Dictionary (https://www.isobus.net/isobus/pGNAndSPN/2131?type=PGN)";
CM_ BO_ 2147538176  "Source: isobus.net VDMA Data Dictionary (https://www.isobus.net/isobus/pGNAndSPN/2139?type=PGN)";
CM_ BO_ 2147538432  "Source: isobus.net VDMA Data Dictionary (https://www.isobus.net/isobus/pGNAndSPN/2140?type=PGN)";
CM_ BO_ 2147539968  "Source: isobus.net VDMA Data Dictionary (https://www.isobus.net/isobus/pGNAndSPN/2160?type=PGN)";
CM_ BO_ 2147540224  "Source: isobus.net VDMA Data Dictionary (https://www.isobus.net/isobus/pGNAndSPN/2164?type=PGN)";
CM_ BO_ 2147540480  "Source: isobus.net VDMA Data Dictionary (https://www.isobus.net/isobus/pGNAndSPN/2175?type=PGN)";
CM_ BO_ 2147540992  "Source: isobus.net VDMA Data Dictionary (https://www.isobus.net/isobus/pGNAndSPN/2208?type=PGN)";
CM_ BO_ 2147541248  "Source: isobus.net VDMA Data Dictionary (https://www.isobus.net/isobus/pGNAndSPN/2209?type=PGN)";
CM_ BO_ 2147541504  "Source: isobus.net VDMA Data Dictionary (https://www.isobus.net/isobus/pGNAndSPN/2210?type=PGN)";
CM_ BO_ 2147541760  "Source: isobus.net VDMA Data Dictionary (https://www.isobus.net/isobus/pGNAndSPN/2213?type=PGN)";
CM_ BO_ 2147542016  "Source: isobus.net VDMA Data Dictionary (https://www.isobus.net/isobus/pGNAndSPN/2214?type=PGN)";
CM_ BO_ 2147542272  "Source: isobus.net VDMA Data Dictionary (https://www.isobus.net/isobus/pGNAndSPN/2215?type=PGN)";
CM_ BO_ 2147544320  "Source: isobus.net VDMA Data Dictionary (https://www.isobus.net/isobus/pGNAndSPN/2269?type=PGN)";
CM_ BO_ 2147545088  "Source: isobus.net VDMA Data Dictionary (https://www.isobus.net/isobus/pGNAndSPN/2284?type=PGN)";
CM_ BO_ 2147545089  "Source: isobus.net VDMA Data Dictionary (https://www.isobus.net/isobus/pGNAndSPN/2307?type=PGN)";
CM_ BO_ 2147545090  "Source: isobus.net VDMA Data Dictionary (https://www.isobus.net/isobus/pGNAndSPN/2318?type=PGN)";
CM_ BO_ 2147545093  "Source: isobus.net VDMA Data Dictionary (https://www.isobus.net/isobus/pGNAndSPN/2345?type=PGN)";
CM_ BO_ 2147545094  "Source: isobus.net VDMA Data Dictionary (https://www.isobus.net/isobus/pGNAndSPN/2357?type=PGN)";
CM_ BO_ 2147545095  "Source: isobus.net VDMA Data Dictionary (https://www.isobus.net/isobus/pGNAndSPN/2368?type=PGN)";
CM_ BO_ 2147545096  "Source: isobus.net VDMA Data Dictionary (https://www.isobus.net/isobus/pGNAndSPN/2379?type=PGN)";
CM_ BO_ 2147545097  "Source: isobus.net VDMA Data Dictionary (https://www.isobus.net/isobus/pGNAndSPN/2385?type=PGN)";
CM_ BO_ 2147545098  "Source: isobus.net VDMA Data Dictionary (https://www.isobus.net/isobus/pGNAndSPN/2389?type=PGN)";
CM_ BO_ 2147545099  "Source: isobus.net VDMA Data Dictionary (https://www.isobus.net/isobus/pGNAndSPN/2396?type=PGN)";
CM_ BO_ 2147545100  "Source: isobus.net VDMA Data Dictionary (https://www.isobus.net/isobus/pGNAndSPN/2402?type=PGN)";
CM_ BO_ 2147545101  "Source: isobus.net VDMA Data Dictionary (https://www.isobus.net/isobus/pGNAndSPN/2413?type=PGN)";
CM_ BO_ 2147545102  "Source: isobus.net VDMA Data Dictionary (https://www.isobus.net/isobus/pGNAndSPN/2424?type=PGN)";
CM_ BO_ 2147545103  "Source: isobus.net VDMA Data Dictionary (https://www.isobus.net/isobus/pGNAndSPN/2435?type=PGN)";
CM_ BO_ 2147545104  "Source: isobus.net VDMA Data Dictionary (https://www.isobus.net/isobus/pGNAndSPN/2447?type=PGN)";
CM_ BO_ 2147545105  "Source: isobus.net VDMA Data Dictionary (https://www.isobus.net/isobus/pGNAndSPN/2459?type=PGN)";
CM_ BO_ 2147545106  "Source: isobus.net VDMA Data Dictionary (https://www.isobus.net/isobus/pGNAndSPN/2463?type=PGN)";
CM_ BO_ 2147545107  "Source: isobus.net VDMA Data Dictionary (https://www.isobus.net/isobus/pGNAndSPN/2471?type=PGN)";
CM_ BO_ 2147545108  "Source: isobus.net VDMA Data Dictionary (https://www.isobus.net/isobus/pGNAndSPN/2476?type=PGN)";
CM_ BO_ 2147545109  "Source: isobus.net VDMA Data Dictionary (https://www.isobus.net/isobus/pGNAndSPN/2479?type=PGN)";
CM_ BO_ 2147545110  "Source: isobus.net VDMA Data Dictionary (https://www.isobus.net/isobus/pGNAndSPN/2503?type=PGN)";
CM_ BO_ 2147545111  "Source: isobus.net VDMA Data Dictionary (https://www.isobus.net/isobus/pGNAndSPN/2511?type=PGN)";
CM_ BO_ 2147545112  "Source: isobus.net VDMA Data Dictionary (https://www.isobus.net/isobus/pGNAndSPN/2519?type=PGN)";
CM_ BO_ 2147545113  "Source: isobus.net VDMA Data Dictionary (https://www.isobus.net/isobus/pGNAndSPN/2527?type=PGN)";
CM_ BO_ 2147545114  "Source: isobus.net VDMA Data Dictionary (https://www.isobus.net/isobus/pGNAndSPN/2531?type=PGN)";
CM_ BO_ 2147545115  "Source: isobus.net VDMA Data Dictionary (https://www.isobus.net/isobus/pGNAndSPN/2532?type=PGN)";
CM_ BO_ 2147545116  "Source: isobus.net VDMA Data Dictionary (https://www.isobus.net/isobus/pGNAndSPN/2533?type=PGN)";
CM_ BO_ 2147545117  "Source: isobus.net VDMA Data Dictionary (https://www.isobus.net/isobus/pGNAndSPN/2541?type=PGN)";
CM_ BO_ 2147545118  "Source: isobus.net VDMA Data Dictionary (https://www.isobus.net/isobus/pGNAndSPN/2544?type=PGN)";
CM_ BO_ 2147545119  "Source: isobus.net VDMA Data Dictionary (https://www.isobus.net/isobus/pGNAndSPN/2545?type=PGN)";
CM_ BO_ 2147545120  "Source: isobus.net VDMA Data Dictionary (https://www.isobus.net/isobus/pGNAndSPN/2546?type=PGN)";
CM_ BO_ 2147545121  "Source: isobus.net VDMA Data Dictionary (https://www.isobus.net/isobus/pGNAndSPN/2552?type=PGN)";
CM_ BO_ 2147545123  "Source: isobus.net VDMA Data Dictionary (https://www.isobus.net/isobus/pGNAndSPN/2564?type=PGN)";
CM_ BO_ 2147545124  "Source: isobus.net VDMA Data Dictionary (https://www.isobus.net/isobus/pGNAndSPN/2570?type=PGN)";
CM_ BO_ 2147545125  "Source: isobus.net VDMA Data Dictionary (https://www.isobus.net/isobus/pGNAndSPN/2577?type=PGN)";
CM_ BO_ 2147545126  "Source: isobus.net VDMA Data Dictionary (https://www.isobus.net/isobus/pGNAndSPN/2583?type=PGN)";
CM_ BO_ 2147545127  "Source: isobus.net VDMA Data Dictionary (https://www.isobus.net/isobus/pGNAndSPN/2590?type=PGN)";
CM_ BO_ 2147545128  "Source: isobus.net VDMA Data Dictionary (https://www.isobus.net/isobus/pGNAndSPN/2597?type=PGN)";
CM_ BO_ 2147545129  "Source: isobus.net VDMA Data Dictionary (https://www.isobus.net/isobus/pGNAndSPN/2604?type=PGN)";
CM_ BO_ 2147545130  "Source: isobus.net VDMA Data Dictionary (https://www.isobus.net/isobus/pGNAndSPN/2611?type=PGN)";
CM_ BO_ 2147545131  "Source: isobus.net VDMA Data Dictionary (https://www.isobus.net/isobus/pGNAndSPN/2614?type=PGN)";
CM_ BO_ 2147545132  "Source: isobus.net VDMA Data Dictionary (https://www.isobus.net/isobus/pGNAndSPN/2624?type=PGN)";
CM_ BO_ 2147545133  "Source: isobus.net VDMA Data Dictionary (https://www.isobus.net/isobus/pGNAndSPN/2631?type=PGN)";
CM_ BO_ 2147545134  "Source: isobus.net VDMA Data Dictionary (https://www.isobus.net/isobus/pGNAndSPN/2635?type=PGN)";
CM_ BO_ 2147545135  "Source: isobus.net VDMA Data Dictionary (https://www.isobus.net/isobus/pGNAndSPN/2641?type=PGN)";
CM_ BO_ 2147545136  "Source: isobus.net VDMA Data Dictionary (https://www.isobus.net/isobus/pGNAndSPN/2645?type=PGN)";
CM_ BO_ 2147545137  "Source: isobus.net VDMA Data Dictionary (https://www.isobus.net/isobus/pGNAndSPN/2647?type=PGN)";
CM_ BO_ 2147545138  "Source: isobus.net VDMA Data Dictionary (https://www.isobus.net/isobus/pGNAndSPN/2649?type=PGN)";
CM_ BO_ 2147545139  "Source: isobus.net VDMA Data Dictionary (https://www.isobus.net/isobus/pGNAndSPN/2656?type=PGN)";
CM_ BO_ 2147545140  "Source: isobus.net VDMA Data Dictionary (https://www.isobus.net/isobus/pGNAndSPN/2663?type=PGN)";
CM_ BO_ 2147545142  "Source: isobus.net VDMA Data Dictionary (https://www.isobus.net/isobus/pGNAndSPN/2677?type=PGN)";
CM_ BO_ 2147545143  "Source: isobus.net VDMA Data Dictionary (https://www.isobus.net/isobus/pGNAndSPN/2683?type=PGN)";
CM_ BO_ 2147545144  "Source: isobus.net VDMA Data Dictionary (https://www.isobus.net/isobus/pGNAndSPN/2688?type=PGN)";
CM_ BO_ 2147545145  "Source: isobus.net VDMA Data Dictionary (https://www.isobus.net/isobus/pGNAndSPN/2692?type=PGN)";
CM_ BO_ 2147545146  "Source: isobus.net VDMA Data Dictionary (https://www.isobus.net/isobus/pGNAndSPN/2698?type=PGN)";
CM_ BO_ 2147545147  "Source: isobus.net VDMA Data Dictionary (https://www.isobus.net/isobus/pGNAndSPN/2704?type=PGN)";
CM_ BO_ 2147545148  "Source: isobus.net VDMA Data Dictionary (https://www.isobus.net/isobus/pGNAndSPN/2710?type=PGN)";
CM_ BO_ 2147545149  "Source: isobus.net VDMA Data Dictionary (https://www.isobus.net/isobus/pGNAndSPN/2716?type=PGN)";
CM_ BO_ 2147545150  "Source: isobus.net VDMA Data Dictionary (https://www.isobus.net/isobus/pGNAndSPN/2722?type=PGN)";
CM_ BO_ 2147545151  "Source: isobus.net VDMA Data Dictionary (https://www.isobus.net/isobus/pGNAndSPN/2728?type=PGN)";
CM_ BO_ 2147545152  "Source: isobus.net VDMA Data Dictionary (https://www.isobus.net/isobus/pGNAndSPN/2734?type=PGN)";
CM_ BO_ 2147545153  "Source: isobus.net VDMA Data Dictionary (https://www.isobus.net/isobus/pGNAndSPN/2740?type=PGN)";
CM_ BO_ 2147545154  "Source: isobus.net VDMA Data Dictionary (https://www.isobus.net/isobus/pGNAndSPN/2746?type=PGN)";
CM_ BO_ 2147545155  "Source: isobus.net VDMA Data Dictionary (https://www.isobus.net/isobus/pGNAndSPN/2752?type=PGN)";
CM_ BO_ 2147545156  "Source: isobus.net VDMA Data Dictionary (https://www.isobus.net/isobus/pGNAndSPN/2758?type=PGN)";
CM_ BO_ 2147545157  "Source: isobus.net VDMA Data Dictionary (https://www.isobus.net/isobus/pGNAndSPN/2764?type=PGN)";
CM_ BO_ 2147545158  "Source: isobus.net VDMA Data Dictionary (https://www.isobus.net/isobus/pGNAndSPN/2770?type=PGN)";
CM_ BO_ 2147545159  "Source: isobus.net VDMA Data Dictionary (https://www.isobus.net/isobus/pGNAndSPN/2776?type=PGN)";
CM_ BO_ 2147545160  "Source: isobus.net VDMA Data Dictionary (https://www.isobus.net/isobus/pGNAndSPN/2782?type=PGN)";
CM_ BO_ 2147545161  "Source: isobus.net VDMA Data Dictionary (https://www.isobus.net/isobus/pGNAndSPN/2788?type=PGN)";
CM_ BO_ 2147545162  "Source: isobus.net VDMA Data Dictionary (https://www.isobus.net/isobus/pGNAndSPN/2794?type=PGN)";
CM_ BO_ 2147545163  "Source: isobus.net VDMA Data Dictionary (https://www.isobus.net/isobus/pGNAndSPN/2800?type=PGN)";
CM_ BO_ 2147545164  "Source: isobus.net VDMA Data Dictionary (https://www.isobus.net/isobus/pGNAndSPN/2806?type=PGN)";
CM_ BO_ 2147545165  "Source: isobus.net VDMA Data Dictionary (https://www.isobus.net/isobus/pGNAndSPN/2812?type=PGN)";
CM_ BO_ 2147545166  "Source: isobus.net VDMA Data Dictionary (https://www.isobus.net/isobus/pGNAndSPN/2816?type=PGN)";
CM_ BO_ 2147545167  "Source: isobus.net VDMA Data Dictionary (https://www.isobus.net/isobus/pGNAndSPN/2820?type=PGN)";
CM_ BO_ 2147545168  "Source: isobus.net VDMA Data Dictionary (https://www.isobus.net/isobus/pGNAndSPN/2824?type=PGN)";
CM_ BO_ 2147545169  "Source: isobus.net VDMA Data Dictionary (https://www.isobus.net/isobus/pGNAndSPN/2828?type=PGN)";
CM_ BO_ 2147545170  "Source: isobus.net VDMA Data Dictionary (https://www.isobus.net/isobus/pGNAndSPN/2832?type=PGN)";
CM_ BO_ 2147545171  "Source: isobus.net VDMA Data Dictionary (https://www.isobus.net/isobus/pGNAndSPN/2836?type=PGN)";
CM_ BO_ 2147545172  "Source: isobus.net VDMA Data Dictionary (https://www.isobus.net/isobus/pGNAndSPN/2840?type=PGN)";
CM_ BO_ 2147545173  "Source: isobus.net VDMA Data Dictionary (https://www.isobus.net/isobus/pGNAndSPN/2844?type=PGN)";
CM_ BO_ 2147545174  "Source: isobus.net VDMA Data Dictionary (https://www.isobus.net/isobus/pGNAndSPN/2848?type=PGN)";
CM_ BO_ 2147545175  "Source: isobus.net VDMA Data Dictionary (https://www.isobus.net/isobus/pGNAndSPN/2852?type=PGN)";
CM_ BO_ 2147545176  "Source: isobus.net VDMA Data Dictionary (https://www.isobus.net/isobus/pGNAndSPN/2856?type=PGN)";
CM_ BO_ 2147545177  "Source: isobus.net VDMA Data Dictionary (https://www.isobus.net/isobus/pGNAndSPN/2860?type=PGN)";

CM_ SG_ 2147483904 Transmission_Control_1_RawPayloa "Generic 8-byte raw payload. Detail page: https://www.isobus.net/isobus/pGNAndSPN/38?type=PGN. Signal-level enrichment via PR welcome  see CONTRIBUTING.md.";
CM_ SG_ 2147484160 Electronic_Brake_System_1_1_RawP "Generic 8-byte raw payload. Detail page: https://www.isobus.net/isobus/pGNAndSPN/39?type=PGN. Signal-level enrichment via PR welcome  see CONTRIBUTING.md.";
CM_ SG_ 2147484416 Electronic_Brake_System_2_1_RawP "Generic 8-byte raw payload. Detail page: https://www.isobus.net/isobus/pGNAndSPN/40?type=PGN. Signal-level enrichment via PR welcome  see CONTRIBUTING.md.";
CM_ SG_ 2147484672 External_Brake_Request_RawPayloa "Generic 8-byte raw payload. Detail page: https://www.isobus.net/isobus/pGNAndSPN/50?type=PGN. Signal-level enrichment via PR welcome  see CONTRIBUTING.md.";
CM_ SG_ 2147484928 CANopen_Application_Message_1_1_ "Generic 8-byte raw payload. Detail page: https://www.isobus.net/isobus/pGNAndSPN/51?type=PGN. Signal-level enrichment via PR welcome  see CONTRIBUTING.md.";
CM_ SG_ 2147485184 CANopen_Application_Message_2_1_ "Generic 8-byte raw payload. Detail page: https://www.isobus.net/isobus/pGNAndSPN/52?type=PGN. Signal-level enrichment via PR welcome  see CONTRIBUTING.md.";
CM_ SG_ 2147485440 General_Purpose_Valve_Pressure_R "Generic 8-byte raw payload. Detail page: https://www.isobus.net/isobus/pGNAndSPN/57?type=PGN. Signal-level enrichment via PR welcome  see CONTRIBUTING.md.";
CM_ SG_ 2147485696 Auxiliary_Input_Output_Status_5_ "Generic 8-byte raw payload. Detail page: https://www.isobus.net/isobus/pGNAndSPN/61?type=PGN. Signal-level enrichment via PR welcome  see CONTRIBUTING.md.";
CM_ SG_ 2147485952 Static_Roll_Angle_Sensor_Informa "Generic 8-byte raw payload. Detail page: https://www.isobus.net/isobus/pGNAndSPN/63?type=PGN. Signal-level enrichment via PR welcome  see CONTRIBUTING.md.";
CM_ SG_ 2147486208 Cruise_Control_Vehicle_Speed_2_R "Generic 8-byte raw payload. Detail page: https://www.isobus.net/isobus/pGNAndSPN/71?type=PGN. Signal-level enrichment via PR welcome  see CONTRIBUTING.md.";
CM_ SG_ 2147486464 Advanced_Emergency_Braking_Syste "Generic 8-byte raw payload. Detail page: https://www.isobus.net/isobus/pGNAndSPN/74?type=PGN. Signal-level enrichment via PR welcome  see CONTRIBUTING.md.";
CM_ SG_ 2147486720 Electronic_Engine_Controller_16_ "Generic 8-byte raw payload. Detail page: https://www.isobus.net/isobus/pGNAndSPN/77?type=PGN. Signal-level enrichment via PR welcome  see CONTRIBUTING.md.";
CM_ SG_ 2147486976 Transmission_Control_2_RawPayloa "Generic 8-byte raw payload. Detail page: https://www.isobus.net/isobus/pGNAndSPN/96?type=PGN. Signal-level enrichment via PR welcome  see CONTRIBUTING.md.";
CM_ SG_ 2147487232 Safety_Header_Message_RawPayload "Generic 8-byte raw payload. Detail page: https://www.isobus.net/isobus/pGNAndSPN/103?type=PGN. Signal-level enrichment via PR welcome  see CONTRIBUTING.md.";
CM_ SG_ 2147487488 High_Voltage_Energy_Storage_Pack "Generic 8-byte raw payload. Detail page: https://www.isobus.net/isobus/pGNAndSPN/115?type=PGN. Signal-level enrichment via PR welcome  see CONTRIBUTING.md.";
CM_ SG_ 2147487744 High_Voltage_Energy_Storage_Pack "Generic 8-byte raw payload. Detail page: https://www.isobus.net/isobus/pGNAndSPN/127?type=PGN. Signal-level enrichment via PR welcome  see CONTRIBUTING.md.";
CM_ SG_ 2147488000 High_Voltage_Energy_Storage_Pack "Generic 8-byte raw payload. Detail page: https://www.isobus.net/isobus/pGNAndSPN/139?type=PGN. Signal-level enrichment via PR welcome  see CONTRIBUTING.md.";
CM_ SG_ 2147488256 High_Voltage_Energy_Storage_Pack "Generic 8-byte raw payload. Detail page: https://www.isobus.net/isobus/pGNAndSPN/151?type=PGN. Signal-level enrichment via PR welcome  see CONTRIBUTING.md.";
CM_ SG_ 2147488512 High_Voltage_Energy_Storage_Pack "Generic 8-byte raw payload. Detail page: https://www.isobus.net/isobus/pGNAndSPN/163?type=PGN. Signal-level enrichment via PR welcome  see CONTRIBUTING.md.";
CM_ SG_ 2147488768 High_Voltage_Energy_Storage_Pack "Generic 8-byte raw payload. Detail page: https://www.isobus.net/isobus/pGNAndSPN/175?type=PGN. Signal-level enrichment via PR welcome  see CONTRIBUTING.md.";
CM_ SG_ 2147489024 High_Voltage_Energy_Storage_Pack "Generic 8-byte raw payload. Detail page: https://www.isobus.net/isobus/pGNAndSPN/187?type=PGN. Signal-level enrichment via PR welcome  see CONTRIBUTING.md.";
CM_ SG_ 2147489280 High_Voltage_Energy_Storage_Pack "Generic 8-byte raw payload. Detail page: https://www.isobus.net/isobus/pGNAndSPN/199?type=PGN. Signal-level enrichment via PR welcome  see CONTRIBUTING.md.";
CM_ SG_ 2147489536 High_Voltage_Energy_Storage_Pack "Generic 8-byte raw payload. Detail page: https://www.isobus.net/isobus/pGNAndSPN/211?type=PGN. Signal-level enrichment via PR welcome  see CONTRIBUTING.md.";
CM_ SG_ 2147489792 High_Voltage_Energy_Storage_Pack "Generic 8-byte raw payload. Detail page: https://www.isobus.net/isobus/pGNAndSPN/223?type=PGN. Signal-level enrichment via PR welcome  see CONTRIBUTING.md.";
CM_ SG_ 2147490048 High_Voltage_Energy_Storage_Pack "Generic 8-byte raw payload. Detail page: https://www.isobus.net/isobus/pGNAndSPN/235?type=PGN. Signal-level enrichment via PR welcome  see CONTRIBUTING.md.";
CM_ SG_ 2147490304 High_Voltage_Energy_Storage_Pack "Generic 8-byte raw payload. Detail page: https://www.isobus.net/isobus/pGNAndSPN/247?type=PGN. Signal-level enrichment via PR welcome  see CONTRIBUTING.md.";
CM_ SG_ 2147490560 High_Voltage_Energy_Storage_Syst "Generic 8-byte raw payload. Detail page: https://www.isobus.net/isobus/pGNAndSPN/259?type=PGN. Signal-level enrichment via PR welcome  see CONTRIBUTING.md.";
CM_ SG_ 2147490816 Transmission_Control_3_Obsolete_ "Generic 8-byte raw payload. Detail page: https://www.isobus.net/isobus/pGNAndSPN/267?type=PGN. Signal-level enrichment via PR welcome  see CONTRIBUTING.md.";
CM_ SG_ 2147491072 Engine_Ignition_Controller_RawPa "Generic 8-byte raw payload. Detail page: https://www.isobus.net/isobus/pGNAndSPN/268?type=PGN. Signal-level enrichment via PR welcome  see CONTRIBUTING.md.";
CM_ SG_ 2147491328 Alternator_Control_RawPayload "Generic 8-byte raw payload. Detail page: https://www.isobus.net/isobus/pGNAndSPN/272?type=PGN. Signal-level enrichment via PR welcome  see CONTRIBUTING.md.";
CM_ SG_ 2147491584 High_Voltage_Energy_Storage_Pack "Generic 8-byte raw payload. Detail page: https://www.isobus.net/isobus/pGNAndSPN/284?type=PGN. Signal-level enrichment via PR welcome  see CONTRIBUTING.md.";
CM_ SG_ 2147491840 High_Voltage_Energy_Storage_Pack "Generic 8-byte raw payload. Detail page: https://www.isobus.net/isobus/pGNAndSPN/296?type=PGN. Signal-level enrichment via PR welcome  see CONTRIBUTING.md.";
CM_ SG_ 2147492096 High_Voltage_Energy_Storage_Pack "Generic 8-byte raw payload. Detail page: https://www.isobus.net/isobus/pGNAndSPN/308?type=PGN. Signal-level enrichment via PR welcome  see CONTRIBUTING.md.";
CM_ SG_ 2147492352 High_Voltage_Energy_Storage_Pack "Generic 8-byte raw payload. Detail page: https://www.isobus.net/isobus/pGNAndSPN/320?type=PGN. Signal-level enrichment via PR welcome  see CONTRIBUTING.md.";
CM_ SG_ 2147492608 Tractor_Implement_Management_TIM "Generic 8-byte raw payload. Detail page: https://www.isobus.net/isobus/pGNAndSPN/494?type=PGN. Signal-level enrichment via PR welcome  see CONTRIBUTING.md.";
CM_ SG_ 2147492864 Tractor_Implement_Management_TIM "Generic 8-byte raw payload. Detail page: https://www.isobus.net/isobus/pGNAndSPN/584?type=PGN. Signal-level enrichment via PR welcome  see CONTRIBUTING.md.";
CM_ SG_ 2147493120 Multi_PG_RawPayload "Generic 8-byte raw payload. Detail page: https://www.isobus.net/isobus/pGNAndSPN/590?type=PGN. Signal-level enrichment via PR welcome  see CONTRIBUTING.md.";
CM_ SG_ 2147493376 Motor_Generator_1_Inverter_Contr "Generic 8-byte raw payload. Detail page: https://www.isobus.net/isobus/pGNAndSPN/598?type=PGN. Signal-level enrichment via PR welcome  see CONTRIBUTING.md.";
CM_ SG_ 2147493632 Motor_Generator_2_Inverter_Contr "Generic 8-byte raw payload. Detail page: https://www.isobus.net/isobus/pGNAndSPN/606?type=PGN. Signal-level enrichment via PR welcome  see CONTRIBUTING.md.";
CM_ SG_ 2147493888 Motor_Generator_1_Inverter_Rate_ "Generic 8-byte raw payload. Detail page: https://www.isobus.net/isobus/pGNAndSPN/610?type=PGN. Signal-level enrichment via PR welcome  see CONTRIBUTING.md.";
CM_ SG_ 2147494144 Motor_Generator_2_Inverter_Rate_ "Generic 8-byte raw payload. Detail page: https://www.isobus.net/isobus/pGNAndSPN/614?type=PGN. Signal-level enrichment via PR welcome  see CONTRIBUTING.md.";
CM_ SG_ 2147494400 High_Voltage_Energy_Storage_Pack "Generic 8-byte raw payload. Detail page: https://www.isobus.net/isobus/pGNAndSPN/626?type=PGN. Signal-level enrichment via PR welcome  see CONTRIBUTING.md.";
CM_ SG_ 2147494656 High_Voltage_Energy_Storage_Pack "Generic 8-byte raw payload. Detail page: https://www.isobus.net/isobus/pGNAndSPN/638?type=PGN. Signal-level enrichment via PR welcome  see CONTRIBUTING.md.";
CM_ SG_ 2147494912 High_Voltage_Energy_Storage_Pack "Generic 8-byte raw payload. Detail page: https://www.isobus.net/isobus/pGNAndSPN/650?type=PGN. Signal-level enrichment via PR welcome  see CONTRIBUTING.md.";
CM_ SG_ 2147495168 High_Voltage_Energy_Storage_Pack "Generic 8-byte raw payload. Detail page: https://www.isobus.net/isobus/pGNAndSPN/662?type=PGN. Signal-level enrichment via PR welcome  see CONTRIBUTING.md.";
CM_ SG_ 2147495424 High_Voltage_Energy_Storage_Pack "Generic 8-byte raw payload. Detail page: https://www.isobus.net/isobus/pGNAndSPN/674?type=PGN. Signal-level enrichment via PR welcome  see CONTRIBUTING.md.";
CM_ SG_ 2147495680 High_Voltage_Energy_Storage_Pack "Generic 8-byte raw payload. Detail page: https://www.isobus.net/isobus/pGNAndSPN/686?type=PGN. Signal-level enrichment via PR welcome  see CONTRIBUTING.md.";
CM_ SG_ 2147495936 High_Voltage_Energy_Storage_Pack "Generic 8-byte raw payload. Detail page: https://www.isobus.net/isobus/pGNAndSPN/698?type=PGN. Signal-level enrichment via PR welcome  see CONTRIBUTING.md.";
CM_ SG_ 2147496192 High_Voltage_Energy_Storage_Pack "Generic 8-byte raw payload. Detail page: https://www.isobus.net/isobus/pGNAndSPN/710?type=PGN. Signal-level enrichment via PR welcome  see CONTRIBUTING.md.";
CM_ SG_ 2147496448 High_Voltage_Energy_Storage_Pack "Generic 8-byte raw payload. Detail page: https://www.isobus.net/isobus/pGNAndSPN/722?type=PGN. Signal-level enrichment via PR welcome  see CONTRIBUTING.md.";
CM_ SG_ 2147496704 High_Voltage_Energy_Storage_Pack "Generic 8-byte raw payload. Detail page: https://www.isobus.net/isobus/pGNAndSPN/734?type=PGN. Signal-level enrichment via PR welcome  see CONTRIBUTING.md.";
CM_ SG_ 2147496960 Reliable_Long_Message_RawPayload "Generic 8-byte raw payload. Detail page: https://www.isobus.net/isobus/pGNAndSPN/735?type=PGN. Signal-level enrichment via PR welcome  see CONTRIBUTING.md.";
CM_ SG_ 2147497216 Reliable_Short_Message_RawPayloa "Generic 8-byte raw payload. Detail page: https://www.isobus.net/isobus/pGNAndSPN/736?type=PGN. Signal-level enrichment via PR welcome  see CONTRIBUTING.md.";
CM_ SG_ 2147497472 Unreliable_Message_RawPayload "Generic 8-byte raw payload. Detail page: https://www.isobus.net/isobus/pGNAndSPN/737?type=PGN. Signal-level enrichment via PR welcome  see CONTRIBUTING.md.";
CM_ SG_ 2147497728 Message_Acknowledgement_RawPaylo "Generic 8-byte raw payload. Detail page: https://www.isobus.net/isobus/pGNAndSPN/738?type=PGN. Signal-level enrichment via PR welcome  see CONTRIBUTING.md.";
CM_ SG_ 2147497984 Version_Negotiation_Section_RawP "Generic 8-byte raw payload. Detail page: https://www.isobus.net/isobus/pGNAndSPN/739?type=PGN. Signal-level enrichment via PR welcome  see CONTRIBUTING.md.";
CM_ SG_ 2147498240 External_ACC_Acceleration_Reques "Generic 8-byte raw payload. Detail page: https://www.isobus.net/isobus/pGNAndSPN/744?type=PGN. Signal-level enrichment via PR welcome  see CONTRIBUTING.md.";
CM_ SG_ 2147498496 Battery_Charger_1_Command_1_RawP "Generic 8-byte raw payload. Detail page: https://www.isobus.net/isobus/pGNAndSPN/748?type=PGN. Signal-level enrichment via PR welcome  see CONTRIBUTING.md.";
CM_ SG_ 2147498752 Battery_Charger_2_Command_1_RawP "Generic 8-byte raw payload. Detail page: https://www.isobus.net/isobus/pGNAndSPN/752?type=PGN. Signal-level enrichment via PR welcome  see CONTRIBUTING.md.";
CM_ SG_ 2147499008 Tractor_Implement_Management_TIM "Generic 8-byte raw payload. Detail page: https://www.isobus.net/isobus/pGNAndSPN/1073?type=PGN. Signal-level enrichment via PR welcome  see CONTRIBUTING.md.";
CM_ SG_ 2147499264 Tractor_Implement_Management_TIM "Generic 8-byte raw payload. Detail page: https://www.isobus.net/isobus/pGNAndSPN/1276?type=PGN. Signal-level enrichment via PR welcome  see CONTRIBUTING.md.";
CM_ SG_ 2147499520 Fuel_Cell_System_Control_Command "Generic 8-byte raw payload. Detail page: https://www.isobus.net/isobus/pGNAndSPN/1282?type=PGN. Signal-level enrichment via PR welcome  see CONTRIBUTING.md.";
CM_ SG_ 2147499776 Fuel_Cell_System_Power_Limit_Com "Generic 8-byte raw payload. Detail page: https://www.isobus.net/isobus/pGNAndSPN/1286?type=PGN. Signal-level enrichment via PR welcome  see CONTRIBUTING.md.";
CM_ SG_ 2147500032 Fuel_Cell_System_Current_Limit_C "Generic 8-byte raw payload. Detail page: https://www.isobus.net/isobus/pGNAndSPN/1290?type=PGN. Signal-level enrichment via PR welcome  see CONTRIBUTING.md.";
CM_ SG_ 2147500288 Hydrogen_Storage_System_Control_ "Generic 8-byte raw payload. Detail page: https://www.isobus.net/isobus/pGNAndSPN/1293?type=PGN. Signal-level enrichment via PR welcome  see CONTRIBUTING.md.";
CM_ SG_ 2147500544 Transmission_Control_4_RawPayloa "Generic 8-byte raw payload. Detail page: https://www.isobus.net/isobus/pGNAndSPN/1301?type=PGN. Signal-level enrichment via PR welcome  see CONTRIBUTING.md.";
CM_ SG_ 2147500800 Safety_Header_Message_2_RawPaylo "Generic 8-byte raw payload. Detail page: https://www.isobus.net/isobus/pGNAndSPN/1302?type=PGN. Signal-level enrichment via PR welcome  see CONTRIBUTING.md.";
CM_ SG_ 2147501568 API_Select_RawPayload "Generic 8-byte raw payload. Detail page: https://www.isobus.net/isobus/pGNAndSPN/1307?type=PGN. Signal-level enrichment via PR welcome  see CONTRIBUTING.md.";
CM_ SG_ 2147502080 Tractor_Implement_Management_TIM "Generic 8-byte raw payload. Detail page: https://www.isobus.net/isobus/pGNAndSPN/1308?type=PGN. Signal-level enrichment via PR welcome  see CONTRIBUTING.md.";
CM_ SG_ 2147502336 Tractor_Implement_Management_TIM "Generic 8-byte raw payload. Detail page: https://www.isobus.net/isobus/pGNAndSPN/1309?type=PGN. Signal-level enrichment via PR welcome  see CONTRIBUTING.md.";
CM_ SG_ 2147502592 EV_Multi_Connection_DC_Status_1_ "Generic 8-byte raw payload. Detail page: https://www.isobus.net/isobus/pGNAndSPN/1313?type=PGN. Signal-level enrichment via PR welcome  see CONTRIBUTING.md.";
CM_ SG_ 2147502848 EV_Multi_Connection_DC_Charging_ "Generic 8-byte raw payload. Detail page: https://www.isobus.net/isobus/pGNAndSPN/1317?type=PGN. Signal-level enrichment via PR welcome  see CONTRIBUTING.md.";
CM_ SG_ 2147503104 Electrified_Accessory_Engine_Coo "Generic 8-byte raw payload. Detail page: https://www.isobus.net/isobus/pGNAndSPN/1322?type=PGN. Signal-level enrichment via PR welcome  see CONTRIBUTING.md.";
CM_ SG_ 2147503360 FD_Transport_Protocol_Connection "Generic 8-byte raw payload. Detail page: https://www.isobus.net/isobus/pGNAndSPN/1336?type=PGN. Signal-level enrichment via PR welcome  see CONTRIBUTING.md.";
CM_ SG_ 2147503616 FD_Transport_Protocol_Data_Trans "Generic 8-byte raw payload. Detail page: https://www.isobus.net/isobus/pGNAndSPN/1340?type=PGN. Signal-level enrichment via PR welcome  see CONTRIBUTING.md.";
CM_ SG_ 2147503872 Data_Transfer_Support_RawPayload "Generic 8-byte raw payload. Detail page: https://www.isobus.net/isobus/pGNAndSPN/1350?type=PGN. Signal-level enrichment via PR welcome  see CONTRIBUTING.md.";
CM_ SG_ 2147504128 Monthly_Data_Transfer_RawPayload "Generic 8-byte raw payload. Detail page: https://www.isobus.net/isobus/pGNAndSPN/1355?type=PGN. Signal-level enrichment via PR welcome  see CONTRIBUTING.md.";
CM_ SG_ 2147504384 Weekly_Data_Transfer_RawPayload "Generic 8-byte raw payload. Detail page: https://www.isobus.net/isobus/pGNAndSPN/1360?type=PGN. Signal-level enrichment via PR welcome  see CONTRIBUTING.md.";
CM_ SG_ 2147504640 Daily_Data_Transfer_RawPayload "Generic 8-byte raw payload. Detail page: https://www.isobus.net/isobus/pGNAndSPN/1365?type=PGN. Signal-level enrichment via PR welcome  see CONTRIBUTING.md.";
CM_ SG_ 2147504896 EVSE_Control_1_RawPayload "Generic 8-byte raw payload. Detail page: https://www.isobus.net/isobus/pGNAndSPN/1369?type=PGN. Signal-level enrichment via PR welcome  see CONTRIBUTING.md.";
CM_ SG_ 2147505152 Winch_Information_3_RawPayload "Generic 8-byte raw payload. Detail page: https://www.isobus.net/isobus/pGNAndSPN/1370?type=PGN. Signal-level enrichment via PR welcome  see CONTRIBUTING.md.";
CM_ SG_ 2147505408 Air_Suspension_Control_8_RawPayl "Generic 8-byte raw payload. Detail page: https://www.isobus.net/isobus/pGNAndSPN/1371?type=PGN. Signal-level enrichment via PR welcome  see CONTRIBUTING.md.";
CM_ SG_ 2147505664 Motor_Generator_2_Inverter_Contr "Generic 8-byte raw payload. Detail page: https://www.isobus.net/isobus/pGNAndSPN/1378?type=PGN. Signal-level enrichment via PR welcome  see CONTRIBUTING.md.";
CM_ SG_ 2147505920 Motor_Generator_1_Inverter_Contr "Generic 8-byte raw payload. Detail page: https://www.isobus.net/isobus/pGNAndSPN/1385?type=PGN. Signal-level enrichment via PR welcome  see CONTRIBUTING.md.";
CM_ SG_ 2147506176 Hoist_Command_Information_RawPay "Generic 8-byte raw payload. Detail page: https://www.isobus.net/isobus/pGNAndSPN/1387?type=PGN. Signal-level enrichment via PR welcome  see CONTRIBUTING.md.";
CM_ SG_ 2147506432 Motor_Generator_2_Inverter_Isola "Generic 8-byte raw payload. Detail page: https://www.isobus.net/isobus/pGNAndSPN/1391?type=PGN. Signal-level enrichment via PR welcome  see CONTRIBUTING.md.";
CM_ SG_ 2147506688 Motor_Generator_1_Inverter_Isola "Generic 8-byte raw payload. Detail page: https://www.isobus.net/isobus/pGNAndSPN/1395?type=PGN. Signal-level enrichment via PR welcome  see CONTRIBUTING.md.";
CM_ SG_ 2147506944 Motor_Generator_2_Inverter_Limit "Generic 8-byte raw payload. Detail page: https://www.isobus.net/isobus/pGNAndSPN/1401?type=PGN. Signal-level enrichment via PR welcome  see CONTRIBUTING.md.";
CM_ SG_ 2147507200 Motor_Generator_2_Inverter_Limit "Generic 8-byte raw payload. Detail page: https://www.isobus.net/isobus/pGNAndSPN/1407?type=PGN. Signal-level enrichment via PR welcome  see CONTRIBUTING.md.";
CM_ SG_ 2147507456 Motor_Generator_2_Inverter_Limit "Generic 8-byte raw payload. Detail page: https://www.isobus.net/isobus/pGNAndSPN/1413?type=PGN. Signal-level enrichment via PR welcome  see CONTRIBUTING.md.";
CM_ SG_ 2147507712 Motor_Generator_1_Inverter_Limit "Generic 8-byte raw payload. Detail page: https://www.isobus.net/isobus/pGNAndSPN/1419?type=PGN. Signal-level enrichment via PR welcome  see CONTRIBUTING.md.";
CM_ SG_ 2147507968 Motor_Generator_1_Inverter_Limit "Generic 8-byte raw payload. Detail page: https://www.isobus.net/isobus/pGNAndSPN/1425?type=PGN. Signal-level enrichment via PR welcome  see CONTRIBUTING.md.";
CM_ SG_ 2147508224 Motor_Generator_1_Inverter_Limit "Generic 8-byte raw payload. Detail page: https://www.isobus.net/isobus/pGNAndSPN/1431?type=PGN. Signal-level enrichment via PR welcome  see CONTRIBUTING.md.";
CM_ SG_ 2147508480 Personnel_Detect_Interlock_RawPa "Generic 8-byte raw payload. Detail page: https://www.isobus.net/isobus/pGNAndSPN/1433?type=PGN. Signal-level enrichment via PR welcome  see CONTRIBUTING.md.";
CM_ SG_ 2147508736 Engine_Cylinder_Combustion_Confi "Generic 8-byte raw payload. Detail page: https://www.isobus.net/isobus/pGNAndSPN/1435?type=PGN. Signal-level enrichment via PR welcome  see CONTRIBUTING.md.";
CM_ SG_ 2147508992 Engine_Cylinder_Combustion_Confi "Generic 8-byte raw payload. Detail page: https://www.isobus.net/isobus/pGNAndSPN/1437?type=PGN. Signal-level enrichment via PR welcome  see CONTRIBUTING.md.";
CM_ SG_ 2147509248 Engine_Cylinder_Pressure_Timing_ "Generic 8-byte raw payload. Detail page: https://www.isobus.net/isobus/pGNAndSPN/1441?type=PGN. Signal-level enrichment via PR welcome  see CONTRIBUTING.md.";
CM_ SG_ 2147509504 Engine_Cylinder_Pressure_Timing_ "Generic 8-byte raw payload. Detail page: https://www.isobus.net/isobus/pGNAndSPN/1445?type=PGN. Signal-level enrichment via PR welcome  see CONTRIBUTING.md.";
CM_ SG_ 2147509760 Electrified_Accessory_Generator_ "Generic 8-byte raw payload. Detail page: https://www.isobus.net/isobus/pGNAndSPN/1452?type=PGN. Signal-level enrichment via PR welcome  see CONTRIBUTING.md.";
CM_ SG_ 2147510016 Electrified_Accessory_Generator_ "Generic 8-byte raw payload. Detail page: https://www.isobus.net/isobus/pGNAndSPN/1459?type=PGN. Signal-level enrichment via PR welcome  see CONTRIBUTING.md.";
CM_ SG_ 2147510272 On_Board_Programming_1_RawPayloa "Generic 8-byte raw payload. Detail page: https://www.isobus.net/isobus/pGNAndSPN/1471?type=PGN. Signal-level enrichment via PR welcome  see CONTRIBUTING.md.";
CM_ SG_ 2147510528 Marine_Control_Information_Confi "Generic 8-byte raw payload. Detail page: https://www.isobus.net/isobus/pGNAndSPN/1475?type=PGN. Signal-level enrichment via PR welcome  see CONTRIBUTING.md.";
CM_ SG_ 2147510784 Marine_Control_Information_2_Raw "Generic 8-byte raw payload. Detail page: https://www.isobus.net/isobus/pGNAndSPN/1482?type=PGN. Signal-level enrichment via PR welcome  see CONTRIBUTING.md.";
CM_ SG_ 2147511040 Well_Stimulation_Pump_Sensor_Cal "Generic 8-byte raw payload. Detail page: https://www.isobus.net/isobus/pGNAndSPN/1484?type=PGN. Signal-level enrichment via PR welcome  see CONTRIBUTING.md.";
CM_ SG_ 2147511296 CiA_602_2_XCP_Obsolete_RawPayloa "Generic 8-byte raw payload. Detail page: https://www.isobus.net/isobus/pGNAndSPN/1485?type=PGN. Signal-level enrichment via PR welcome  see CONTRIBUTING.md.";
CM_ SG_ 2147511552 Well_Stimulation_Pump_System_Con "Generic 8-byte raw payload. Detail page: https://www.isobus.net/isobus/pGNAndSPN/1496?type=PGN. Signal-level enrichment via PR welcome  see CONTRIBUTING.md.";
CM_ SG_ 2147511808 Configurable_Receive_SPNs_Comman "Generic 8-byte raw payload. Detail page: https://www.isobus.net/isobus/pGNAndSPN/1501?type=PGN. Signal-level enrichment via PR welcome  see CONTRIBUTING.md.";
CM_ SG_ 2147512064 Authentication_Client_to_Authent "Generic 8-byte raw payload. Detail page: https://www.isobus.net/isobus/pGNAndSPN/1527?type=PGN. Signal-level enrichment via PR welcome  see CONTRIBUTING.md.";
CM_ SG_ 2147512320 Authentication_Server_to_Authent "Generic 8-byte raw payload. Detail page: https://www.isobus.net/isobus/pGNAndSPN/1552?type=PGN. Signal-level enrichment via PR welcome  see CONTRIBUTING.md.";
CM_ SG_ 2147512576 Configurable_Transmit_PGNs_Comma "Generic 8-byte raw payload. Detail page: https://www.isobus.net/isobus/pGNAndSPN/1556?type=PGN. Signal-level enrichment via PR welcome  see CONTRIBUTING.md.";
CM_ SG_ 2147512832 Oil_Debris_Monitor_Configuration "Generic 8-byte raw payload. Detail page: https://www.isobus.net/isobus/pGNAndSPN/1569?type=PGN. Signal-level enrichment via PR welcome  see CONTRIBUTING.md.";
CM_ SG_ 2147513088 Electrified_Accessory_Propulsion "Generic 8-byte raw payload. Detail page: https://www.isobus.net/isobus/pGNAndSPN/1576?type=PGN. Signal-level enrichment via PR welcome  see CONTRIBUTING.md.";
CM_ SG_ 2147513344 Electrified_Accessory_Propulsion "Generic 8-byte raw payload. Detail page: https://www.isobus.net/isobus/pGNAndSPN/1583?type=PGN. Signal-level enrichment via PR welcome  see CONTRIBUTING.md.";
CM_ SG_ 2147513600 Electrified_Accessory_Propulsion "Generic 8-byte raw payload. Detail page: https://www.isobus.net/isobus/pGNAndSPN/1590?type=PGN. Signal-level enrichment via PR welcome  see CONTRIBUTING.md.";
CM_ SG_ 2147513856 Electrified_Accessory_Power_Elec "Generic 8-byte raw payload. Detail page: https://www.isobus.net/isobus/pGNAndSPN/1597?type=PGN. Signal-level enrichment via PR welcome  see CONTRIBUTING.md.";
CM_ SG_ 2147514112 Electrified_Accessory_Power_Elec "Generic 8-byte raw payload. Detail page: https://www.isobus.net/isobus/pGNAndSPN/1604?type=PGN. Signal-level enrichment via PR welcome  see CONTRIBUTING.md.";
CM_ SG_ 2147514368 Electrified_Accessory_Power_Elec "Generic 8-byte raw payload. Detail page: https://www.isobus.net/isobus/pGNAndSPN/1611?type=PGN. Signal-level enrichment via PR welcome  see CONTRIBUTING.md.";
CM_ SG_ 2147514624 Electrified_Accessory_Propulsion "Generic 8-byte raw payload. Detail page: https://www.isobus.net/isobus/pGNAndSPN/1618?type=PGN. Signal-level enrichment via PR welcome  see CONTRIBUTING.md.";
CM_ SG_ 2147514880 Electrified_Accessory_Propulsion "Generic 8-byte raw payload. Detail page: https://www.isobus.net/isobus/pGNAndSPN/1625?type=PGN. Signal-level enrichment via PR welcome  see CONTRIBUTING.md.";
CM_ SG_ 2147515136 Electrified_Accessory_Power_Elec "Generic 8-byte raw payload. Detail page: https://www.isobus.net/isobus/pGNAndSPN/1632?type=PGN. Signal-level enrichment via PR welcome  see CONTRIBUTING.md.";
CM_ SG_ 2147515392 Extended_Control_Function_Functi "Generic 8-byte raw payload. Detail page: https://www.isobus.net/isobus/pGNAndSPN/1633?type=PGN. Signal-level enrichment via PR welcome  see CONTRIBUTING.md.";
CM_ SG_ 2147515648 Electrified_Accessory_Motor_Comm "Generic 8-byte raw payload. Detail page: https://www.isobus.net/isobus/pGNAndSPN/1655?type=PGN. Signal-level enrichment via PR welcome  see CONTRIBUTING.md.";
CM_ SG_ 2147515904 Engine_Speed_Ramp_Rate_Boundary_ "Generic 8-byte raw payload. Detail page: https://www.isobus.net/isobus/pGNAndSPN/1657?type=PGN. Signal-level enrichment via PR welcome  see CONTRIBUTING.md.";
CM_ SG_ 2147516160 Tire_Sensor_Identification_Comma "Generic 8-byte raw payload. Detail page: https://www.isobus.net/isobus/pGNAndSPN/1661?type=PGN. Signal-level enrichment via PR welcome  see CONTRIBUTING.md.";
CM_ SG_ 2147516416 Hybrid_or_EV_System_Control_1_Ra "Generic 8-byte raw payload. Detail page: https://www.isobus.net/isobus/pGNAndSPN/1674?type=PGN. Signal-level enrichment via PR welcome  see CONTRIBUTING.md.";
CM_ SG_ 2147516672 Aftertreatment_System_Control_Ra "Generic 8-byte raw payload. Detail page: https://www.isobus.net/isobus/pGNAndSPN/1680?type=PGN. Signal-level enrichment via PR welcome  see CONTRIBUTING.md.";
CM_ SG_ 2147516928 Tire_Configuration_Command_Infor "Generic 8-byte raw payload. Detail page: https://www.isobus.net/isobus/pGNAndSPN/1687?type=PGN. Signal-level enrichment via PR welcome  see CONTRIBUTING.md.";
CM_ SG_ 2147517184 Payload_Calibration_Information_ "Generic 8-byte raw payload. Detail page: https://www.isobus.net/isobus/pGNAndSPN/1690?type=PGN. Signal-level enrichment via PR welcome  see CONTRIBUTING.md.";
CM_ SG_ 2147517440 Aftertreatment_1_Particulate_Sen "Generic 8-byte raw payload. Detail page: https://www.isobus.net/isobus/pGNAndSPN/1695?type=PGN. Signal-level enrichment via PR welcome  see CONTRIBUTING.md.";
CM_ SG_ 2147517696 Cab_Message_2_RawPayload "Generic 8-byte raw payload. Detail page: https://www.isobus.net/isobus/pGNAndSPN/1713?type=PGN. Signal-level enrichment via PR welcome  see CONTRIBUTING.md.";
CM_ SG_ 2147517952 Switched_Power_Outputs_Command_R "Generic 8-byte raw payload. Detail page: https://www.isobus.net/isobus/pGNAndSPN/1745?type=PGN. Signal-level enrichment via PR welcome  see CONTRIBUTING.md.";
CM_ SG_ 2147518208 Engine_State_Requests_RawPayload "Generic 8-byte raw payload. Detail page: https://www.isobus.net/isobus/pGNAndSPN/1754?type=PGN. Signal-level enrichment via PR welcome  see CONTRIBUTING.md.";
CM_ SG_ 2147518464 Radio_Beacon_Request_RawPayload "Generic 8-byte raw payload. Detail page: https://www.isobus.net/isobus/pGNAndSPN/1758?type=PGN. Signal-level enrichment via PR welcome  see CONTRIBUTING.md.";
CM_ SG_ 2147518720 Running_Gear_Equipment_2_4_RawPa "Generic 8-byte raw payload. Detail page: https://www.isobus.net/isobus/pGNAndSPN/1759?type=PGN. Signal-level enrichment via PR welcome  see CONTRIBUTING.md.";
CM_ SG_ 2147518976 Running_Gear_Equipment_1_2_RawPa "Generic 8-byte raw payload. Detail page: https://www.isobus.net/isobus/pGNAndSPN/1760?type=PGN. Signal-level enrichment via PR welcome  see CONTRIBUTING.md.";
CM_ SG_ 2147519232 CCP_Data_Transmission_Object_Raw "Generic 8-byte raw payload. Detail page: https://www.isobus.net/isobus/pGNAndSPN/1761?type=PGN. Signal-level enrichment via PR welcome  see CONTRIBUTING.md.";
CM_ SG_ 2147519488 CCP_Command_Receive_Object_RawPa "Generic 8-byte raw payload. Detail page: https://www.isobus.net/isobus/pGNAndSPN/1762?type=PGN. Signal-level enrichment via PR welcome  see CONTRIBUTING.md.";
CM_ SG_ 2147519744 Sequence_Control_Client_to_Seque "Generic 8-byte raw payload. Detail page: https://www.isobus.net/isobus/pGNAndSPN/1763?type=PGN. Signal-level enrichment via PR welcome  see CONTRIBUTING.md.";
CM_ SG_ 2147520000 Sequence_Control_Master_to_Seque "Generic 8-byte raw payload. Detail page: https://www.isobus.net/isobus/pGNAndSPN/1764?type=PGN. Signal-level enrichment via PR welcome  see CONTRIBUTING.md.";
CM_ SG_ 2147520256 Engine_Configuration_Commands_Ra "Generic 8-byte raw payload. Detail page: https://www.isobus.net/isobus/pGNAndSPN/1765?type=PGN. Signal-level enrichment via PR welcome  see CONTRIBUTING.md.";
CM_ SG_ 2147520512 Supplemental_Fan_Command_RawPayl "Generic 8-byte raw payload. Detail page: https://www.isobus.net/isobus/pGNAndSPN/1769?type=PGN. Signal-level enrichment via PR welcome  see CONTRIBUTING.md.";
CM_ SG_ 2147520768 Vehicle_Chassis_Lubrication_Syst "Generic 8-byte raw payload. Detail page: https://www.isobus.net/isobus/pGNAndSPN/1774?type=PGN. Signal-level enrichment via PR welcome  see CONTRIBUTING.md.";
CM_ SG_ 2147521024 Aftertreatment_1_Hydrocarbon_Dos "Generic 8-byte raw payload. Detail page: https://www.isobus.net/isobus/pGNAndSPN/1780?type=PGN. Signal-level enrichment via PR welcome  see CONTRIBUTING.md.";
CM_ SG_ 2147521280 NAME_Management_Message_RawPaylo "Generic 8-byte raw payload. Detail page: https://www.isobus.net/isobus/pGNAndSPN/1798?type=PGN. Signal-level enrichment via PR welcome  see CONTRIBUTING.md.";
CM_ SG_ 2147521536 Aftertreatment_1_Diesel_Particul "Generic 8-byte raw payload. Detail page: https://www.isobus.net/isobus/pGNAndSPN/1800?type=PGN. Signal-level enrichment via PR welcome  see CONTRIBUTING.md.";
CM_ SG_ 2147521792 Aftertreatment_2_Diesel_Particul "Generic 8-byte raw payload. Detail page: https://www.isobus.net/isobus/pGNAndSPN/1802?type=PGN. Signal-level enrichment via PR welcome  see CONTRIBUTING.md.";
CM_ SG_ 2147522048 Low_Voltage_Disconnect_Set_Opera "Generic 8-byte raw payload. Detail page: https://www.isobus.net/isobus/pGNAndSPN/1803?type=PGN. Signal-level enrichment via PR welcome  see CONTRIBUTING.md.";
CM_ SG_ 2147522304 Noise_Control_Status_RawPayload "Generic 8-byte raw payload. Detail page: https://www.isobus.net/isobus/pGNAndSPN/1805?type=PGN. Signal-level enrichment via PR welcome  see CONTRIBUTING.md.";
CM_ SG_ 2147522560 Noise_Control_1_RawPayload "Generic 8-byte raw payload. Detail page: https://www.isobus.net/isobus/pGNAndSPN/1807?type=PGN. Signal-level enrichment via PR welcome  see CONTRIBUTING.md.";
CM_ SG_ 2147522816 Joystick_Lamp_Command_Message_Ra "Generic 8-byte raw payload. Detail page: https://www.isobus.net/isobus/pGNAndSPN/1837?type=PGN. Signal-level enrichment via PR welcome  see CONTRIBUTING.md.";
CM_ SG_ 2147523072 General_Purpose_Message_1_8_RawP "Generic 8-byte raw payload. Detail page: https://www.isobus.net/isobus/pGNAndSPN/1838?type=PGN. Signal-level enrichment via PR welcome  see CONTRIBUTING.md.";
CM_ SG_ 2147523584 Auxiliary_Input_Output_Status_7_ "Generic 8-byte raw payload. Detail page: https://www.isobus.net/isobus/pGNAndSPN/1848?type=PGN. Signal-level enrichment via PR welcome  see CONTRIBUTING.md.";
CM_ SG_ 2147523840 Auxiliary_Input_Output_Status_6_ "Generic 8-byte raw payload. Detail page: https://www.isobus.net/isobus/pGNAndSPN/1856?type=PGN. Signal-level enrichment via PR welcome  see CONTRIBUTING.md.";
CM_ SG_ 2147524096 DTC_Counts_RawPayload "Generic 8-byte raw payload. Detail page: https://www.isobus.net/isobus/pGNAndSPN/1861?type=PGN. Signal-level enrichment via PR welcome  see CONTRIBUTING.md.";
CM_ SG_ 2147524352 Immediate_Fault_Status_RawPayloa "Generic 8-byte raw payload. Detail page: https://www.isobus.net/isobus/pGNAndSPN/1873?type=PGN. Signal-level enrichment via PR welcome  see CONTRIBUTING.md.";
CM_ SG_ 2147524608 NTE_Status_RawPayload "Generic 8-byte raw payload. Detail page: https://www.isobus.net/isobus/pGNAndSPN/1879?type=PGN. Signal-level enrichment via PR welcome  see CONTRIBUTING.md.";
CM_ SG_ 2147524864 Emission_Increasing_Auxiliary_Em "Generic 8-byte raw payload. Detail page: https://www.isobus.net/isobus/pGNAndSPN/1882?type=PGN. Signal-level enrichment via PR welcome  see CONTRIBUTING.md.";
CM_ SG_ 2147525120 Regulated_Exhaust_Emission_Level "Generic 8-byte raw payload. Detail page: https://www.isobus.net/isobus/pGNAndSPN/1887?type=PGN. Signal-level enrichment via PR welcome  see CONTRIBUTING.md.";
CM_ SG_ 2147525376 DTC_To_Lamp_Association_RawPaylo "Generic 8-byte raw payload. Detail page: https://www.isobus.net/isobus/pGNAndSPN/1899?type=PGN. Signal-level enrichment via PR welcome  see CONTRIBUTING.md.";
CM_ SG_ 2147525632 Scaled_Test_Results_RawPayload "Generic 8-byte raw payload. Detail page: https://www.isobus.net/isobus/pGNAndSPN/1906?type=PGN. Signal-level enrichment via PR welcome  see CONTRIBUTING.md.";
CM_ SG_ 2147525888 Auxiliary_Input_Output_Status_4_ "Generic 8-byte raw payload. Detail page: https://www.isobus.net/isobus/pGNAndSPN/1938?type=PGN. Signal-level enrichment via PR welcome  see CONTRIBUTING.md.";
CM_ SG_ 2147526144 Auxiliary_Input_Output_Status_3_ "Generic 8-byte raw payload. Detail page: https://www.isobus.net/isobus/pGNAndSPN/1970?type=PGN. Signal-level enrichment via PR welcome  see CONTRIBUTING.md.";
CM_ SG_ 2147526400 Auxiliary_Input_Output_Status_2_ "Generic 8-byte raw payload. Detail page: https://www.isobus.net/isobus/pGNAndSPN/2002?type=PGN. Signal-level enrichment via PR welcome  see CONTRIBUTING.md.";
CM_ SG_ 2147526656 Text_Display_RawPayload "Generic 8-byte raw payload. Detail page: https://www.isobus.net/isobus/pGNAndSPN/2005?type=PGN. Signal-level enrichment via PR welcome  see CONTRIBUTING.md.";
CM_ SG_ 2147526912 Forward_Lane_Image_Command_RawPa "Generic 8-byte raw payload. Detail page: https://www.isobus.net/isobus/pGNAndSPN/2011?type=PGN. Signal-level enrichment via PR welcome  see CONTRIBUTING.md.";
CM_ SG_ 2147527168 Client_ECU_to_File_Server_messag "Generic 8-byte raw payload. Detail page: https://www.isobus.net/isobus/pGNAndSPN/2012?type=PGN. Signal-level enrichment via PR welcome  see CONTRIBUTING.md.";
CM_ SG_ 2147527424 File_Server_to_Client_ECU_messag "Generic 8-byte raw payload. Detail page: https://www.isobus.net/isobus/pGNAndSPN/2013?type=PGN. Signal-level enrichment via PR welcome  see CONTRIBUTING.md.";
CM_ SG_ 2147528192 Tire_Pressure_Reference_Setting_ "Generic 8-byte raw payload. Detail page: https://www.isobus.net/isobus/pGNAndSPN/2025?type=PGN. Signal-level enrichment via PR welcome  see CONTRIBUTING.md.";
CM_ SG_ 2147528448 Parameter_Locate_Message_RawPayl "Generic 8-byte raw payload. Detail page: https://www.isobus.net/isobus/pGNAndSPN/2026?type=PGN. Signal-level enrichment via PR welcome  see CONTRIBUTING.md.";
CM_ SG_ 2147528704 Configuration_Identification_Mes "Generic 8-byte raw payload. Detail page: https://www.isobus.net/isobus/pGNAndSPN/2027?type=PGN. Signal-level enrichment via PR welcome  see CONTRIBUTING.md.";
CM_ SG_ 2147528960 Proprietarily_Configurable_Messa "Generic 8-byte raw payload. Detail page: https://www.isobus.net/isobus/pGNAndSPN/2028?type=PGN. Signal-level enrichment via PR welcome  see CONTRIBUTING.md.";
CM_ SG_ 2147529216 Proprietarily_Configurable_Messa "Generic 8-byte raw payload. Detail page: https://www.isobus.net/isobus/pGNAndSPN/2029?type=PGN. Signal-level enrichment via PR welcome  see CONTRIBUTING.md.";
CM_ SG_ 2147529472 Proprietarily_Configurable_Messa "Generic 8-byte raw payload. Detail page: https://www.isobus.net/isobus/pGNAndSPN/2030?type=PGN. Signal-level enrichment via PR welcome  see CONTRIBUTING.md.";
CM_ SG_ 2147529728 Proprietarily_Configurable_Messa "Generic 8-byte raw payload. Detail page: https://www.isobus.net/isobus/pGNAndSPN/2031?type=PGN. Signal-level enrichment via PR welcome  see CONTRIBUTING.md.";
CM_ SG_ 2147529984 Proprietarily_Configurable_Messa "Generic 8-byte raw payload. Detail page: https://www.isobus.net/isobus/pGNAndSPN/2032?type=PGN. Signal-level enrichment via PR welcome  see CONTRIBUTING.md.";
CM_ SG_ 2147530240 Proprietarily_Configurable_Messa "Generic 8-byte raw payload. Detail page: https://www.isobus.net/isobus/pGNAndSPN/2033?type=PGN. Signal-level enrichment via PR welcome  see CONTRIBUTING.md.";
CM_ SG_ 2147530496 Proprietarily_Configurable_Messa "Generic 8-byte raw payload. Detail page: https://www.isobus.net/isobus/pGNAndSPN/2034?type=PGN. Signal-level enrichment via PR welcome  see CONTRIBUTING.md.";
CM_ SG_ 2147530752 Proprietarily_Configurable_Messa "Generic 8-byte raw payload. Detail page: https://www.isobus.net/isobus/pGNAndSPN/2035?type=PGN. Signal-level enrichment via PR welcome  see CONTRIBUTING.md.";
CM_ SG_ 2147531008 Proprietarily_Configurable_Messa "Generic 8-byte raw payload. Detail page: https://www.isobus.net/isobus/pGNAndSPN/2036?type=PGN. Signal-level enrichment via PR welcome  see CONTRIBUTING.md.";
CM_ SG_ 2147531264 Proprietarily_Configurable_Messa "Generic 8-byte raw payload. Detail page: https://www.isobus.net/isobus/pGNAndSPN/2037?type=PGN. Signal-level enrichment via PR welcome  see CONTRIBUTING.md.";
CM_ SG_ 2147531520 Proprietarily_Configurable_Messa "Generic 8-byte raw payload. Detail page: https://www.isobus.net/isobus/pGNAndSPN/2038?type=PGN. Signal-level enrichment via PR welcome  see CONTRIBUTING.md.";
CM_ SG_ 2147531776 Proprietarily_Configurable_Messa "Generic 8-byte raw payload. Detail page: https://www.isobus.net/isobus/pGNAndSPN/2039?type=PGN. Signal-level enrichment via PR welcome  see CONTRIBUTING.md.";
CM_ SG_ 2147532032 Proprietarily_Configurable_Messa "Generic 8-byte raw payload. Detail page: https://www.isobus.net/isobus/pGNAndSPN/2040?type=PGN. Signal-level enrichment via PR welcome  see CONTRIBUTING.md.";
CM_ SG_ 2147532288 Proprietarily_Configurable_Messa "Generic 8-byte raw payload. Detail page: https://www.isobus.net/isobus/pGNAndSPN/2041?type=PGN. Signal-level enrichment via PR welcome  see CONTRIBUTING.md.";
CM_ SG_ 2147532544 Proprietarily_Configurable_Messa "Generic 8-byte raw payload. Detail page: https://www.isobus.net/isobus/pGNAndSPN/2042?type=PGN. Signal-level enrichment via PR welcome  see CONTRIBUTING.md.";
CM_ SG_ 2147532800 Proprietarily_Configurable_Messa "Generic 8-byte raw payload. Detail page: https://www.isobus.net/isobus/pGNAndSPN/2043?type=PGN. Signal-level enrichment via PR welcome  see CONTRIBUTING.md.";
CM_ SG_ 2147533056 Diagnostic_Readiness_2_RawPayloa "Generic 8-byte raw payload. Detail page: https://www.isobus.net/isobus/pGNAndSPN/2047?type=PGN. Signal-level enrichment via PR welcome  see CONTRIBUTING.md.";
CM_ SG_ 2147533312 Monitor_Performance_Ratio_RawPay "Generic 8-byte raw payload. Detail page: https://www.isobus.net/isobus/pGNAndSPN/2052?type=PGN. Signal-level enrichment via PR welcome  see CONTRIBUTING.md.";
CM_ SG_ 2147533824 General_Purpose_Valve_command_Ra "Generic 8-byte raw payload. Detail page: https://www.isobus.net/isobus/pGNAndSPN/2060?type=PGN. Signal-level enrichment via PR welcome  see CONTRIBUTING.md.";
CM_ SG_ 2147534080 General_Purpose_Valve_measured_f "Generic 8-byte raw payload. Detail page: https://www.isobus.net/isobus/pGNAndSPN/2066?type=PGN. Signal-level enrichment via PR welcome  see CONTRIBUTING.md.";
CM_ SG_ 2147534336 General_Purpose_Valve_estimated_ "Generic 8-byte raw payload. Detail page: https://www.isobus.net/isobus/pGNAndSPN/2074?type=PGN. Signal-level enrichment via PR welcome  see CONTRIBUTING.md.";
CM_ SG_ 2147535104 Request_2_RawPayload "Generic 8-byte raw payload. Detail page: https://www.isobus.net/isobus/pGNAndSPN/2082?type=PGN. Signal-level enrichment via PR welcome  see CONTRIBUTING.md.";
CM_ SG_ 2147535360 Transfer_RawPayload "Generic 8-byte raw payload. Detail page: https://www.isobus.net/isobus/pGNAndSPN/2086?type=PGN. Signal-level enrichment via PR welcome  see CONTRIBUTING.md.";
CM_ SG_ 2147536640 Continuous_Torque_Speed_Limit_Re "Generic 8-byte raw payload. Detail page: https://www.isobus.net/isobus/pGNAndSPN/2102?type=PGN. Signal-level enrichment via PR welcome  see CONTRIBUTING.md.";
CM_ SG_ 2147536896 Background_lighting_level_comman "Generic 8-byte raw payload. Detail page: https://www.isobus.net/isobus/pGNAndSPN/2103?type=PGN. Signal-level enrichment via PR welcome  see CONTRIBUTING.md.";
CM_ SG_ 2147537152 Air_Suspension_Control_6_RawPayl "Generic 8-byte raw payload. Detail page: https://www.isobus.net/isobus/pGNAndSPN/2107?type=PGN. Signal-level enrichment via PR welcome  see CONTRIBUTING.md.";
CM_ SG_ 2147537408 Air_Suspension_Control_2_RawPayl "Generic 8-byte raw payload. Detail page: https://www.isobus.net/isobus/pGNAndSPN/2126?type=PGN. Signal-level enrichment via PR welcome  see CONTRIBUTING.md.";
CM_ SG_ 2147537664 Calibration_Information_RawPaylo "Generic 8-byte raw payload. Detail page: https://www.isobus.net/isobus/pGNAndSPN/2128?type=PGN. Signal-level enrichment via PR welcome  see CONTRIBUTING.md.";
CM_ SG_ 2147537920 Data_Security_RawPayload "Generic 8-byte raw payload. Detail page: https://www.isobus.net/isobus/pGNAndSPN/2131?type=PGN. Signal-level enrichment via PR welcome  see CONTRIBUTING.md.";
CM_ SG_ 2147538176 Time_Date_Adjust_RawPayload "Generic 8-byte raw payload. Detail page: https://www.isobus.net/isobus/pGNAndSPN/2139?type=PGN. Signal-level enrichment via PR welcome  see CONTRIBUTING.md.";
CM_ SG_ 2147538432 Boot_Load_Data_RawPayload "Generic 8-byte raw payload. Detail page: https://www.isobus.net/isobus/pGNAndSPN/2140?type=PGN. Signal-level enrichment via PR welcome  see CONTRIBUTING.md.";
CM_ SG_ 2147539968 Anti_theft_Status_RawPayload "Generic 8-byte raw payload. Detail page: https://www.isobus.net/isobus/pGNAndSPN/2160?type=PGN. Signal-level enrichment via PR welcome  see CONTRIBUTING.md.";
CM_ SG_ 2147540224 Anti_theft_Request_RawPayload "Generic 8-byte raw payload. Detail page: https://www.isobus.net/isobus/pGNAndSPN/2164?type=PGN. Signal-level enrichment via PR welcome  see CONTRIBUTING.md.";
CM_ SG_ 2147540480 Reset_RawPayload "Generic 8-byte raw payload. Detail page: https://www.isobus.net/isobus/pGNAndSPN/2175?type=PGN. Signal-level enrichment via PR welcome  see CONTRIBUTING.md.";
CM_ SG_ 2147540992 Cab_Message_1_RawPayload "Generic 8-byte raw payload. Detail page: https://www.isobus.net/isobus/pGNAndSPN/2208?type=PGN. Signal-level enrichment via PR welcome  see CONTRIBUTING.md.";
CM_ SG_ 2147541248 General_Purpose_Message_2_1_RawP "Generic 8-byte raw payload. Detail page: https://www.isobus.net/isobus/pGNAndSPN/2209?type=PGN. Signal-level enrichment via PR welcome  see CONTRIBUTING.md.";
CM_ SG_ 2147541504 General_Purpose_Message_1_1_RawP "Generic 8-byte raw payload. Detail page: https://www.isobus.net/isobus/pGNAndSPN/2210?type=PGN. Signal-level enrichment via PR welcome  see CONTRIBUTING.md.";
CM_ SG_ 2147541760 Command_Non_continuously_Monitor "Generic 8-byte raw payload. Detail page: https://www.isobus.net/isobus/pGNAndSPN/2213?type=PGN. Signal-level enrichment via PR welcome  see CONTRIBUTING.md.";
CM_ SG_ 2147542016 Running_Gear_Equipment_1_1_RawPa "Generic 8-byte raw payload. Detail page: https://www.isobus.net/isobus/pGNAndSPN/2214?type=PGN. Signal-level enrichment via PR welcome  see CONTRIBUTING.md.";
CM_ SG_ 2147542272 Running_Gear_Equipment_2_1_RawPa "Generic 8-byte raw payload. Detail page: https://www.isobus.net/isobus/pGNAndSPN/2215?type=PGN. Signal-level enrichment via PR welcome  see CONTRIBUTING.md.";
CM_ SG_ 2147544320 Network_Message_RawPayload "Generic 8-byte raw payload. Detail page: https://www.isobus.net/isobus/pGNAndSPN/2269?type=PGN. Signal-level enrichment via PR welcome  see CONTRIBUTING.md.";
CM_ SG_ 2147545088 Electronic_Retarder_Controller_1 "Generic 8-byte raw payload. Detail page: https://www.isobus.net/isobus/pGNAndSPN/2284?type=PGN. Signal-level enrichment via PR welcome  see CONTRIBUTING.md.";
CM_ SG_ 2147545089 Electronic_Brake_Controller_1_Ra "Generic 8-byte raw payload. Detail page: https://www.isobus.net/isobus/pGNAndSPN/2307?type=PGN. Signal-level enrichment via PR welcome  see CONTRIBUTING.md.";
CM_ SG_ 2147545090 Electronic_Transmission_Controll "Generic 8-byte raw payload. Detail page: https://www.isobus.net/isobus/pGNAndSPN/2318?type=PGN. Signal-level enrichment via PR welcome  see CONTRIBUTING.md.";
CM_ SG_ 2147545093 Electronic_Transmission_Controll "Generic 8-byte raw payload. Detail page: https://www.isobus.net/isobus/pGNAndSPN/2345?type=PGN. Signal-level enrichment via PR welcome  see CONTRIBUTING.md.";
CM_ SG_ 2147545094 Electronic_Axle_Controller_1_Raw "Generic 8-byte raw payload. Detail page: https://www.isobus.net/isobus/pGNAndSPN/2357?type=PGN. Signal-level enrichment via PR welcome  see CONTRIBUTING.md.";
CM_ SG_ 2147545095 Forward_Lane_Image_1_RawPayload "Generic 8-byte raw payload. Detail page: https://www.isobus.net/isobus/pGNAndSPN/2368?type=PGN. Signal-level enrichment via PR welcome  see CONTRIBUTING.md.";
CM_ SG_ 2147545096 Hydraulic_Pressure_Governor_Info "Generic 8-byte raw payload. Detail page: https://www.isobus.net/isobus/pGNAndSPN/2379?type=PGN. Signal-level enrichment via PR welcome  see CONTRIBUTING.md.";
CM_ SG_ 2147545097 Vehicle_Dynamic_Stability_Contro "Generic 8-byte raw payload. Detail page: https://www.isobus.net/isobus/pGNAndSPN/2385?type=PGN. Signal-level enrichment via PR welcome  see CONTRIBUTING.md.";
CM_ SG_ 2147545098 Engine_Gas_Flow_Rate_1_RawPayloa "Generic 8-byte raw payload. Detail page: https://www.isobus.net/isobus/pGNAndSPN/2389?type=PGN. Signal-level enrichment via PR welcome  see CONTRIBUTING.md.";
CM_ SG_ 2147545099 Electronic_Steering_Control_RawP "Generic 8-byte raw payload. Detail page: https://www.isobus.net/isobus/pGNAndSPN/2396?type=PGN. Signal-level enrichment via PR welcome  see CONTRIBUTING.md.";
CM_ SG_ 2147545100 Electronic_Transmission_Controll "Generic 8-byte raw payload. Detail page: https://www.isobus.net/isobus/pGNAndSPN/2402?type=PGN. Signal-level enrichment via PR welcome  see CONTRIBUTING.md.";
CM_ SG_ 2147545101 Land_Leveling_System_Operational "Generic 8-byte raw payload. Detail page: https://www.isobus.net/isobus/pGNAndSPN/2413?type=PGN. Signal-level enrichment via PR welcome  see CONTRIBUTING.md.";
CM_ SG_ 2147545102 Aftertreatment_1_Intake_Gas_1_Ra "Generic 8-byte raw payload. Detail page: https://www.isobus.net/isobus/pGNAndSPN/2424?type=PGN. Signal-level enrichment via PR welcome  see CONTRIBUTING.md.";
CM_ SG_ 2147545103 Aftertreatment_1_Outlet_Gas_1_Ra "Generic 8-byte raw payload. Detail page: https://www.isobus.net/isobus/pGNAndSPN/2435?type=PGN. Signal-level enrichment via PR welcome  see CONTRIBUTING.md.";
CM_ SG_ 2147545104 Aftertreatment_2_Intake_Gas_1_Ra "Generic 8-byte raw payload. Detail page: https://www.isobus.net/isobus/pGNAndSPN/2447?type=PGN. Signal-level enrichment via PR welcome  see CONTRIBUTING.md.";
CM_ SG_ 2147545105 Aftertreatment_2_Outlet_Gas_1_Ra "Generic 8-byte raw payload. Detail page: https://www.isobus.net/isobus/pGNAndSPN/2459?type=PGN. Signal-level enrichment via PR welcome  see CONTRIBUTING.md.";
CM_ SG_ 2147545106 Fifth_Wheel_Smart_Systems_1_RawP "Generic 8-byte raw payload. Detail page: https://www.isobus.net/isobus/pGNAndSPN/2463?type=PGN. Signal-level enrichment via PR welcome  see CONTRIBUTING.md.";
CM_ SG_ 2147545107 Slope_Sensor_Information_RawPayl "Generic 8-byte raw payload. Detail page: https://www.isobus.net/isobus/pGNAndSPN/2471?type=PGN. Signal-level enrichment via PR welcome  see CONTRIBUTING.md.";
CM_ SG_ 2147545108 Blade_Information_RawPayload "Generic 8-byte raw payload. Detail page: https://www.isobus.net/isobus/pGNAndSPN/2476?type=PGN. Signal-level enrichment via PR welcome  see CONTRIBUTING.md.";
CM_ SG_ 2147545109 Requested_Generator_Total_AC_Rea "Generic 8-byte raw payload. Detail page: https://www.isobus.net/isobus/pGNAndSPN/2479?type=PGN. Signal-level enrichment via PR welcome  see CONTRIBUTING.md.";
CM_ SG_ 2147545110 Cylinder_Combustion_Status_RawPa "Generic 8-byte raw payload. Detail page: https://www.isobus.net/isobus/pGNAndSPN/2503?type=PGN. Signal-level enrichment via PR welcome  see CONTRIBUTING.md.";
CM_ SG_ 2147545111 Engine_Knock_Level_1_RawPayload "Generic 8-byte raw payload. Detail page: https://www.isobus.net/isobus/pGNAndSPN/2511?type=PGN. Signal-level enrichment via PR welcome  see CONTRIBUTING.md.";
CM_ SG_ 2147545112 Engine_Knock_Level_2_RawPayload "Generic 8-byte raw payload. Detail page: https://www.isobus.net/isobus/pGNAndSPN/2519?type=PGN. Signal-level enrichment via PR welcome  see CONTRIBUTING.md.";
CM_ SG_ 2147545113 Engine_Knock_Level_3_RawPayload "Generic 8-byte raw payload. Detail page: https://www.isobus.net/isobus/pGNAndSPN/2527?type=PGN. Signal-level enrichment via PR welcome  see CONTRIBUTING.md.";
CM_ SG_ 2147545114 Engine_Throttle_Fuel_Actuator_Co "Generic 8-byte raw payload. Detail page: https://www.isobus.net/isobus/pGNAndSPN/2531?type=PGN. Signal-level enrichment via PR welcome  see CONTRIBUTING.md.";
CM_ SG_ 2147545115 General_Purpose_Message_1_7_RawP "Generic 8-byte raw payload. Detail page: https://www.isobus.net/isobus/pGNAndSPN/2532?type=PGN. Signal-level enrichment via PR welcome  see CONTRIBUTING.md.";
CM_ SG_ 2147545116 Requested_Generator_Average_Basi "Generic 8-byte raw payload. Detail page: https://www.isobus.net/isobus/pGNAndSPN/2533?type=PGN. Signal-level enrichment via PR welcome  see CONTRIBUTING.md.";
CM_ SG_ 2147545117 Steering_Angle_Sensor_Informatio "Generic 8-byte raw payload. Detail page: https://www.isobus.net/isobus/pGNAndSPN/2541?type=PGN. Signal-level enrichment via PR welcome  see CONTRIBUTING.md.";
CM_ SG_ 2147545118 Generator_Control_2_RawPayload "Generic 8-byte raw payload. Detail page: https://www.isobus.net/isobus/pGNAndSPN/2544?type=PGN. Signal-level enrichment via PR welcome  see CONTRIBUTING.md.";
CM_ SG_ 2147545119 Electronic_Brake_System_2_6_RawP "Generic 8-byte raw payload. Detail page: https://www.isobus.net/isobus/pGNAndSPN/2545?type=PGN. Signal-level enrichment via PR welcome  see CONTRIBUTING.md.";
CM_ SG_ 2147545120 Electronic_Brake_System_2_5_RawP "Generic 8-byte raw payload. Detail page: https://www.isobus.net/isobus/pGNAndSPN/2546?type=PGN. Signal-level enrichment via PR welcome  see CONTRIBUTING.md.";
CM_ SG_ 2147545121 Engine_Speed_Sensor_Information_ "Generic 8-byte raw payload. Detail page: https://www.isobus.net/isobus/pGNAndSPN/2552?type=PGN. Signal-level enrichment via PR welcome  see CONTRIBUTING.md.";
CM_ SG_ 2147545123 Aftertreatment_1_SCR_Dosing_Syst "Generic 8-byte raw payload. Detail page: https://www.isobus.net/isobus/pGNAndSPN/2564?type=PGN. Signal-level enrichment via PR welcome  see CONTRIBUTING.md.";
CM_ SG_ 2147545124 Aftertreatment_1_SCR_Dosing_Syst "Generic 8-byte raw payload. Detail page: https://www.isobus.net/isobus/pGNAndSPN/2570?type=PGN. Signal-level enrichment via PR welcome  see CONTRIBUTING.md.";
CM_ SG_ 2147545125 Aftertreatment_1_SCR_Ammonia_Inf "Generic 8-byte raw payload. Detail page: https://www.isobus.net/isobus/pGNAndSPN/2577?type=PGN. Signal-level enrichment via PR welcome  see CONTRIBUTING.md.";
CM_ SG_ 2147545126 Aftertreatment_2_SCR_Dosing_Syst "Generic 8-byte raw payload. Detail page: https://www.isobus.net/isobus/pGNAndSPN/2583?type=PGN. Signal-level enrichment via PR welcome  see CONTRIBUTING.md.";
CM_ SG_ 2147545127 Aftertreatment_2_SCR_Dosing_Syst "Generic 8-byte raw payload. Detail page: https://www.isobus.net/isobus/pGNAndSPN/2590?type=PGN. Signal-level enrichment via PR welcome  see CONTRIBUTING.md.";
CM_ SG_ 2147545128 Aftertreatment_2_SCR_Ammonia_Inf "Generic 8-byte raw payload. Detail page: https://www.isobus.net/isobus/pGNAndSPN/2597?type=PGN. Signal-level enrichment via PR welcome  see CONTRIBUTING.md.";
CM_ SG_ 2147545129 Slope_Sensor_Information_2_RawPa "Generic 8-byte raw payload. Detail page: https://www.isobus.net/isobus/pGNAndSPN/2604?type=PGN. Signal-level enrichment via PR welcome  see CONTRIBUTING.md.";
CM_ SG_ 2147545130 Angular_Rate_Information_RawPayl "Generic 8-byte raw payload. Detail page: https://www.isobus.net/isobus/pGNAndSPN/2611?type=PGN. Signal-level enrichment via PR welcome  see CONTRIBUTING.md.";
CM_ SG_ 2147545131 Crash_Notification_RawPayload "Generic 8-byte raw payload. Detail page: https://www.isobus.net/isobus/pGNAndSPN/2614?type=PGN. Signal-level enrichment via PR welcome  see CONTRIBUTING.md.";
CM_ SG_ 2147545132 Magnet_Status_Information_2_RawP "Generic 8-byte raw payload. Detail page: https://www.isobus.net/isobus/pGNAndSPN/2624?type=PGN. Signal-level enrichment via PR welcome  see CONTRIBUTING.md.";
CM_ SG_ 2147545133 Acceleration_Sensor_RawPayload "Generic 8-byte raw payload. Detail page: https://www.isobus.net/isobus/pGNAndSPN/2631?type=PGN. Signal-level enrichment via PR welcome  see CONTRIBUTING.md.";
CM_ SG_ 2147545134 Engine_Turbocharger_Control_1_Ra "Generic 8-byte raw payload. Detail page: https://www.isobus.net/isobus/pGNAndSPN/2635?type=PGN. Signal-level enrichment via PR welcome  see CONTRIBUTING.md.";
CM_ SG_ 2147545135 Advanced_Emergency_Braking_Syste "Generic 8-byte raw payload. Detail page: https://www.isobus.net/isobus/pGNAndSPN/2641?type=PGN. Signal-level enrichment via PR welcome  see CONTRIBUTING.md.";
CM_ SG_ 2147545136 Wireless_Status_RawPayload "Generic 8-byte raw payload. Detail page: https://www.isobus.net/isobus/pGNAndSPN/2645?type=PGN. Signal-level enrichment via PR welcome  see CONTRIBUTING.md.";
CM_ SG_ 2147545137 Wand_Sensor_RawPayload "Generic 8-byte raw payload. Detail page: https://www.isobus.net/isobus/pGNAndSPN/2647?type=PGN. Signal-level enrichment via PR welcome  see CONTRIBUTING.md.";
CM_ SG_ 2147545138 Linear_Displacement_Sensor_RawPa "Generic 8-byte raw payload. Detail page: https://www.isobus.net/isobus/pGNAndSPN/2649?type=PGN. Signal-level enrichment via PR welcome  see CONTRIBUTING.md.";
CM_ SG_ 2147545139 Aftertreatment_1_SCR_Ammonia_Inf "Generic 8-byte raw payload. Detail page: https://www.isobus.net/isobus/pGNAndSPN/2656?type=PGN. Signal-level enrichment via PR welcome  see CONTRIBUTING.md.";
CM_ SG_ 2147545140 Aftertreatment_2_SCR_Ammonia_Inf "Generic 8-byte raw payload. Detail page: https://www.isobus.net/isobus/pGNAndSPN/2663?type=PGN. Signal-level enrichment via PR welcome  see CONTRIBUTING.md.";
CM_ SG_ 2147545142 High_Voltage_Energy_Storage_Syst "Generic 8-byte raw payload. Detail page: https://www.isobus.net/isobus/pGNAndSPN/2677?type=PGN. Signal-level enrichment via PR welcome  see CONTRIBUTING.md.";
CM_ SG_ 2147545143 Engine_Turbocharger_Blowoff_Actu "Generic 8-byte raw payload. Detail page: https://www.isobus.net/isobus/pGNAndSPN/2683?type=PGN. Signal-level enrichment via PR welcome  see CONTRIBUTING.md.";
CM_ SG_ 2147545144 Engine_Torque_Fuel_Request_RawPa "Generic 8-byte raw payload. Detail page: https://www.isobus.net/isobus/pGNAndSPN/2688?type=PGN. Signal-level enrichment via PR welcome  see CONTRIBUTING.md.";
CM_ SG_ 2147545145 Engine_Air_System_Information_Ra "Generic 8-byte raw payload. Detail page: https://www.isobus.net/isobus/pGNAndSPN/2692?type=PGN. Signal-level enrichment via PR welcome  see CONTRIBUTING.md.";
CM_ SG_ 2147545146 Engine_Cylinder_1_Combustion_Inf "Generic 8-byte raw payload. Detail page: https://www.isobus.net/isobus/pGNAndSPN/2698?type=PGN. Signal-level enrichment via PR welcome  see CONTRIBUTING.md.";
CM_ SG_ 2147545147 Engine_Cylinder_2_Combustion_Inf "Generic 8-byte raw payload. Detail page: https://www.isobus.net/isobus/pGNAndSPN/2704?type=PGN. Signal-level enrichment via PR welcome  see CONTRIBUTING.md.";
CM_ SG_ 2147545148 Engine_Cylinder_3_Combustion_Inf "Generic 8-byte raw payload. Detail page: https://www.isobus.net/isobus/pGNAndSPN/2710?type=PGN. Signal-level enrichment via PR welcome  see CONTRIBUTING.md.";
CM_ SG_ 2147545149 Engine_Cylinder_4_Combustion_Inf "Generic 8-byte raw payload. Detail page: https://www.isobus.net/isobus/pGNAndSPN/2716?type=PGN. Signal-level enrichment via PR welcome  see CONTRIBUTING.md.";
CM_ SG_ 2147545150 Engine_Cylinder_5_Combustion_Inf "Generic 8-byte raw payload. Detail page: https://www.isobus.net/isobus/pGNAndSPN/2722?type=PGN. Signal-level enrichment via PR welcome  see CONTRIBUTING.md.";
CM_ SG_ 2147545151 Engine_Cylinder_6_Combustion_Inf "Generic 8-byte raw payload. Detail page: https://www.isobus.net/isobus/pGNAndSPN/2728?type=PGN. Signal-level enrichment via PR welcome  see CONTRIBUTING.md.";
CM_ SG_ 2147545152 Engine_Cylinder_7_Combustion_Inf "Generic 8-byte raw payload. Detail page: https://www.isobus.net/isobus/pGNAndSPN/2734?type=PGN. Signal-level enrichment via PR welcome  see CONTRIBUTING.md.";
CM_ SG_ 2147545153 Engine_Cylinder_8_Combustion_Inf "Generic 8-byte raw payload. Detail page: https://www.isobus.net/isobus/pGNAndSPN/2740?type=PGN. Signal-level enrichment via PR welcome  see CONTRIBUTING.md.";
CM_ SG_ 2147545154 Engine_Cylinder_9_Combustion_Inf "Generic 8-byte raw payload. Detail page: https://www.isobus.net/isobus/pGNAndSPN/2746?type=PGN. Signal-level enrichment via PR welcome  see CONTRIBUTING.md.";
CM_ SG_ 2147545155 Engine_Cylinder_10_Combustion_In "Generic 8-byte raw payload. Detail page: https://www.isobus.net/isobus/pGNAndSPN/2752?type=PGN. Signal-level enrichment via PR welcome  see CONTRIBUTING.md.";
CM_ SG_ 2147545156 Engine_Cylinder_11_Combustion_In "Generic 8-byte raw payload. Detail page: https://www.isobus.net/isobus/pGNAndSPN/2758?type=PGN. Signal-level enrichment via PR welcome  see CONTRIBUTING.md.";
CM_ SG_ 2147545157 Engine_Cylinder_12_Combustion_In "Generic 8-byte raw payload. Detail page: https://www.isobus.net/isobus/pGNAndSPN/2764?type=PGN. Signal-level enrichment via PR welcome  see CONTRIBUTING.md.";
CM_ SG_ 2147545158 Engine_Cylinder_13_Combustion_In "Generic 8-byte raw payload. Detail page: https://www.isobus.net/isobus/pGNAndSPN/2770?type=PGN. Signal-level enrichment via PR welcome  see CONTRIBUTING.md.";
CM_ SG_ 2147545159 Engine_Cylinder_14_Combustion_In "Generic 8-byte raw payload. Detail page: https://www.isobus.net/isobus/pGNAndSPN/2776?type=PGN. Signal-level enrichment via PR welcome  see CONTRIBUTING.md.";
CM_ SG_ 2147545160 Engine_Cylinder_15_Combustion_In "Generic 8-byte raw payload. Detail page: https://www.isobus.net/isobus/pGNAndSPN/2782?type=PGN. Signal-level enrichment via PR welcome  see CONTRIBUTING.md.";
CM_ SG_ 2147545161 Engine_Cylinder_16_Combustion_In "Generic 8-byte raw payload. Detail page: https://www.isobus.net/isobus/pGNAndSPN/2788?type=PGN. Signal-level enrichment via PR welcome  see CONTRIBUTING.md.";
CM_ SG_ 2147545162 Engine_Cylinder_17_Combustion_In "Generic 8-byte raw payload. Detail page: https://www.isobus.net/isobus/pGNAndSPN/2794?type=PGN. Signal-level enrichment via PR welcome  see CONTRIBUTING.md.";
CM_ SG_ 2147545163 Engine_Cylinder_18_Combustion_In "Generic 8-byte raw payload. Detail page: https://www.isobus.net/isobus/pGNAndSPN/2800?type=PGN. Signal-level enrichment via PR welcome  see CONTRIBUTING.md.";
CM_ SG_ 2147545164 Engine_Cylinder_19_Combustion_In "Generic 8-byte raw payload. Detail page: https://www.isobus.net/isobus/pGNAndSPN/2806?type=PGN. Signal-level enrichment via PR welcome  see CONTRIBUTING.md.";
CM_ SG_ 2147545165 Engine_Cylinder_20_Combustion_In "Generic 8-byte raw payload. Detail page: https://www.isobus.net/isobus/pGNAndSPN/2812?type=PGN. Signal-level enrichment via PR welcome  see CONTRIBUTING.md.";
CM_ SG_ 2147545166 Engine_Cylinder_1_Combustion_Ave "Generic 8-byte raw payload. Detail page: https://www.isobus.net/isobus/pGNAndSPN/2816?type=PGN. Signal-level enrichment via PR welcome  see CONTRIBUTING.md.";
CM_ SG_ 2147545167 Engine_Cylinder_2_Combustion_Ave "Generic 8-byte raw payload. Detail page: https://www.isobus.net/isobus/pGNAndSPN/2820?type=PGN. Signal-level enrichment via PR welcome  see CONTRIBUTING.md.";
CM_ SG_ 2147545168 Engine_Cylinder_3_Combustion_Ave "Generic 8-byte raw payload. Detail page: https://www.isobus.net/isobus/pGNAndSPN/2824?type=PGN. Signal-level enrichment via PR welcome  see CONTRIBUTING.md.";
CM_ SG_ 2147545169 Engine_Cylinder_4_Combustion_Ave "Generic 8-byte raw payload. Detail page: https://www.isobus.net/isobus/pGNAndSPN/2828?type=PGN. Signal-level enrichment via PR welcome  see CONTRIBUTING.md.";
CM_ SG_ 2147545170 Engine_Cylinder_5_Combustion_Ave "Generic 8-byte raw payload. Detail page: https://www.isobus.net/isobus/pGNAndSPN/2832?type=PGN. Signal-level enrichment via PR welcome  see CONTRIBUTING.md.";
CM_ SG_ 2147545171 Engine_Cylinder_6_Combustion_Ave "Generic 8-byte raw payload. Detail page: https://www.isobus.net/isobus/pGNAndSPN/2836?type=PGN. Signal-level enrichment via PR welcome  see CONTRIBUTING.md.";
CM_ SG_ 2147545172 Engine_Cylinder_7_Combustion_Ave "Generic 8-byte raw payload. Detail page: https://www.isobus.net/isobus/pGNAndSPN/2840?type=PGN. Signal-level enrichment via PR welcome  see CONTRIBUTING.md.";
CM_ SG_ 2147545173 Engine_Cylinder_8_Combustion_Ave "Generic 8-byte raw payload. Detail page: https://www.isobus.net/isobus/pGNAndSPN/2844?type=PGN. Signal-level enrichment via PR welcome  see CONTRIBUTING.md.";
CM_ SG_ 2147545174 Engine_Cylinder_9_Combustion_Ave "Generic 8-byte raw payload. Detail page: https://www.isobus.net/isobus/pGNAndSPN/2848?type=PGN. Signal-level enrichment via PR welcome  see CONTRIBUTING.md.";
CM_ SG_ 2147545175 Engine_Cylinder_10_Combustion_Av "Generic 8-byte raw payload. Detail page: https://www.isobus.net/isobus/pGNAndSPN/2852?type=PGN. Signal-level enrichment via PR welcome  see CONTRIBUTING.md.";
CM_ SG_ 2147545176 Engine_Cylinder_11_Combustion_Av "Generic 8-byte raw payload. Detail page: https://www.isobus.net/isobus/pGNAndSPN/2856?type=PGN. Signal-level enrichment via PR welcome  see CONTRIBUTING.md.";
CM_ SG_ 2147545177 Engine_Cylinder_12_Combustion_Av "Generic 8-byte raw payload. Detail page: https://www.isobus.net/isobus/pGNAndSPN/2860?type=PGN. Signal-level enrichment via PR welcome  see CONTRIBUTING.md.";

BA_DEF_ BO_ "SystemMessageLongSymbol" STRING;
BA_DEF_ SG_ "SystemSignalLongSymbol" STRING;

BA_ "SystemMessageLongSymbol" BO_ 2147484160 "VDMA_200_Electronic_Brake_System_1_1";
BA_ "SystemMessageLongSymbol" BO_ 2147484416 "VDMA_300_Electronic_Brake_System_2_1";
BA_ "SystemMessageLongSymbol" BO_ 2147484928 "VDMA_500_CANopen_Application_Message_1_1";
BA_ "SystemMessageLongSymbol" BO_ 2147485184 "VDMA_600_CANopen_Application_Message_2_1";
BA_ "SystemMessageLongSymbol" BO_ 2147485440 "VDMA_700_General_Purpose_Valve_Pressure";
BA_ "SystemMessageLongSymbol" BO_ 2147485696 "VDMA_800_Auxiliary_Input_Output_Status_5";
BA_ "SystemMessageLongSymbol" BO_ 2147485952 "VDMA_900_Static_Roll_Angle_Sensor_Informa";
BA_ "SystemMessageLongSymbol" BO_ 2147486208 "VDMA_A00_Cruise_Control_Vehicle_Speed_2";
BA_ "SystemMessageLongSymbol" BO_ 2147486464 "VDMA_B00_Advanced_Emergency_Braking_Syste";
BA_ "SystemMessageLongSymbol" BO_ 2147486720 "VDMA_C00_Electronic_Engine_Controller_16";
BA_ "SystemMessageLongSymbol" BO_ 2147487488 "VDMA_F00_High_Voltage_Energy_Storage_Pack";
BA_ "SystemMessageLongSymbol" BO_ 2147487744 "VDMA_1000_High_Voltage_Energy_Storage_Pack";
BA_ "SystemMessageLongSymbol" BO_ 2147488000 "VDMA_1100_High_Voltage_Energy_Storage_Pack";
BA_ "SystemMessageLongSymbol" BO_ 2147488256 "VDMA_1200_High_Voltage_Energy_Storage_Pack";
BA_ "SystemMessageLongSymbol" BO_ 2147488512 "VDMA_1300_High_Voltage_Energy_Storage_Pack";
BA_ "SystemMessageLongSymbol" BO_ 2147488768 "VDMA_1400_High_Voltage_Energy_Storage_Pack";
BA_ "SystemMessageLongSymbol" BO_ 2147489024 "VDMA_1500_High_Voltage_Energy_Storage_Pack";
BA_ "SystemMessageLongSymbol" BO_ 2147489280 "VDMA_1600_High_Voltage_Energy_Storage_Pack";
BA_ "SystemMessageLongSymbol" BO_ 2147489536 "VDMA_1700_High_Voltage_Energy_Storage_Pack";
BA_ "SystemMessageLongSymbol" BO_ 2147489792 "VDMA_1800_High_Voltage_Energy_Storage_Pack";
BA_ "SystemMessageLongSymbol" BO_ 2147490048 "VDMA_1900_High_Voltage_Energy_Storage_Pack";
BA_ "SystemMessageLongSymbol" BO_ 2147490304 "VDMA_1A00_High_Voltage_Energy_Storage_Pack";
BA_ "SystemMessageLongSymbol" BO_ 2147490560 "VDMA_1B00_High_Voltage_Energy_Storage_Syst";
BA_ "SystemMessageLongSymbol" BO_ 2147490816 "VDMA_1C00_Transmission_Control_3_Obsolete_";
BA_ "SystemMessageLongSymbol" BO_ 2147491072 "VDMA_1D00_Engine_Ignition_Controller";
BA_ "SystemMessageLongSymbol" BO_ 2147491584 "VDMA_1F00_High_Voltage_Energy_Storage_Pack";
BA_ "SystemMessageLongSymbol" BO_ 2147491840 "VDMA_2000_High_Voltage_Energy_Storage_Pack";
BA_ "SystemMessageLongSymbol" BO_ 2147492096 "VDMA_2100_High_Voltage_Energy_Storage_Pack";
BA_ "SystemMessageLongSymbol" BO_ 2147492352 "VDMA_2200_High_Voltage_Energy_Storage_Pack";
BA_ "SystemMessageLongSymbol" BO_ 2147492608 "VDMA_2300_Tractor_Implement_Management_TIM";
BA_ "SystemMessageLongSymbol" BO_ 2147492864 "VDMA_2400_Tractor_Implement_Management_TIM";
BA_ "SystemMessageLongSymbol" BO_ 2147493376 "VDMA_2600_Motor_Generator_1_Inverter_Contr";
BA_ "SystemMessageLongSymbol" BO_ 2147493632 "VDMA_2700_Motor_Generator_2_Inverter_Contr";
BA_ "SystemMessageLongSymbol" BO_ 2147493888 "VDMA_2800_Motor_Generator_1_Inverter_Rate_";
BA_ "SystemMessageLongSymbol" BO_ 2147494144 "VDMA_2900_Motor_Generator_2_Inverter_Rate_";
BA_ "SystemMessageLongSymbol" BO_ 2147494400 "VDMA_2A00_High_Voltage_Energy_Storage_Pack";
BA_ "SystemMessageLongSymbol" BO_ 2147494656 "VDMA_2B00_High_Voltage_Energy_Storage_Pack";
BA_ "SystemMessageLongSymbol" BO_ 2147494912 "VDMA_2C00_High_Voltage_Energy_Storage_Pack";
BA_ "SystemMessageLongSymbol" BO_ 2147495168 "VDMA_2D00_High_Voltage_Energy_Storage_Pack";
BA_ "SystemMessageLongSymbol" BO_ 2147495424 "VDMA_2E00_High_Voltage_Energy_Storage_Pack";
BA_ "SystemMessageLongSymbol" BO_ 2147495680 "VDMA_2F00_High_Voltage_Energy_Storage_Pack";
BA_ "SystemMessageLongSymbol" BO_ 2147495936 "VDMA_3000_High_Voltage_Energy_Storage_Pack";
BA_ "SystemMessageLongSymbol" BO_ 2147496192 "VDMA_3100_High_Voltage_Energy_Storage_Pack";
BA_ "SystemMessageLongSymbol" BO_ 2147496448 "VDMA_3200_High_Voltage_Energy_Storage_Pack";
BA_ "SystemMessageLongSymbol" BO_ 2147496704 "VDMA_3300_High_Voltage_Energy_Storage_Pack";
BA_ "SystemMessageLongSymbol" BO_ 2147497728 "VDMA_3700_Message_Acknowledgement";
BA_ "SystemMessageLongSymbol" BO_ 2147497984 "VDMA_3800_Version_Negotiation_Section";
BA_ "SystemMessageLongSymbol" BO_ 2147498240 "VDMA_3900_External_ACC_Acceleration_Reques";
BA_ "SystemMessageLongSymbol" BO_ 2147498496 "VDMA_3A00_Battery_Charger_1_Command_1";
BA_ "SystemMessageLongSymbol" BO_ 2147498752 "VDMA_3B00_Battery_Charger_2_Command_1";
BA_ "SystemMessageLongSymbol" BO_ 2147499008 "VDMA_3C00_Tractor_Implement_Management_TIM";
BA_ "SystemMessageLongSymbol" BO_ 2147499264 "VDMA_3D00_Tractor_Implement_Management_TIM";
BA_ "SystemMessageLongSymbol" BO_ 2147499520 "VDMA_3E00_Fuel_Cell_System_Control_Command";
BA_ "SystemMessageLongSymbol" BO_ 2147499776 "VDMA_3F00_Fuel_Cell_System_Power_Limit_Com";
BA_ "SystemMessageLongSymbol" BO_ 2147500032 "VDMA_4000_Fuel_Cell_System_Current_Limit_C";
BA_ "SystemMessageLongSymbol" BO_ 2147500288 "VDMA_4100_Hydrogen_Storage_System_Control_";
BA_ "SystemMessageLongSymbol" BO_ 2147500800 "VDMA_4300_Safety_Header_Message_2";
BA_ "SystemMessageLongSymbol" BO_ 2147502080 "VDMA_4800_Tractor_Implement_Management_TIM";
BA_ "SystemMessageLongSymbol" BO_ 2147502336 "VDMA_4900_Tractor_Implement_Management_TIM";
BA_ "SystemMessageLongSymbol" BO_ 2147502592 "VDMA_4A00_EV_Multi_Connection_DC_Status_1";
BA_ "SystemMessageLongSymbol" BO_ 2147502848 "VDMA_4B00_EV_Multi_Connection_DC_Charging_";
BA_ "SystemMessageLongSymbol" BO_ 2147503104 "VDMA_4C00_Electrified_Accessory_Engine_Coo";
BA_ "SystemMessageLongSymbol" BO_ 2147503360 "VDMA_4D00_FD_Transport_Protocol_Connection";
BA_ "SystemMessageLongSymbol" BO_ 2147503616 "VDMA_4E00_FD_Transport_Protocol_Data_Trans";
BA_ "SystemMessageLongSymbol" BO_ 2147505408 "VDMA_5500_Air_Suspension_Control_8";
BA_ "SystemMessageLongSymbol" BO_ 2147505664 "VDMA_5600_Motor_Generator_2_Inverter_Contr";
BA_ "SystemMessageLongSymbol" BO_ 2147505920 "VDMA_5700_Motor_Generator_1_Inverter_Contr";
BA_ "SystemMessageLongSymbol" BO_ 2147506176 "VDMA_5800_Hoist_Command_Information";
BA_ "SystemMessageLongSymbol" BO_ 2147506432 "VDMA_5900_Motor_Generator_2_Inverter_Isola";
BA_ "SystemMessageLongSymbol" BO_ 2147506688 "VDMA_5A00_Motor_Generator_1_Inverter_Isola";
BA_ "SystemMessageLongSymbol" BO_ 2147506944 "VDMA_5B00_Motor_Generator_2_Inverter_Limit";
BA_ "SystemMessageLongSymbol" BO_ 2147507200 "VDMA_5C00_Motor_Generator_2_Inverter_Limit";
BA_ "SystemMessageLongSymbol" BO_ 2147507456 "VDMA_5D00_Motor_Generator_2_Inverter_Limit";
BA_ "SystemMessageLongSymbol" BO_ 2147507712 "VDMA_5E00_Motor_Generator_1_Inverter_Limit";
BA_ "SystemMessageLongSymbol" BO_ 2147507968 "VDMA_5F00_Motor_Generator_1_Inverter_Limit";
BA_ "SystemMessageLongSymbol" BO_ 2147508224 "VDMA_6000_Motor_Generator_1_Inverter_Limit";
BA_ "SystemMessageLongSymbol" BO_ 2147508480 "VDMA_6100_Personnel_Detect_Interlock";
BA_ "SystemMessageLongSymbol" BO_ 2147508736 "VDMA_6200_Engine_Cylinder_Combustion_Confi";
BA_ "SystemMessageLongSymbol" BO_ 2147508992 "VDMA_6300_Engine_Cylinder_Combustion_Confi";
BA_ "SystemMessageLongSymbol" BO_ 2147509248 "VDMA_6400_Engine_Cylinder_Pressure_Timing_";
BA_ "SystemMessageLongSymbol" BO_ 2147509504 "VDMA_6500_Engine_Cylinder_Pressure_Timing_";
BA_ "SystemMessageLongSymbol" BO_ 2147509760 "VDMA_6600_Electrified_Accessory_Generator_";
BA_ "SystemMessageLongSymbol" BO_ 2147510016 "VDMA_6700_Electrified_Accessory_Generator_";
BA_ "SystemMessageLongSymbol" BO_ 2147510528 "VDMA_6900_Marine_Control_Information_Confi";
BA_ "SystemMessageLongSymbol" BO_ 2147510784 "VDMA_6A00_Marine_Control_Information_2";
BA_ "SystemMessageLongSymbol" BO_ 2147511040 "VDMA_6B00_Well_Stimulation_Pump_Sensor_Cal";
BA_ "SystemMessageLongSymbol" BO_ 2147511552 "VDMA_6D00_Well_Stimulation_Pump_System_Con";
BA_ "SystemMessageLongSymbol" BO_ 2147511808 "VDMA_6E00_Configurable_Receive_SPNs_Comman";
BA_ "SystemMessageLongSymbol" BO_ 2147512064 "VDMA_6F00_Authentication_Client_to_Authent";
BA_ "SystemMessageLongSymbol" BO_ 2147512320 "VDMA_7000_Authentication_Server_to_Authent";
BA_ "SystemMessageLongSymbol" BO_ 2147512576 "VDMA_7100_Configurable_Transmit_PGNs_Comma";
BA_ "SystemMessageLongSymbol" BO_ 2147512832 "VDMA_7200_Oil_Debris_Monitor_Configuration";
BA_ "SystemMessageLongSymbol" BO_ 2147513088 "VDMA_7300_Electrified_Accessory_Propulsion";
BA_ "SystemMessageLongSymbol" BO_ 2147513344 "VDMA_7400_Electrified_Accessory_Propulsion";
BA_ "SystemMessageLongSymbol" BO_ 2147513600 "VDMA_7500_Electrified_Accessory_Propulsion";
BA_ "SystemMessageLongSymbol" BO_ 2147513856 "VDMA_7600_Electrified_Accessory_Power_Elec";
BA_ "SystemMessageLongSymbol" BO_ 2147514112 "VDMA_7700_Electrified_Accessory_Power_Elec";
BA_ "SystemMessageLongSymbol" BO_ 2147514368 "VDMA_7800_Electrified_Accessory_Power_Elec";
BA_ "SystemMessageLongSymbol" BO_ 2147514624 "VDMA_7900_Electrified_Accessory_Propulsion";
BA_ "SystemMessageLongSymbol" BO_ 2147514880 "VDMA_7A00_Electrified_Accessory_Propulsion";
BA_ "SystemMessageLongSymbol" BO_ 2147515136 "VDMA_7B00_Electrified_Accessory_Power_Elec";
BA_ "SystemMessageLongSymbol" BO_ 2147515392 "VDMA_7C00_Extended_Control_Function_Functi";
BA_ "SystemMessageLongSymbol" BO_ 2147515648 "VDMA_7D00_Electrified_Accessory_Motor_Comm";
BA_ "SystemMessageLongSymbol" BO_ 2147515904 "VDMA_7E00_Engine_Speed_Ramp_Rate_Boundary_";
BA_ "SystemMessageLongSymbol" BO_ 2147516160 "VDMA_7F00_Tire_Sensor_Identification_Comma";
BA_ "SystemMessageLongSymbol" BO_ 2147516416 "VDMA_8000_Hybrid_or_EV_System_Control_1";
BA_ "SystemMessageLongSymbol" BO_ 2147516672 "VDMA_8100_Aftertreatment_System_Control";
BA_ "SystemMessageLongSymbol" BO_ 2147516928 "VDMA_8200_Tire_Configuration_Command_Infor";
BA_ "SystemMessageLongSymbol" BO_ 2147517184 "VDMA_8300_Payload_Calibration_Information_";
BA_ "SystemMessageLongSymbol" BO_ 2147517440 "VDMA_8400_Aftertreatment_1_Particulate_Sen";
BA_ "SystemMessageLongSymbol" BO_ 2147517952 "VDMA_8600_Switched_Power_Outputs_Command";
BA_ "SystemMessageLongSymbol" BO_ 2147518720 "VDMA_8900_Running_Gear_Equipment_2_4";
BA_ "SystemMessageLongSymbol" BO_ 2147518976 "VDMA_8A00_Running_Gear_Equipment_1_2";
BA_ "SystemMessageLongSymbol" BO_ 2147519232 "VDMA_8B00_CCP_Data_Transmission_Object";
BA_ "SystemMessageLongSymbol" BO_ 2147519488 "VDMA_8C00_CCP_Command_Receive_Object";
BA_ "SystemMessageLongSymbol" BO_ 2147519744 "VDMA_8D00_Sequence_Control_Client_to_Seque";
BA_ "SystemMessageLongSymbol" BO_ 2147520000 "VDMA_8E00_Sequence_Control_Master_to_Seque";
BA_ "SystemMessageLongSymbol" BO_ 2147520256 "VDMA_8F00_Engine_Configuration_Commands";
BA_ "SystemMessageLongSymbol" BO_ 2147520512 "VDMA_9000_Supplemental_Fan_Command";
BA_ "SystemMessageLongSymbol" BO_ 2147520768 "VDMA_9100_Vehicle_Chassis_Lubrication_Syst";
BA_ "SystemMessageLongSymbol" BO_ 2147521024 "VDMA_9200_Aftertreatment_1_Hydrocarbon_Dos";
BA_ "SystemMessageLongSymbol" BO_ 2147521280 "VDMA_9300_NAME_Management_Message";
BA_ "SystemMessageLongSymbol" BO_ 2147521536 "VDMA_9400_Aftertreatment_1_Diesel_Particul";
BA_ "SystemMessageLongSymbol" BO_ 2147521792 "VDMA_9500_Aftertreatment_2_Diesel_Particul";
BA_ "SystemMessageLongSymbol" BO_ 2147522048 "VDMA_9600_Low_Voltage_Disconnect_Set_Opera";
BA_ "SystemMessageLongSymbol" BO_ 2147522816 "VDMA_9900_Joystick_Lamp_Command_Message";
BA_ "SystemMessageLongSymbol" BO_ 2147523072 "VDMA_9A00_General_Purpose_Message_1_8";
BA_ "SystemMessageLongSymbol" BO_ 2147523584 "VDMA_9C00_Auxiliary_Input_Output_Status_7";
BA_ "SystemMessageLongSymbol" BO_ 2147523840 "VDMA_9D00_Auxiliary_Input_Output_Status_6";
BA_ "SystemMessageLongSymbol" BO_ 2147524864 "VDMA_A100_Emission_Increasing_Auxiliary_Em";
BA_ "SystemMessageLongSymbol" BO_ 2147525120 "VDMA_A200_Regulated_Exhaust_Emission_Level";
BA_ "SystemMessageLongSymbol" BO_ 2147525376 "VDMA_A300_DTC_To_Lamp_Association";
BA_ "SystemMessageLongSymbol" BO_ 2147525888 "VDMA_A500_Auxiliary_Input_Output_Status_4";
BA_ "SystemMessageLongSymbol" BO_ 2147526144 "VDMA_A600_Auxiliary_Input_Output_Status_3";
BA_ "SystemMessageLongSymbol" BO_ 2147526400 "VDMA_A700_Auxiliary_Input_Output_Status_2";
BA_ "SystemMessageLongSymbol" BO_ 2147526912 "VDMA_A900_Forward_Lane_Image_Command";
BA_ "SystemMessageLongSymbol" BO_ 2147527168 "VDMA_AA00_Client_ECU_to_File_Server_messag";
BA_ "SystemMessageLongSymbol" BO_ 2147527424 "VDMA_AB00_File_Server_to_Client_ECU_messag";
BA_ "SystemMessageLongSymbol" BO_ 2147528192 "VDMA_AE00_Tire_Pressure_Reference_Setting";
BA_ "SystemMessageLongSymbol" BO_ 2147528448 "VDMA_AF00_Parameter_Locate_Message";
BA_ "SystemMessageLongSymbol" BO_ 2147528704 "VDMA_B000_Configuration_Identification_Mes";
BA_ "SystemMessageLongSymbol" BO_ 2147528960 "VDMA_B100_Proprietarily_Configurable_Messa";
BA_ "SystemMessageLongSymbol" BO_ 2147529216 "VDMA_B200_Proprietarily_Configurable_Messa";
BA_ "SystemMessageLongSymbol" BO_ 2147529472 "VDMA_B300_Proprietarily_Configurable_Messa";
BA_ "SystemMessageLongSymbol" BO_ 2147529728 "VDMA_B400_Proprietarily_Configurable_Messa";
BA_ "SystemMessageLongSymbol" BO_ 2147529984 "VDMA_B500_Proprietarily_Configurable_Messa";
BA_ "SystemMessageLongSymbol" BO_ 2147530240 "VDMA_B600_Proprietarily_Configurable_Messa";
BA_ "SystemMessageLongSymbol" BO_ 2147530496 "VDMA_B700_Proprietarily_Configurable_Messa";
BA_ "SystemMessageLongSymbol" BO_ 2147530752 "VDMA_B800_Proprietarily_Configurable_Messa";
BA_ "SystemMessageLongSymbol" BO_ 2147531008 "VDMA_B900_Proprietarily_Configurable_Messa";
BA_ "SystemMessageLongSymbol" BO_ 2147531264 "VDMA_BA00_Proprietarily_Configurable_Messa";
BA_ "SystemMessageLongSymbol" BO_ 2147531520 "VDMA_BB00_Proprietarily_Configurable_Messa";
BA_ "SystemMessageLongSymbol" BO_ 2147531776 "VDMA_BC00_Proprietarily_Configurable_Messa";
BA_ "SystemMessageLongSymbol" BO_ 2147532032 "VDMA_BD00_Proprietarily_Configurable_Messa";
BA_ "SystemMessageLongSymbol" BO_ 2147532288 "VDMA_BE00_Proprietarily_Configurable_Messa";
BA_ "SystemMessageLongSymbol" BO_ 2147532544 "VDMA_BF00_Proprietarily_Configurable_Messa";
BA_ "SystemMessageLongSymbol" BO_ 2147532800 "VDMA_C000_Proprietarily_Configurable_Messa";
BA_ "SystemMessageLongSymbol" BO_ 2147533312 "VDMA_C200_Monitor_Performance_Ratio";
BA_ "SystemMessageLongSymbol" BO_ 2147533824 "VDMA_C400_General_Purpose_Valve_command";
BA_ "SystemMessageLongSymbol" BO_ 2147534080 "VDMA_C500_General_Purpose_Valve_measured_f";
BA_ "SystemMessageLongSymbol" BO_ 2147534336 "VDMA_C600_General_Purpose_Valve_estimated_";
BA_ "SystemMessageLongSymbol" BO_ 2147536640 "VDMA_CF00_Continuous_Torque_Speed_Limit_Re";
BA_ "SystemMessageLongSymbol" BO_ 2147536896 "VDMA_D000_Background_lighting_level_comman";
BA_ "SystemMessageLongSymbol" BO_ 2147537152 "VDMA_D100_Air_Suspension_Control_6";
BA_ "SystemMessageLongSymbol" BO_ 2147537408 "VDMA_D200_Air_Suspension_Control_2";
BA_ "SystemMessageLongSymbol" BO_ 2147537664 "VDMA_D300_Calibration_Information";
BA_ "SystemMessageLongSymbol" BO_ 2147541248 "VDMA_E100_General_Purpose_Message_2_1";
BA_ "SystemMessageLongSymbol" BO_ 2147541504 "VDMA_E200_General_Purpose_Message_1_1";
BA_ "SystemMessageLongSymbol" BO_ 2147541760 "VDMA_E300_Command_Non_continuously_Monitor";
BA_ "SystemMessageLongSymbol" BO_ 2147542016 "VDMA_E400_Running_Gear_Equipment_1_1";
BA_ "SystemMessageLongSymbol" BO_ 2147542272 "VDMA_E500_Running_Gear_Equipment_2_1";
BA_ "SystemMessageLongSymbol" BO_ 2147545088 "VDMA_F000_Electronic_Retarder_Controller_1";
BA_ "SystemMessageLongSymbol" BO_ 2147545089 "VDMA_F001_Electronic_Brake_Controller_1";
BA_ "SystemMessageLongSymbol" BO_ 2147545090 "VDMA_F002_Electronic_Transmission_Controll";
BA_ "SystemMessageLongSymbol" BO_ 2147545093 "VDMA_F005_Electronic_Transmission_Controll";
BA_ "SystemMessageLongSymbol" BO_ 2147545094 "VDMA_F006_Electronic_Axle_Controller_1";
BA_ "SystemMessageLongSymbol" BO_ 2147545096 "VDMA_F008_Hydraulic_Pressure_Governor_Info";
BA_ "SystemMessageLongSymbol" BO_ 2147545097 "VDMA_F009_Vehicle_Dynamic_Stability_Contro";
BA_ "SystemMessageLongSymbol" BO_ 2147545099 "VDMA_F00B_Electronic_Steering_Control";
BA_ "SystemMessageLongSymbol" BO_ 2147545100 "VDMA_F00C_Electronic_Transmission_Controll";
BA_ "SystemMessageLongSymbol" BO_ 2147545101 "VDMA_F00D_Land_Leveling_System_Operational";
BA_ "SystemMessageLongSymbol" BO_ 2147545102 "VDMA_F00E_Aftertreatment_1_Intake_Gas_1";
BA_ "SystemMessageLongSymbol" BO_ 2147545103 "VDMA_F00F_Aftertreatment_1_Outlet_Gas_1";
BA_ "SystemMessageLongSymbol" BO_ 2147545104 "VDMA_F010_Aftertreatment_2_Intake_Gas_1";
BA_ "SystemMessageLongSymbol" BO_ 2147545105 "VDMA_F011_Aftertreatment_2_Outlet_Gas_1";
BA_ "SystemMessageLongSymbol" BO_ 2147545106 "VDMA_F012_Fifth_Wheel_Smart_Systems_1";
BA_ "SystemMessageLongSymbol" BO_ 2147545107 "VDMA_F013_Slope_Sensor_Information";
BA_ "SystemMessageLongSymbol" BO_ 2147545109 "VDMA_F015_Requested_Generator_Total_AC_Rea";
BA_ "SystemMessageLongSymbol" BO_ 2147545110 "VDMA_F016_Cylinder_Combustion_Status";
BA_ "SystemMessageLongSymbol" BO_ 2147545114 "VDMA_F01A_Engine_Throttle_Fuel_Actuator_Co";
BA_ "SystemMessageLongSymbol" BO_ 2147545115 "VDMA_F01B_General_Purpose_Message_1_7";
BA_ "SystemMessageLongSymbol" BO_ 2147545116 "VDMA_F01C_Requested_Generator_Average_Basi";
BA_ "SystemMessageLongSymbol" BO_ 2147545117 "VDMA_F01D_Steering_Angle_Sensor_Informatio";
BA_ "SystemMessageLongSymbol" BO_ 2147545119 "VDMA_F01F_Electronic_Brake_System_2_6";
BA_ "SystemMessageLongSymbol" BO_ 2147545120 "VDMA_F020_Electronic_Brake_System_2_5";
BA_ "SystemMessageLongSymbol" BO_ 2147545121 "VDMA_F021_Engine_Speed_Sensor_Information_";
BA_ "SystemMessageLongSymbol" BO_ 2147545123 "VDMA_F023_Aftertreatment_1_SCR_Dosing_Syst";
BA_ "SystemMessageLongSymbol" BO_ 2147545124 "VDMA_F024_Aftertreatment_1_SCR_Dosing_Syst";
BA_ "SystemMessageLongSymbol" BO_ 2147545125 "VDMA_F025_Aftertreatment_1_SCR_Ammonia_Inf";
BA_ "SystemMessageLongSymbol" BO_ 2147545126 "VDMA_F026_Aftertreatment_2_SCR_Dosing_Syst";
BA_ "SystemMessageLongSymbol" BO_ 2147545127 "VDMA_F027_Aftertreatment_2_SCR_Dosing_Syst";
BA_ "SystemMessageLongSymbol" BO_ 2147545128 "VDMA_F028_Aftertreatment_2_SCR_Ammonia_Inf";
BA_ "SystemMessageLongSymbol" BO_ 2147545129 "VDMA_F029_Slope_Sensor_Information_2";
BA_ "SystemMessageLongSymbol" BO_ 2147545130 "VDMA_F02A_Angular_Rate_Information";
BA_ "SystemMessageLongSymbol" BO_ 2147545132 "VDMA_F02C_Magnet_Status_Information_2";
BA_ "SystemMessageLongSymbol" BO_ 2147545134 "VDMA_F02E_Engine_Turbocharger_Control_1";
BA_ "SystemMessageLongSymbol" BO_ 2147545135 "VDMA_F02F_Advanced_Emergency_Braking_Syste";
BA_ "SystemMessageLongSymbol" BO_ 2147545138 "VDMA_F032_Linear_Displacement_Sensor";
BA_ "SystemMessageLongSymbol" BO_ 2147545139 "VDMA_F033_Aftertreatment_1_SCR_Ammonia_Inf";
BA_ "SystemMessageLongSymbol" BO_ 2147545140 "VDMA_F034_Aftertreatment_2_SCR_Ammonia_Inf";
BA_ "SystemMessageLongSymbol" BO_ 2147545142 "VDMA_F036_High_Voltage_Energy_Storage_Syst";
BA_ "SystemMessageLongSymbol" BO_ 2147545143 "VDMA_F037_Engine_Turbocharger_Blowoff_Actu";
BA_ "SystemMessageLongSymbol" BO_ 2147545144 "VDMA_F038_Engine_Torque_Fuel_Request";
BA_ "SystemMessageLongSymbol" BO_ 2147545145 "VDMA_F039_Engine_Air_System_Information";
BA_ "SystemMessageLongSymbol" BO_ 2147545146 "VDMA_F03A_Engine_Cylinder_1_Combustion_Inf";
BA_ "SystemMessageLongSymbol" BO_ 2147545147 "VDMA_F03B_Engine_Cylinder_2_Combustion_Inf";
BA_ "SystemMessageLongSymbol" BO_ 2147545148 "VDMA_F03C_Engine_Cylinder_3_Combustion_Inf";
BA_ "SystemMessageLongSymbol" BO_ 2147545149 "VDMA_F03D_Engine_Cylinder_4_Combustion_Inf";
BA_ "SystemMessageLongSymbol" BO_ 2147545150 "VDMA_F03E_Engine_Cylinder_5_Combustion_Inf";
BA_ "SystemMessageLongSymbol" BO_ 2147545151 "VDMA_F03F_Engine_Cylinder_6_Combustion_Inf";
BA_ "SystemMessageLongSymbol" BO_ 2147545152 "VDMA_F040_Engine_Cylinder_7_Combustion_Inf";
BA_ "SystemMessageLongSymbol" BO_ 2147545153 "VDMA_F041_Engine_Cylinder_8_Combustion_Inf";
BA_ "SystemMessageLongSymbol" BO_ 2147545154 "VDMA_F042_Engine_Cylinder_9_Combustion_Inf";
BA_ "SystemMessageLongSymbol" BO_ 2147545155 "VDMA_F043_Engine_Cylinder_10_Combustion_In";
BA_ "SystemMessageLongSymbol" BO_ 2147545156 "VDMA_F044_Engine_Cylinder_11_Combustion_In";
BA_ "SystemMessageLongSymbol" BO_ 2147545157 "VDMA_F045_Engine_Cylinder_12_Combustion_In";
BA_ "SystemMessageLongSymbol" BO_ 2147545158 "VDMA_F046_Engine_Cylinder_13_Combustion_In";
BA_ "SystemMessageLongSymbol" BO_ 2147545159 "VDMA_F047_Engine_Cylinder_14_Combustion_In";
BA_ "SystemMessageLongSymbol" BO_ 2147545160 "VDMA_F048_Engine_Cylinder_15_Combustion_In";
BA_ "SystemMessageLongSymbol" BO_ 2147545161 "VDMA_F049_Engine_Cylinder_16_Combustion_In";
BA_ "SystemMessageLongSymbol" BO_ 2147545162 "VDMA_F04A_Engine_Cylinder_17_Combustion_In";
BA_ "SystemMessageLongSymbol" BO_ 2147545163 "VDMA_F04B_Engine_Cylinder_18_Combustion_In";
BA_ "SystemMessageLongSymbol" BO_ 2147545164 "VDMA_F04C_Engine_Cylinder_19_Combustion_In";
BA_ "SystemMessageLongSymbol" BO_ 2147545165 "VDMA_F04D_Engine_Cylinder_20_Combustion_In";
BA_ "SystemMessageLongSymbol" BO_ 2147545166 "VDMA_F04E_Engine_Cylinder_1_Combustion_Ave";
BA_ "SystemMessageLongSymbol" BO_ 2147545167 "VDMA_F04F_Engine_Cylinder_2_Combustion_Ave";
BA_ "SystemMessageLongSymbol" BO_ 2147545168 "VDMA_F050_Engine_Cylinder_3_Combustion_Ave";
BA_ "SystemMessageLongSymbol" BO_ 2147545169 "VDMA_F051_Engine_Cylinder_4_Combustion_Ave";
BA_ "SystemMessageLongSymbol" BO_ 2147545170 "VDMA_F052_Engine_Cylinder_5_Combustion_Ave";
BA_ "SystemMessageLongSymbol" BO_ 2147545171 "VDMA_F053_Engine_Cylinder_6_Combustion_Ave";
BA_ "SystemMessageLongSymbol" BO_ 2147545172 "VDMA_F054_Engine_Cylinder_7_Combustion_Ave";
BA_ "SystemMessageLongSymbol" BO_ 2147545173 "VDMA_F055_Engine_Cylinder_8_Combustion_Ave";
BA_ "SystemMessageLongSymbol" BO_ 2147545174 "VDMA_F056_Engine_Cylinder_9_Combustion_Ave";
BA_ "SystemMessageLongSymbol" BO_ 2147545175 "VDMA_F057_Engine_Cylinder_10_Combustion_Av";
BA_ "SystemMessageLongSymbol" BO_ 2147545176 "VDMA_F058_Engine_Cylinder_11_Combustion_Av";
BA_ "SystemMessageLongSymbol" BO_ 2147545177 "VDMA_F059_Engine_Cylinder_12_Combustion_Av";

BA_ "SystemSignalLongSymbol" SG_ 2147483904 Transmission_Control_1_RawPayloa "Transmission_Control_1_RawPayload";
BA_ "SystemSignalLongSymbol" SG_ 2147484160 Electronic_Brake_System_1_1_RawP "Electronic_Brake_System_1_1_RawPayload";
BA_ "SystemSignalLongSymbol" SG_ 2147484416 Electronic_Brake_System_2_1_RawP "Electronic_Brake_System_2_1_RawPayload";
BA_ "SystemSignalLongSymbol" SG_ 2147484672 External_Brake_Request_RawPayloa "External_Brake_Request_RawPayload";
BA_ "SystemSignalLongSymbol" SG_ 2147484928 CANopen_Application_Message_1_1_ "CANopen_Application_Message_1_1_RawPayload";
BA_ "SystemSignalLongSymbol" SG_ 2147485184 CANopen_Application_Message_2_1_ "CANopen_Application_Message_2_1_RawPayload";
BA_ "SystemSignalLongSymbol" SG_ 2147485440 General_Purpose_Valve_Pressure_R "General_Purpose_Valve_Pressure_RawPayload";
BA_ "SystemSignalLongSymbol" SG_ 2147485696 Auxiliary_Input_Output_Status_5_ "Auxiliary_Input_Output_Status_5_RawPayload";
BA_ "SystemSignalLongSymbol" SG_ 2147485952 Static_Roll_Angle_Sensor_Informa "Static_Roll_Angle_Sensor_Informa_RawPayload";
BA_ "SystemSignalLongSymbol" SG_ 2147486208 Cruise_Control_Vehicle_Speed_2_R "Cruise_Control_Vehicle_Speed_2_RawPayload";
BA_ "SystemSignalLongSymbol" SG_ 2147486464 Advanced_Emergency_Braking_Syste "Advanced_Emergency_Braking_Syste_RawPayload";
BA_ "SystemSignalLongSymbol" SG_ 2147486720 Electronic_Engine_Controller_16_ "Electronic_Engine_Controller_16_RawPayload";
BA_ "SystemSignalLongSymbol" SG_ 2147486976 Transmission_Control_2_RawPayloa "Transmission_Control_2_RawPayload";
BA_ "SystemSignalLongSymbol" SG_ 2147487488 High_Voltage_Energy_Storage_Pack "High_Voltage_Energy_Storage_Pack_RawPayload";
BA_ "SystemSignalLongSymbol" SG_ 2147487744 High_Voltage_Energy_Storage_Pack "High_Voltage_Energy_Storage_Pack_RawPayload";
BA_ "SystemSignalLongSymbol" SG_ 2147488000 High_Voltage_Energy_Storage_Pack "High_Voltage_Energy_Storage_Pack_RawPayload";
BA_ "SystemSignalLongSymbol" SG_ 2147488256 High_Voltage_Energy_Storage_Pack "High_Voltage_Energy_Storage_Pack_RawPayload";
BA_ "SystemSignalLongSymbol" SG_ 2147488512 High_Voltage_Energy_Storage_Pack "High_Voltage_Energy_Storage_Pack_RawPayload";
BA_ "SystemSignalLongSymbol" SG_ 2147488768 High_Voltage_Energy_Storage_Pack "High_Voltage_Energy_Storage_Pack_RawPayload";
BA_ "SystemSignalLongSymbol" SG_ 2147489024 High_Voltage_Energy_Storage_Pack "High_Voltage_Energy_Storage_Pack_RawPayload";
BA_ "SystemSignalLongSymbol" SG_ 2147489280 High_Voltage_Energy_Storage_Pack "High_Voltage_Energy_Storage_Pack_RawPayload";
BA_ "SystemSignalLongSymbol" SG_ 2147489536 High_Voltage_Energy_Storage_Pack "High_Voltage_Energy_Storage_Pack_RawPayload";
BA_ "SystemSignalLongSymbol" SG_ 2147489792 High_Voltage_Energy_Storage_Pack "High_Voltage_Energy_Storage_Pack_RawPayload";
BA_ "SystemSignalLongSymbol" SG_ 2147490048 High_Voltage_Energy_Storage_Pack "High_Voltage_Energy_Storage_Pack_RawPayload";
BA_ "SystemSignalLongSymbol" SG_ 2147490304 High_Voltage_Energy_Storage_Pack "High_Voltage_Energy_Storage_Pack_RawPayload";
BA_ "SystemSignalLongSymbol" SG_ 2147490560 High_Voltage_Energy_Storage_Syst "High_Voltage_Energy_Storage_Syst_RawPayload";
BA_ "SystemSignalLongSymbol" SG_ 2147490816 Transmission_Control_3_Obsolete_ "Transmission_Control_3_Obsolete__RawPayload";
BA_ "SystemSignalLongSymbol" SG_ 2147491072 Engine_Ignition_Controller_RawPa "Engine_Ignition_Controller_RawPayload";
BA_ "SystemSignalLongSymbol" SG_ 2147491584 High_Voltage_Energy_Storage_Pack "High_Voltage_Energy_Storage_Pack_RawPayload";
BA_ "SystemSignalLongSymbol" SG_ 2147491840 High_Voltage_Energy_Storage_Pack "High_Voltage_Energy_Storage_Pack_RawPayload";
BA_ "SystemSignalLongSymbol" SG_ 2147492096 High_Voltage_Energy_Storage_Pack "High_Voltage_Energy_Storage_Pack_RawPayload";
BA_ "SystemSignalLongSymbol" SG_ 2147492352 High_Voltage_Energy_Storage_Pack "High_Voltage_Energy_Storage_Pack_RawPayload";
BA_ "SystemSignalLongSymbol" SG_ 2147492608 Tractor_Implement_Management_TIM "Tractor_Implement_Management_TIM_RawPayload";
BA_ "SystemSignalLongSymbol" SG_ 2147492864 Tractor_Implement_Management_TIM "Tractor_Implement_Management_TIM_RawPayload";
BA_ "SystemSignalLongSymbol" SG_ 2147493376 Motor_Generator_1_Inverter_Contr "Motor_Generator_1_Inverter_Contr_RawPayload";
BA_ "SystemSignalLongSymbol" SG_ 2147493632 Motor_Generator_2_Inverter_Contr "Motor_Generator_2_Inverter_Contr_RawPayload";
BA_ "SystemSignalLongSymbol" SG_ 2147493888 Motor_Generator_1_Inverter_Rate_ "Motor_Generator_1_Inverter_Rate__RawPayload";
BA_ "SystemSignalLongSymbol" SG_ 2147494144 Motor_Generator_2_Inverter_Rate_ "Motor_Generator_2_Inverter_Rate__RawPayload";
BA_ "SystemSignalLongSymbol" SG_ 2147494400 High_Voltage_Energy_Storage_Pack "High_Voltage_Energy_Storage_Pack_RawPayload";
BA_ "SystemSignalLongSymbol" SG_ 2147494656 High_Voltage_Energy_Storage_Pack "High_Voltage_Energy_Storage_Pack_RawPayload";
BA_ "SystemSignalLongSymbol" SG_ 2147494912 High_Voltage_Energy_Storage_Pack "High_Voltage_Energy_Storage_Pack_RawPayload";
BA_ "SystemSignalLongSymbol" SG_ 2147495168 High_Voltage_Energy_Storage_Pack "High_Voltage_Energy_Storage_Pack_RawPayload";
BA_ "SystemSignalLongSymbol" SG_ 2147495424 High_Voltage_Energy_Storage_Pack "High_Voltage_Energy_Storage_Pack_RawPayload";
BA_ "SystemSignalLongSymbol" SG_ 2147495680 High_Voltage_Energy_Storage_Pack "High_Voltage_Energy_Storage_Pack_RawPayload";
BA_ "SystemSignalLongSymbol" SG_ 2147495936 High_Voltage_Energy_Storage_Pack "High_Voltage_Energy_Storage_Pack_RawPayload";
BA_ "SystemSignalLongSymbol" SG_ 2147496192 High_Voltage_Energy_Storage_Pack "High_Voltage_Energy_Storage_Pack_RawPayload";
BA_ "SystemSignalLongSymbol" SG_ 2147496448 High_Voltage_Energy_Storage_Pack "High_Voltage_Energy_Storage_Pack_RawPayload";
BA_ "SystemSignalLongSymbol" SG_ 2147496704 High_Voltage_Energy_Storage_Pack "High_Voltage_Energy_Storage_Pack_RawPayload";
BA_ "SystemSignalLongSymbol" SG_ 2147497216 Reliable_Short_Message_RawPayloa "Reliable_Short_Message_RawPayload";
BA_ "SystemSignalLongSymbol" SG_ 2147497728 Message_Acknowledgement_RawPaylo "Message_Acknowledgement_RawPayload";
BA_ "SystemSignalLongSymbol" SG_ 2147497984 Version_Negotiation_Section_RawP "Version_Negotiation_Section_RawPayload";
BA_ "SystemSignalLongSymbol" SG_ 2147498240 External_ACC_Acceleration_Reques "External_ACC_Acceleration_Reques_RawPayload";
BA_ "SystemSignalLongSymbol" SG_ 2147498496 Battery_Charger_1_Command_1_RawP "Battery_Charger_1_Command_1_RawPayload";
BA_ "SystemSignalLongSymbol" SG_ 2147498752 Battery_Charger_2_Command_1_RawP "Battery_Charger_2_Command_1_RawPayload";
BA_ "SystemSignalLongSymbol" SG_ 2147499008 Tractor_Implement_Management_TIM "Tractor_Implement_Management_TIM_RawPayload";
BA_ "SystemSignalLongSymbol" SG_ 2147499264 Tractor_Implement_Management_TIM "Tractor_Implement_Management_TIM_RawPayload";
BA_ "SystemSignalLongSymbol" SG_ 2147499520 Fuel_Cell_System_Control_Command "Fuel_Cell_System_Control_Command_RawPayload";
BA_ "SystemSignalLongSymbol" SG_ 2147499776 Fuel_Cell_System_Power_Limit_Com "Fuel_Cell_System_Power_Limit_Com_RawPayload";
BA_ "SystemSignalLongSymbol" SG_ 2147500032 Fuel_Cell_System_Current_Limit_C "Fuel_Cell_System_Current_Limit_C_RawPayload";
BA_ "SystemSignalLongSymbol" SG_ 2147500288 Hydrogen_Storage_System_Control_ "Hydrogen_Storage_System_Control__RawPayload";
BA_ "SystemSignalLongSymbol" SG_ 2147500544 Transmission_Control_4_RawPayloa "Transmission_Control_4_RawPayload";
BA_ "SystemSignalLongSymbol" SG_ 2147500800 Safety_Header_Message_2_RawPaylo "Safety_Header_Message_2_RawPayload";
BA_ "SystemSignalLongSymbol" SG_ 2147502080 Tractor_Implement_Management_TIM "Tractor_Implement_Management_TIM_RawPayload";
BA_ "SystemSignalLongSymbol" SG_ 2147502336 Tractor_Implement_Management_TIM "Tractor_Implement_Management_TIM_RawPayload";
BA_ "SystemSignalLongSymbol" SG_ 2147502592 EV_Multi_Connection_DC_Status_1_ "EV_Multi_Connection_DC_Status_1_RawPayload";
BA_ "SystemSignalLongSymbol" SG_ 2147502848 EV_Multi_Connection_DC_Charging_ "EV_Multi_Connection_DC_Charging__RawPayload";
BA_ "SystemSignalLongSymbol" SG_ 2147503104 Electrified_Accessory_Engine_Coo "Electrified_Accessory_Engine_Coo_RawPayload";
BA_ "SystemSignalLongSymbol" SG_ 2147503360 FD_Transport_Protocol_Connection "FD_Transport_Protocol_Connection_RawPayload";
BA_ "SystemSignalLongSymbol" SG_ 2147503616 FD_Transport_Protocol_Data_Trans "FD_Transport_Protocol_Data_Trans_RawPayload";
BA_ "SystemSignalLongSymbol" SG_ 2147505408 Air_Suspension_Control_8_RawPayl "Air_Suspension_Control_8_RawPayload";
BA_ "SystemSignalLongSymbol" SG_ 2147505664 Motor_Generator_2_Inverter_Contr "Motor_Generator_2_Inverter_Contr_RawPayload";
BA_ "SystemSignalLongSymbol" SG_ 2147505920 Motor_Generator_1_Inverter_Contr "Motor_Generator_1_Inverter_Contr_RawPayload";
BA_ "SystemSignalLongSymbol" SG_ 2147506176 Hoist_Command_Information_RawPay "Hoist_Command_Information_RawPayload";
BA_ "SystemSignalLongSymbol" SG_ 2147506432 Motor_Generator_2_Inverter_Isola "Motor_Generator_2_Inverter_Isola_RawPayload";
BA_ "SystemSignalLongSymbol" SG_ 2147506688 Motor_Generator_1_Inverter_Isola "Motor_Generator_1_Inverter_Isola_RawPayload";
BA_ "SystemSignalLongSymbol" SG_ 2147506944 Motor_Generator_2_Inverter_Limit "Motor_Generator_2_Inverter_Limit_RawPayload";
BA_ "SystemSignalLongSymbol" SG_ 2147507200 Motor_Generator_2_Inverter_Limit "Motor_Generator_2_Inverter_Limit_RawPayload";
BA_ "SystemSignalLongSymbol" SG_ 2147507456 Motor_Generator_2_Inverter_Limit "Motor_Generator_2_Inverter_Limit_RawPayload";
BA_ "SystemSignalLongSymbol" SG_ 2147507712 Motor_Generator_1_Inverter_Limit "Motor_Generator_1_Inverter_Limit_RawPayload";
BA_ "SystemSignalLongSymbol" SG_ 2147507968 Motor_Generator_1_Inverter_Limit "Motor_Generator_1_Inverter_Limit_RawPayload";
BA_ "SystemSignalLongSymbol" SG_ 2147508224 Motor_Generator_1_Inverter_Limit "Motor_Generator_1_Inverter_Limit_RawPayload";
BA_ "SystemSignalLongSymbol" SG_ 2147508480 Personnel_Detect_Interlock_RawPa "Personnel_Detect_Interlock_RawPayload";
BA_ "SystemSignalLongSymbol" SG_ 2147508736 Engine_Cylinder_Combustion_Confi "Engine_Cylinder_Combustion_Confi_RawPayload";
BA_ "SystemSignalLongSymbol" SG_ 2147508992 Engine_Cylinder_Combustion_Confi "Engine_Cylinder_Combustion_Confi_RawPayload";
BA_ "SystemSignalLongSymbol" SG_ 2147509248 Engine_Cylinder_Pressure_Timing_ "Engine_Cylinder_Pressure_Timing__RawPayload";
BA_ "SystemSignalLongSymbol" SG_ 2147509504 Engine_Cylinder_Pressure_Timing_ "Engine_Cylinder_Pressure_Timing__RawPayload";
BA_ "SystemSignalLongSymbol" SG_ 2147509760 Electrified_Accessory_Generator_ "Electrified_Accessory_Generator__RawPayload";
BA_ "SystemSignalLongSymbol" SG_ 2147510016 Electrified_Accessory_Generator_ "Electrified_Accessory_Generator__RawPayload";
BA_ "SystemSignalLongSymbol" SG_ 2147510272 On_Board_Programming_1_RawPayloa "On_Board_Programming_1_RawPayload";
BA_ "SystemSignalLongSymbol" SG_ 2147510528 Marine_Control_Information_Confi "Marine_Control_Information_Confi_RawPayload";
BA_ "SystemSignalLongSymbol" SG_ 2147510784 Marine_Control_Information_2_Raw "Marine_Control_Information_2_RawPayload";
BA_ "SystemSignalLongSymbol" SG_ 2147511040 Well_Stimulation_Pump_Sensor_Cal "Well_Stimulation_Pump_Sensor_Cal_RawPayload";
BA_ "SystemSignalLongSymbol" SG_ 2147511296 CiA_602_2_XCP_Obsolete_RawPayloa "CiA_602_2_XCP_Obsolete_RawPayload";
BA_ "SystemSignalLongSymbol" SG_ 2147511552 Well_Stimulation_Pump_System_Con "Well_Stimulation_Pump_System_Con_RawPayload";
BA_ "SystemSignalLongSymbol" SG_ 2147511808 Configurable_Receive_SPNs_Comman "Configurable_Receive_SPNs_Comman_RawPayload";
BA_ "SystemSignalLongSymbol" SG_ 2147512064 Authentication_Client_to_Authent "Authentication_Client_to_Authent_RawPayload";
BA_ "SystemSignalLongSymbol" SG_ 2147512320 Authentication_Server_to_Authent "Authentication_Server_to_Authent_RawPayload";
BA_ "SystemSignalLongSymbol" SG_ 2147512576 Configurable_Transmit_PGNs_Comma "Configurable_Transmit_PGNs_Comma_RawPayload";
BA_ "SystemSignalLongSymbol" SG_ 2147512832 Oil_Debris_Monitor_Configuration "Oil_Debris_Monitor_Configuration_RawPayload";
BA_ "SystemSignalLongSymbol" SG_ 2147513088 Electrified_Accessory_Propulsion "Electrified_Accessory_Propulsion_RawPayload";
BA_ "SystemSignalLongSymbol" SG_ 2147513344 Electrified_Accessory_Propulsion "Electrified_Accessory_Propulsion_RawPayload";
BA_ "SystemSignalLongSymbol" SG_ 2147513600 Electrified_Accessory_Propulsion "Electrified_Accessory_Propulsion_RawPayload";
BA_ "SystemSignalLongSymbol" SG_ 2147513856 Electrified_Accessory_Power_Elec "Electrified_Accessory_Power_Elec_RawPayload";
BA_ "SystemSignalLongSymbol" SG_ 2147514112 Electrified_Accessory_Power_Elec "Electrified_Accessory_Power_Elec_RawPayload";
BA_ "SystemSignalLongSymbol" SG_ 2147514368 Electrified_Accessory_Power_Elec "Electrified_Accessory_Power_Elec_RawPayload";
BA_ "SystemSignalLongSymbol" SG_ 2147514624 Electrified_Accessory_Propulsion "Electrified_Accessory_Propulsion_RawPayload";
BA_ "SystemSignalLongSymbol" SG_ 2147514880 Electrified_Accessory_Propulsion "Electrified_Accessory_Propulsion_RawPayload";
BA_ "SystemSignalLongSymbol" SG_ 2147515136 Electrified_Accessory_Power_Elec "Electrified_Accessory_Power_Elec_RawPayload";
BA_ "SystemSignalLongSymbol" SG_ 2147515392 Extended_Control_Function_Functi "Extended_Control_Function_Functi_RawPayload";
BA_ "SystemSignalLongSymbol" SG_ 2147515648 Electrified_Accessory_Motor_Comm "Electrified_Accessory_Motor_Comm_RawPayload";
BA_ "SystemSignalLongSymbol" SG_ 2147515904 Engine_Speed_Ramp_Rate_Boundary_ "Engine_Speed_Ramp_Rate_Boundary__RawPayload";
BA_ "SystemSignalLongSymbol" SG_ 2147516160 Tire_Sensor_Identification_Comma "Tire_Sensor_Identification_Comma_RawPayload";
BA_ "SystemSignalLongSymbol" SG_ 2147516416 Hybrid_or_EV_System_Control_1_Ra "Hybrid_or_EV_System_Control_1_RawPayload";
BA_ "SystemSignalLongSymbol" SG_ 2147516672 Aftertreatment_System_Control_Ra "Aftertreatment_System_Control_RawPayload";
BA_ "SystemSignalLongSymbol" SG_ 2147516928 Tire_Configuration_Command_Infor "Tire_Configuration_Command_Infor_RawPayload";
BA_ "SystemSignalLongSymbol" SG_ 2147517184 Payload_Calibration_Information_ "Payload_Calibration_Information__RawPayload";
BA_ "SystemSignalLongSymbol" SG_ 2147517440 Aftertreatment_1_Particulate_Sen "Aftertreatment_1_Particulate_Sen_RawPayload";
BA_ "SystemSignalLongSymbol" SG_ 2147517952 Switched_Power_Outputs_Command_R "Switched_Power_Outputs_Command_RawPayload";
BA_ "SystemSignalLongSymbol" SG_ 2147518720 Running_Gear_Equipment_2_4_RawPa "Running_Gear_Equipment_2_4_RawPayload";
BA_ "SystemSignalLongSymbol" SG_ 2147518976 Running_Gear_Equipment_1_2_RawPa "Running_Gear_Equipment_1_2_RawPayload";
BA_ "SystemSignalLongSymbol" SG_ 2147519232 CCP_Data_Transmission_Object_Raw "CCP_Data_Transmission_Object_RawPayload";
BA_ "SystemSignalLongSymbol" SG_ 2147519488 CCP_Command_Receive_Object_RawPa "CCP_Command_Receive_Object_RawPayload";
BA_ "SystemSignalLongSymbol" SG_ 2147519744 Sequence_Control_Client_to_Seque "Sequence_Control_Client_to_Seque_RawPayload";
BA_ "SystemSignalLongSymbol" SG_ 2147520000 Sequence_Control_Master_to_Seque "Sequence_Control_Master_to_Seque_RawPayload";
BA_ "SystemSignalLongSymbol" SG_ 2147520256 Engine_Configuration_Commands_Ra "Engine_Configuration_Commands_RawPayload";
BA_ "SystemSignalLongSymbol" SG_ 2147520512 Supplemental_Fan_Command_RawPayl "Supplemental_Fan_Command_RawPayload";
BA_ "SystemSignalLongSymbol" SG_ 2147520768 Vehicle_Chassis_Lubrication_Syst "Vehicle_Chassis_Lubrication_Syst_RawPayload";
BA_ "SystemSignalLongSymbol" SG_ 2147521024 Aftertreatment_1_Hydrocarbon_Dos "Aftertreatment_1_Hydrocarbon_Dos_RawPayload";
BA_ "SystemSignalLongSymbol" SG_ 2147521280 NAME_Management_Message_RawPaylo "NAME_Management_Message_RawPayload";
BA_ "SystemSignalLongSymbol" SG_ 2147521536 Aftertreatment_1_Diesel_Particul "Aftertreatment_1_Diesel_Particul_RawPayload";
BA_ "SystemSignalLongSymbol" SG_ 2147521792 Aftertreatment_2_Diesel_Particul "Aftertreatment_2_Diesel_Particul_RawPayload";
BA_ "SystemSignalLongSymbol" SG_ 2147522048 Low_Voltage_Disconnect_Set_Opera "Low_Voltage_Disconnect_Set_Opera_RawPayload";
BA_ "SystemSignalLongSymbol" SG_ 2147522816 Joystick_Lamp_Command_Message_Ra "Joystick_Lamp_Command_Message_RawPayload";
BA_ "SystemSignalLongSymbol" SG_ 2147523072 General_Purpose_Message_1_8_RawP "General_Purpose_Message_1_8_RawPayload";
BA_ "SystemSignalLongSymbol" SG_ 2147523584 Auxiliary_Input_Output_Status_7_ "Auxiliary_Input_Output_Status_7_RawPayload";
BA_ "SystemSignalLongSymbol" SG_ 2147523840 Auxiliary_Input_Output_Status_6_ "Auxiliary_Input_Output_Status_6_RawPayload";
BA_ "SystemSignalLongSymbol" SG_ 2147524352 Immediate_Fault_Status_RawPayloa "Immediate_Fault_Status_RawPayload";
BA_ "SystemSignalLongSymbol" SG_ 2147524864 Emission_Increasing_Auxiliary_Em "Emission_Increasing_Auxiliary_Em_RawPayload";
BA_ "SystemSignalLongSymbol" SG_ 2147525120 Regulated_Exhaust_Emission_Level "Regulated_Exhaust_Emission_Level_RawPayload";
BA_ "SystemSignalLongSymbol" SG_ 2147525376 DTC_To_Lamp_Association_RawPaylo "DTC_To_Lamp_Association_RawPayload";
BA_ "SystemSignalLongSymbol" SG_ 2147525888 Auxiliary_Input_Output_Status_4_ "Auxiliary_Input_Output_Status_4_RawPayload";
BA_ "SystemSignalLongSymbol" SG_ 2147526144 Auxiliary_Input_Output_Status_3_ "Auxiliary_Input_Output_Status_3_RawPayload";
BA_ "SystemSignalLongSymbol" SG_ 2147526400 Auxiliary_Input_Output_Status_2_ "Auxiliary_Input_Output_Status_2_RawPayload";
BA_ "SystemSignalLongSymbol" SG_ 2147526912 Forward_Lane_Image_Command_RawPa "Forward_Lane_Image_Command_RawPayload";
BA_ "SystemSignalLongSymbol" SG_ 2147527168 Client_ECU_to_File_Server_messag "Client_ECU_to_File_Server_messag_RawPayload";
BA_ "SystemSignalLongSymbol" SG_ 2147527424 File_Server_to_Client_ECU_messag "File_Server_to_Client_ECU_messag_RawPayload";
BA_ "SystemSignalLongSymbol" SG_ 2147528192 Tire_Pressure_Reference_Setting_ "Tire_Pressure_Reference_Setting_RawPayload";
BA_ "SystemSignalLongSymbol" SG_ 2147528448 Parameter_Locate_Message_RawPayl "Parameter_Locate_Message_RawPayload";
BA_ "SystemSignalLongSymbol" SG_ 2147528704 Configuration_Identification_Mes "Configuration_Identification_Mes_RawPayload";
BA_ "SystemSignalLongSymbol" SG_ 2147528960 Proprietarily_Configurable_Messa "Proprietarily_Configurable_Messa_RawPayload";
BA_ "SystemSignalLongSymbol" SG_ 2147529216 Proprietarily_Configurable_Messa "Proprietarily_Configurable_Messa_RawPayload";
BA_ "SystemSignalLongSymbol" SG_ 2147529472 Proprietarily_Configurable_Messa "Proprietarily_Configurable_Messa_RawPayload";
BA_ "SystemSignalLongSymbol" SG_ 2147529728 Proprietarily_Configurable_Messa "Proprietarily_Configurable_Messa_RawPayload";
BA_ "SystemSignalLongSymbol" SG_ 2147529984 Proprietarily_Configurable_Messa "Proprietarily_Configurable_Messa_RawPayload";
BA_ "SystemSignalLongSymbol" SG_ 2147530240 Proprietarily_Configurable_Messa "Proprietarily_Configurable_Messa_RawPayload";
BA_ "SystemSignalLongSymbol" SG_ 2147530496 Proprietarily_Configurable_Messa "Proprietarily_Configurable_Messa_RawPayload";
BA_ "SystemSignalLongSymbol" SG_ 2147530752 Proprietarily_Configurable_Messa "Proprietarily_Configurable_Messa_RawPayload";
BA_ "SystemSignalLongSymbol" SG_ 2147531008 Proprietarily_Configurable_Messa "Proprietarily_Configurable_Messa_RawPayload";
BA_ "SystemSignalLongSymbol" SG_ 2147531264 Proprietarily_Configurable_Messa "Proprietarily_Configurable_Messa_RawPayload";
BA_ "SystemSignalLongSymbol" SG_ 2147531520 Proprietarily_Configurable_Messa "Proprietarily_Configurable_Messa_RawPayload";
BA_ "SystemSignalLongSymbol" SG_ 2147531776 Proprietarily_Configurable_Messa "Proprietarily_Configurable_Messa_RawPayload";
BA_ "SystemSignalLongSymbol" SG_ 2147532032 Proprietarily_Configurable_Messa "Proprietarily_Configurable_Messa_RawPayload";
BA_ "SystemSignalLongSymbol" SG_ 2147532288 Proprietarily_Configurable_Messa "Proprietarily_Configurable_Messa_RawPayload";
BA_ "SystemSignalLongSymbol" SG_ 2147532544 Proprietarily_Configurable_Messa "Proprietarily_Configurable_Messa_RawPayload";
BA_ "SystemSignalLongSymbol" SG_ 2147532800 Proprietarily_Configurable_Messa "Proprietarily_Configurable_Messa_RawPayload";
BA_ "SystemSignalLongSymbol" SG_ 2147533056 Diagnostic_Readiness_2_RawPayloa "Diagnostic_Readiness_2_RawPayload";
BA_ "SystemSignalLongSymbol" SG_ 2147533312 Monitor_Performance_Ratio_RawPay "Monitor_Performance_Ratio_RawPayload";
BA_ "SystemSignalLongSymbol" SG_ 2147533824 General_Purpose_Valve_command_Ra "General_Purpose_Valve_command_RawPayload";
BA_ "SystemSignalLongSymbol" SG_ 2147534080 General_Purpose_Valve_measured_f "General_Purpose_Valve_measured_f_RawPayload";
BA_ "SystemSignalLongSymbol" SG_ 2147534336 General_Purpose_Valve_estimated_ "General_Purpose_Valve_estimated__RawPayload";
BA_ "SystemSignalLongSymbol" SG_ 2147536640 Continuous_Torque_Speed_Limit_Re "Continuous_Torque_Speed_Limit_Re_RawPayload";
BA_ "SystemSignalLongSymbol" SG_ 2147536896 Background_lighting_level_comman "Background_lighting_level_comman_RawPayload";
BA_ "SystemSignalLongSymbol" SG_ 2147537152 Air_Suspension_Control_6_RawPayl "Air_Suspension_Control_6_RawPayload";
BA_ "SystemSignalLongSymbol" SG_ 2147537408 Air_Suspension_Control_2_RawPayl "Air_Suspension_Control_2_RawPayload";
BA_ "SystemSignalLongSymbol" SG_ 2147537664 Calibration_Information_RawPaylo "Calibration_Information_RawPayload";
BA_ "SystemSignalLongSymbol" SG_ 2147541248 General_Purpose_Message_2_1_RawP "General_Purpose_Message_2_1_RawPayload";
BA_ "SystemSignalLongSymbol" SG_ 2147541504 General_Purpose_Message_1_1_RawP "General_Purpose_Message_1_1_RawPayload";
BA_ "SystemSignalLongSymbol" SG_ 2147541760 Command_Non_continuously_Monitor "Command_Non_continuously_Monitor_RawPayload";
BA_ "SystemSignalLongSymbol" SG_ 2147542016 Running_Gear_Equipment_1_1_RawPa "Running_Gear_Equipment_1_1_RawPayload";
BA_ "SystemSignalLongSymbol" SG_ 2147542272 Running_Gear_Equipment_2_1_RawPa "Running_Gear_Equipment_2_1_RawPayload";
BA_ "SystemSignalLongSymbol" SG_ 2147545088 Electronic_Retarder_Controller_1 "Electronic_Retarder_Controller_1_RawPayload";
BA_ "SystemSignalLongSymbol" SG_ 2147545089 Electronic_Brake_Controller_1_Ra "Electronic_Brake_Controller_1_RawPayload";
BA_ "SystemSignalLongSymbol" SG_ 2147545090 Electronic_Transmission_Controll "Electronic_Transmission_Controll_RawPayload";
BA_ "SystemSignalLongSymbol" SG_ 2147545093 Electronic_Transmission_Controll "Electronic_Transmission_Controll_RawPayload";
BA_ "SystemSignalLongSymbol" SG_ 2147545094 Electronic_Axle_Controller_1_Raw "Electronic_Axle_Controller_1_RawPayload";
BA_ "SystemSignalLongSymbol" SG_ 2147545096 Hydraulic_Pressure_Governor_Info "Hydraulic_Pressure_Governor_Info_RawPayload";
BA_ "SystemSignalLongSymbol" SG_ 2147545097 Vehicle_Dynamic_Stability_Contro "Vehicle_Dynamic_Stability_Contro_RawPayload";
BA_ "SystemSignalLongSymbol" SG_ 2147545098 Engine_Gas_Flow_Rate_1_RawPayloa "Engine_Gas_Flow_Rate_1_RawPayload";
BA_ "SystemSignalLongSymbol" SG_ 2147545099 Electronic_Steering_Control_RawP "Electronic_Steering_Control_RawPayload";
BA_ "SystemSignalLongSymbol" SG_ 2147545100 Electronic_Transmission_Controll "Electronic_Transmission_Controll_RawPayload";
BA_ "SystemSignalLongSymbol" SG_ 2147545101 Land_Leveling_System_Operational "Land_Leveling_System_Operational_RawPayload";
BA_ "SystemSignalLongSymbol" SG_ 2147545102 Aftertreatment_1_Intake_Gas_1_Ra "Aftertreatment_1_Intake_Gas_1_RawPayload";
BA_ "SystemSignalLongSymbol" SG_ 2147545103 Aftertreatment_1_Outlet_Gas_1_Ra "Aftertreatment_1_Outlet_Gas_1_RawPayload";
BA_ "SystemSignalLongSymbol" SG_ 2147545104 Aftertreatment_2_Intake_Gas_1_Ra "Aftertreatment_2_Intake_Gas_1_RawPayload";
BA_ "SystemSignalLongSymbol" SG_ 2147545105 Aftertreatment_2_Outlet_Gas_1_Ra "Aftertreatment_2_Outlet_Gas_1_RawPayload";
BA_ "SystemSignalLongSymbol" SG_ 2147545106 Fifth_Wheel_Smart_Systems_1_RawP "Fifth_Wheel_Smart_Systems_1_RawPayload";
BA_ "SystemSignalLongSymbol" SG_ 2147545107 Slope_Sensor_Information_RawPayl "Slope_Sensor_Information_RawPayload";
BA_ "SystemSignalLongSymbol" SG_ 2147545109 Requested_Generator_Total_AC_Rea "Requested_Generator_Total_AC_Rea_RawPayload";
BA_ "SystemSignalLongSymbol" SG_ 2147545110 Cylinder_Combustion_Status_RawPa "Cylinder_Combustion_Status_RawPayload";
BA_ "SystemSignalLongSymbol" SG_ 2147545114 Engine_Throttle_Fuel_Actuator_Co "Engine_Throttle_Fuel_Actuator_Co_RawPayload";
BA_ "SystemSignalLongSymbol" SG_ 2147545115 General_Purpose_Message_1_7_RawP "General_Purpose_Message_1_7_RawPayload";
BA_ "SystemSignalLongSymbol" SG_ 2147545116 Requested_Generator_Average_Basi "Requested_Generator_Average_Basi_RawPayload";
BA_ "SystemSignalLongSymbol" SG_ 2147545117 Steering_Angle_Sensor_Informatio "Steering_Angle_Sensor_Informatio_RawPayload";
BA_ "SystemSignalLongSymbol" SG_ 2147545119 Electronic_Brake_System_2_6_RawP "Electronic_Brake_System_2_6_RawPayload";
BA_ "SystemSignalLongSymbol" SG_ 2147545120 Electronic_Brake_System_2_5_RawP "Electronic_Brake_System_2_5_RawPayload";
BA_ "SystemSignalLongSymbol" SG_ 2147545121 Engine_Speed_Sensor_Information_ "Engine_Speed_Sensor_Information__RawPayload";
BA_ "SystemSignalLongSymbol" SG_ 2147545123 Aftertreatment_1_SCR_Dosing_Syst "Aftertreatment_1_SCR_Dosing_Syst_RawPayload";
BA_ "SystemSignalLongSymbol" SG_ 2147545124 Aftertreatment_1_SCR_Dosing_Syst "Aftertreatment_1_SCR_Dosing_Syst_RawPayload";
BA_ "SystemSignalLongSymbol" SG_ 2147545125 Aftertreatment_1_SCR_Ammonia_Inf "Aftertreatment_1_SCR_Ammonia_Inf_RawPayload";
BA_ "SystemSignalLongSymbol" SG_ 2147545126 Aftertreatment_2_SCR_Dosing_Syst "Aftertreatment_2_SCR_Dosing_Syst_RawPayload";
BA_ "SystemSignalLongSymbol" SG_ 2147545127 Aftertreatment_2_SCR_Dosing_Syst "Aftertreatment_2_SCR_Dosing_Syst_RawPayload";
BA_ "SystemSignalLongSymbol" SG_ 2147545128 Aftertreatment_2_SCR_Ammonia_Inf "Aftertreatment_2_SCR_Ammonia_Inf_RawPayload";
BA_ "SystemSignalLongSymbol" SG_ 2147545129 Slope_Sensor_Information_2_RawPa "Slope_Sensor_Information_2_RawPayload";
BA_ "SystemSignalLongSymbol" SG_ 2147545130 Angular_Rate_Information_RawPayl "Angular_Rate_Information_RawPayload";
BA_ "SystemSignalLongSymbol" SG_ 2147545132 Magnet_Status_Information_2_RawP "Magnet_Status_Information_2_RawPayload";
BA_ "SystemSignalLongSymbol" SG_ 2147545134 Engine_Turbocharger_Control_1_Ra "Engine_Turbocharger_Control_1_RawPayload";
BA_ "SystemSignalLongSymbol" SG_ 2147545135 Advanced_Emergency_Braking_Syste "Advanced_Emergency_Braking_Syste_RawPayload";
BA_ "SystemSignalLongSymbol" SG_ 2147545138 Linear_Displacement_Sensor_RawPa "Linear_Displacement_Sensor_RawPayload";
BA_ "SystemSignalLongSymbol" SG_ 2147545139 Aftertreatment_1_SCR_Ammonia_Inf "Aftertreatment_1_SCR_Ammonia_Inf_RawPayload";
BA_ "SystemSignalLongSymbol" SG_ 2147545140 Aftertreatment_2_SCR_Ammonia_Inf "Aftertreatment_2_SCR_Ammonia_Inf_RawPayload";
BA_ "SystemSignalLongSymbol" SG_ 2147545142 High_Voltage_Energy_Storage_Syst "High_Voltage_Energy_Storage_Syst_RawPayload";
BA_ "SystemSignalLongSymbol" SG_ 2147545143 Engine_Turbocharger_Blowoff_Actu "Engine_Turbocharger_Blowoff_Actu_RawPayload";
BA_ "SystemSignalLongSymbol" SG_ 2147545144 Engine_Torque_Fuel_Request_RawPa "Engine_Torque_Fuel_Request_RawPayload";
BA_ "SystemSignalLongSymbol" SG_ 2147545145 Engine_Air_System_Information_Ra "Engine_Air_System_Information_RawPayload";
BA_ "SystemSignalLongSymbol" SG_ 2147545146 Engine_Cylinder_1_Combustion_Inf "Engine_Cylinder_1_Combustion_Inf_RawPayload";
BA_ "SystemSignalLongSymbol" SG_ 2147545147 Engine_Cylinder_2_Combustion_Inf "Engine_Cylinder_2_Combustion_Inf_RawPayload";
BA_ "SystemSignalLongSymbol" SG_ 2147545148 Engine_Cylinder_3_Combustion_Inf "Engine_Cylinder_3_Combustion_Inf_RawPayload";
BA_ "SystemSignalLongSymbol" SG_ 2147545149 Engine_Cylinder_4_Combustion_Inf "Engine_Cylinder_4_Combustion_Inf_RawPayload";
BA_ "SystemSignalLongSymbol" SG_ 2147545150 Engine_Cylinder_5_Combustion_Inf "Engine_Cylinder_5_Combustion_Inf_RawPayload";
BA_ "SystemSignalLongSymbol" SG_ 2147545151 Engine_Cylinder_6_Combustion_Inf "Engine_Cylinder_6_Combustion_Inf_RawPayload";
BA_ "SystemSignalLongSymbol" SG_ 2147545152 Engine_Cylinder_7_Combustion_Inf "Engine_Cylinder_7_Combustion_Inf_RawPayload";
BA_ "SystemSignalLongSymbol" SG_ 2147545153 Engine_Cylinder_8_Combustion_Inf "Engine_Cylinder_8_Combustion_Inf_RawPayload";
BA_ "SystemSignalLongSymbol" SG_ 2147545154 Engine_Cylinder_9_Combustion_Inf "Engine_Cylinder_9_Combustion_Inf_RawPayload";
BA_ "SystemSignalLongSymbol" SG_ 2147545155 Engine_Cylinder_10_Combustion_In "Engine_Cylinder_10_Combustion_In_RawPayload";
BA_ "SystemSignalLongSymbol" SG_ 2147545156 Engine_Cylinder_11_Combustion_In "Engine_Cylinder_11_Combustion_In_RawPayload";
BA_ "SystemSignalLongSymbol" SG_ 2147545157 Engine_Cylinder_12_Combustion_In "Engine_Cylinder_12_Combustion_In_RawPayload";
BA_ "SystemSignalLongSymbol" SG_ 2147545158 Engine_Cylinder_13_Combustion_In "Engine_Cylinder_13_Combustion_In_RawPayload";
BA_ "SystemSignalLongSymbol" SG_ 2147545159 Engine_Cylinder_14_Combustion_In "Engine_Cylinder_14_Combustion_In_RawPayload";
BA_ "SystemSignalLongSymbol" SG_ 2147545160 Engine_Cylinder_15_Combustion_In "Engine_Cylinder_15_Combustion_In_RawPayload";
BA_ "SystemSignalLongSymbol" SG_ 2147545161 Engine_Cylinder_16_Combustion_In "Engine_Cylinder_16_Combustion_In_RawPayload";
BA_ "SystemSignalLongSymbol" SG_ 2147545162 Engine_Cylinder_17_Combustion_In "Engine_Cylinder_17_Combustion_In_RawPayload";
BA_ "SystemSignalLongSymbol" SG_ 2147545163 Engine_Cylinder_18_Combustion_In "Engine_Cylinder_18_Combustion_In_RawPayload";
BA_ "SystemSignalLongSymbol" SG_ 2147545164 Engine_Cylinder_19_Combustion_In "Engine_Cylinder_19_Combustion_In_RawPayload";
BA_ "SystemSignalLongSymbol" SG_ 2147545165 Engine_Cylinder_20_Combustion_In "Engine_Cylinder_20_Combustion_In_RawPayload";
BA_ "SystemSignalLongSymbol" SG_ 2147545166 Engine_Cylinder_1_Combustion_Ave "Engine_Cylinder_1_Combustion_Ave_RawPayload";
BA_ "SystemSignalLongSymbol" SG_ 2147545167 Engine_Cylinder_2_Combustion_Ave "Engine_Cylinder_2_Combustion_Ave_RawPayload";
BA_ "SystemSignalLongSymbol" SG_ 2147545168 Engine_Cylinder_3_Combustion_Ave "Engine_Cylinder_3_Combustion_Ave_RawPayload";
BA_ "SystemSignalLongSymbol" SG_ 2147545169 Engine_Cylinder_4_Combustion_Ave "Engine_Cylinder_4_Combustion_Ave_RawPayload";
BA_ "SystemSignalLongSymbol" SG_ 2147545170 Engine_Cylinder_5_Combustion_Ave "Engine_Cylinder_5_Combustion_Ave_RawPayload";
BA_ "SystemSignalLongSymbol" SG_ 2147545171 Engine_Cylinder_6_Combustion_Ave "Engine_Cylinder_6_Combustion_Ave_RawPayload";
BA_ "SystemSignalLongSymbol" SG_ 2147545172 Engine_Cylinder_7_Combustion_Ave "Engine_Cylinder_7_Combustion_Ave_RawPayload";
BA_ "SystemSignalLongSymbol" SG_ 2147545173 Engine_Cylinder_8_Combustion_Ave "Engine_Cylinder_8_Combustion_Ave_RawPayload";
BA_ "SystemSignalLongSymbol" SG_ 2147545174 Engine_Cylinder_9_Combustion_Ave "Engine_Cylinder_9_Combustion_Ave_RawPayload";
BA_ "SystemSignalLongSymbol" SG_ 2147545175 Engine_Cylinder_10_Combustion_Av "Engine_Cylinder_10_Combustion_Av_RawPayload";
BA_ "SystemSignalLongSymbol" SG_ 2147545176 Engine_Cylinder_11_Combustion_Av "Engine_Cylinder_11_Combustion_Av_RawPayload";
BA_ "SystemSignalLongSymbol" SG_ 2147545177 Engine_Cylinder_12_Combustion_Av "Engine_Cylinder_12_Combustion_Av_RawPayload";
